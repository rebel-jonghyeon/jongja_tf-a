## bootloader/rot/cmrt-zephyr-2.0.36/dts/bindings/cmrt/rambus,cmrt-pdma.yaml
```yaml
# Copyright (c) 2023 Cryptography Research, Inc. (CRI)

description: CMRT PDMA Core

compatible: "rambus,cmrt-pdma"

include: rambus,cmrt-hwc.yaml
```

## bootloader/rot/cmrt-zephyr-2.0.36/dts/bindings/cmrt/rambus,cmrt-pke.yaml
```yaml
# Copyright (c) 2022-2023 Cryptography Research, Inc. (CRI)

description: CMRT Public Key Engine (PKE)

compatible: "rambus,cmrt-pke"

include: rambus,cmrt-hwc.yaml
```

## bootloader/rot/cmrt-zephyr-2.0.36/dts/bindings/cmrt/rambus,cmrt-sac.yaml
```yaml
# Copyright (c) 2022-2023 Cryptography Research, Inc. (CRI)

description: CMRT System Aperture Core (SAC)

compatible: "rambus,cmrt-sac"

include: rambus,cmrt-hwc.yaml

properties:
    num-segments:
      required: true
      type: int
      description: number of SAC segments supported by hardware

    segment0-default:
      required: true
      type: int
      description: default value for SAC segment 0 at boot up

    user-access:
      type: boolean
      required: false
      description: set if HW allows direct user mode access to SAC memory
```

## bootloader/rot/cmrt-zephyr-2.0.36/dts/bindings/cmrt/rambus,cmrt-sac2.yaml
```yaml
# Copyright (c) 2022-2023 Cryptography Research, Inc. (CRI)

description: CMRT 64bit System Aperture Core (SAC2)

compatible: "rambus,cmrt-sac2"

include: rambus,cmrt-hwc.yaml

properties:
    user-access:
      type: boolean
      required: false
      description: set if HW allows direct user mode access to SAC memory
```

## bootloader/rot/cmrt-zephyr-2.0.36/dts/bindings/cmrt/rambus,cmrt-sic.yaml
```yaml
# Copyright (c) 2022-2023 Cryptography Research, Inc. (CRI)

description: CMRT System Interface Core (SIC)

compatible: "rambus,cmrt-sic"

include: [interrupt-controller.yaml, "rambus,cmrt-hwc.yaml"]

properties:
    num-custom:
      required: true
      type: int
      description: number of custom registers supported by hardware

    num-irqs:
      required: true
      type: int
      description: number of SoC interrupts supported by hardware

    "#interrupt-cells":
      const: 2

interrupt-cells:
    - irq
    - priority
```

## bootloader/rot/cmrt-zephyr-2.0.36/dts/bindings/cmrt/rambus,cmrt-sic2.yaml
```yaml
# Copyright (c) 2022-2023 Cryptography Research, Inc. (CRI)

description: CMRT System Interface Core (SIC2) with multi-master support

compatible: "rambus,cmrt-sic2"

include: rambus,cmrt-sic.yaml

properties:
    num-instances:
      required: true
      type: int
      description: number of messaging instances supported by hardware

    has-boot-control:
      required: false
      type: boolean
      description: flag to support the boot control register
```

## bootloader/rot/cmrt-zephyr-2.0.36/dts/bindings/cmrt/rambus,cmrt-tmc.yaml
```yaml
# Copyright (c) 2022-2023 Cryptography Research, Inc. (CRI)

description: CMRT TRNG Management Core (TMC)

compatible: "rambus,cmrt-tmc"

include: rambus,cmrt-hwc.yaml

properties:
    eip76-trng:
      required: false
      type: boolean
      description: flag for EIP76 TRNG instead of the default CRNG

    eip76-fros:
      required: false
      type: int
      default: 8
      description: number of FROs, typically either 8 or 24

    tmc-ext-entropy:
      required: false
      type: boolean
      description: flag for external entropy configuration
```

## bootloader/rot/cmrt-zephyr-2.0.36/dts/bindings/ethernet/xlnx,axi-eth.yaml
```yaml
# Copyright (c) 2023 Cryptography Research, Inc. (CRI)

description: Xilinx AXI DMA and Ethernet controller

compatible: "xlnx,axi-eth"

include: ethernet.yaml

properties:
    reg:
      required: true

    interrupts:
      required: true

    clock-frequency:
      type: int
      required: true
      description: AXI clock frequency.

    dma:
      type: array
      required: true
      description: AXI DMA register space

    ddr:
      type: array
      required: true
      description: AXI DDR buffer space
```

## bootloader/rot/cmrt-zephyr-2.0.36/dts/bindings/interrupt-controller/rambus,cmrt-plic.yaml
```yaml
# Copyright (c) 2022-2023 Cryptography Research, Inc. (CRI)

description: CMRT RISC-V platform-local interrupt controller

compatible: "rambus,cmrt-plic"

include: [interrupt-controller.yaml, base.yaml]

properties:
  reg:
      required: true

  "#interrupt-cells":
      const: 1

interrupt-cells:
  - irq
```

## bootloader/rot/cmrt-zephyr-2.0.36/dts/bindings/interrupt-controller/xlnx,axi-intc.yaml
```yaml
# Copyright (c) 2023 Cryptography Research, Inc. (CRI)

description: Xilinx AXI interrupt controller

compatible: "xlnx,axi-intc"

include: [interrupt-controller.yaml, base.yaml]

properties:
  reg:
      required: true

  "#interrupt-cells":
      const: 1

interrupt-cells:
  - irq
```

## bootloader/rot/cmrt-zephyr-2.0.36/dts/bindings/ipm/samsung,mailbox.yaml
```yaml
# Copyright (c) 2024 Samsung Electronics Co, Ltd.
# SPDX-License-Identifier: Apache-2.0

description: SAMSUNG MAILBOX

compatible: "samsung,mailbox"

include: base.yaml

properties:
  reg:
      required: true

  interrupts:
      required: true

  label:
      required: true

interrupt-cells:
    - irq
```

## bootloader/rot/cmrt-zephyr-2.0.36/dts/bindings/misc/samsung,pvt.yaml
```yaml
# Copyright (c) 2024, SAMSUNG
# SPDX-License-Identifier: Apache-2.0

description: SAMSUNG PVT

compatible: "samsung,pvt"

include: base.yaml

properties:
  status:
      required: true

  reg:
      required: true

  label:
      required: true
```

## bootloader/rot/cmrt-zephyr-2.0.36/dts/bindings/mmu_mpu/rambus,cmrt-mpu.yaml
```yaml
description: RISC-V CMRT Memory Protection Unit (MPU)

compatible: "rambus,cmrt-mpu"

include: base.yaml

properties:
    reg:
      required: true

    num-regions:
      required: true
      type: int
      description: number of MPU regions supported by hardware
```

## bootloader/rot/cmrt-zephyr-2.0.36/dts/bindings/otp/samsung,otp.yaml
```yaml
# Copyright (c) 2024, SAMSUNG
# SPDX-License-Identifier: Apache-2.0

description: SAMSUNG OTP

compatible: "samsung,otp"

include: base.yaml

properties:
  reg:
      required: true

  interrupts:
      required: false

  label:
      required: true

  ecc_parity_addr_offset:
      type: int
      required: true

  bank_num:
      type: int
      required: true

  bank_type:
      type: array
      required: true

  parity_bank_type:
      type: array
      required: true

interrupt-cells:
    - irq
```

## bootloader/rot/cmrt-zephyr-2.0.36/dts/bindings/spi/samsung,qspi.yaml
```yaml
# Copyright (c) 2025 Samsung Electronics Co, Ltd.
# SPDX-License-Identifier: Apache-2.0

description: SAMSUNG QSPI

compatible: "samsung,qspi"

include: base.yaml

properties:
  reg:
      required: true

  label:
      required: true
```

## bootloader/rot/cmrt-zephyr-2.0.36/dts/bindings/syscon/samsung,sysreg.yaml
```yaml
# Copyright (c) 2024, SAMSUNG
# SPDX-License-Identifier: Apache-2.0

description: SAMSUNG SYSREG

compatible: "samsung,sysreg-rot"

include: base.yaml

properties:
  reg:
      required: true

  interrupts:
      required: false

  label:
      required: true
```

## bootloader/rot/cmrt-zephyr-2.0.36/dts/bindings/watchdog/rambus,cmrt-wdt.yaml
```yaml
# Copyright (c) 2022-2023 Cryptography Research, Inc. (CRI)

description: CMRT watchdog within the timer module

compatible: "rambus,cmrt-wdt"

include: base.yaml

properties:
    reg:
      required: true

    label:
      required: true
```

## bootloader/rot/cmrt-zephyr-2.0.36/lib/caliptra/Kconfig
```kconfig
# Copyright (c) 2023 Cryptography Research, Inc. (CRI).
# A license or authorization from CRI is needed to use this file

config CMRT_CALIPTRA_LIBRARY
	bool
	default n
	prompt "Caliptra support library"
	select CMRT_UCU_LIBRARY
	help
	  Build the Caliptra support library.
```

## bootloader/rot/cmrt-zephyr-2.0.36/lib/libshsig/Kconfig
```kconfig
# Kconfig - SHSIG library

#
# Copyright (c) 2023 Cryptography Research, Inc. (CRI).
# A license or authorization from CRI is needed to use this file.
#

menu "Library for stateful hash-based signatures"

config CMRT_SHSIG_LIBRARY
	bool
	default n
	prompt "Build shsig library"
	help
	  Build a stateful hash-based signatures library.

config CMRT_SHSIG_LMS
	bool "Enable LMS"
	default n
	depends on CMRT_SHSIG_LIBRARY
	help
	  Enable Leighton-Micali-Signature (LMS) hash-based signature
	  scheme operations

config CMRT_SHSIG_LMS_HSS
	bool "Enable LMS-HSS"
	default n
	depends on CMRT_SHSIG_LIBRARY
	select CMRT_SHSIG_LMS
	help
	  Enable Leighton-Micali-Signature (LMS) Hierarchical Signature System
	  (HSS) hash-based signature scheme operations

config CMRT_SHSIG_XMSS
	bool "Enable XMSS"
	default n
	depends on CMRT_SHSIG_LIBRARY
	help
	  Enable eXtended Merkle Signature Scheme (XMSS) operations

config CMRT_SHSIG_XMSS_ENABLE_ALL_MODES
	bool "Enable support for all xmss modes"
	default n if CMRT_FBOOT
	default n
	depends on CMRT_SHSIG_LIBRARY
	help
	  Limits amount of modes and stack usage for xmss operations.
	  Without this option only sha2-256 modes are available.
	  When enabled, sha2-512, shake256, shake512 modes can be used.

config CMRT_SHSIG_XMSS_MT
	bool "Enable XMSS-MT"
	default n
	depends on CMRT_SHSIG_LIBRARY
	select CMRT_SHSIG_XMSS
	help
	  Enable a multi-tree variant of XMSS operations

endmenu
```

## bootloader/rot/cmrt-zephyr-2.0.36/lib/libucu/Kconfig
```kconfig
# Kconfig - UCU library

#
# Copyright (c) 2022-2023 Cryptography Research, Inc. (CRI).
# A license or authorization from CRI is needed to use this file.
#

menu "Additional libraries"

config CMRT_UCU_LIBRARY
	bool
	default y if CMRT_RSA || CMRT_FBOOT_HAS_RSA_VERIFY
	default n
	prompt "Build ucu library"
	help
	  Build a unified cryptographic utilities library.

config CMRT_ECIES
	bool "Enable Elliptic Curve Integrated Encryption Scheme (ECIES)"
	default n
	select CMRT_AES
	select CMRT_HC
	select CMRT_PKE
	help
	  Enable Elliptic Curve Integrated Encryption Scheme (ECIES) operations

endmenu
```

## bootloader/rot/cmrt-zephyr-2.0.36/soc/riscv/riscv-privilege/cmrt/Kconfig.defconfig.series
```kconfig
# Copyright (c) 2022-2023 Cryptography Research, Inc. (CRI)

if SOC_SERIES_RISCV_CMRT

config SOC_SERIES
	default "cmrt"

config SYS_CLOCK_HW_CYCLES_PER_SEC
	default 4000000

config RISCV_SOC_INTERRUPT_INIT
	default y

config RISCV_HAS_CPU_IDLE
	default y

config RISCV_HAS_PLIC
	default y

config RISCV_HAS_SLIC
	default y if CMRT_SIC || CMRT_SIC2

config RISCV_HAS_AXI
	default y if ETH_XAXIDMA

config RISCV_GP
	default y if !CMRT_FBOOT

config 2ND_LVL_ISR_TBL_OFFSET
	default 12

config NUM_2ND_LEVEL_AGGREGATORS
	default 2

config 2ND_LVL_INTR_00_OFFSET
	default 11 # MEI

config 2ND_LVL_INTR_01_OFFSET
	default 9 # SEI

config 3RD_LVL_ISR_TBL_OFFSET
	default 24

config 3RD_LVL_INTR_00_OFFSET
	default 5 # SIC IRQ + 1

config 4TH_LVL_ISR_TBL_OFFSET
	default 56

config 4TH_LVL_INTR_00_OFFSET
	default 6 # AXI_INTC_IRQ + 1

config MAX_IRQ_PER_AGGREGATOR
	default 32

config NUM_IRQS
	default 64 # 12 RISC-V + 12 CMRT PLIC + 32 SOC IRQS + 8 AXI IRQS

config CRI_OMC_LAYOUT_VERSION
	int
	default $(dt_node_int_prop_int,/soc/omc@40000,layout-version)

config CRI_OMC_KEYSPLITS_NUM
	int
	default $(dt_node_int_prop_int,/soc/omc@40000,num-keysplits)

config CRI_OMC_ROOTS_NUM
	int
	default $(dt_node_int_prop_int,/soc/omc@40000,num-roots)

config CMRT_CFI
	def_bool $(dt_node_has_bool_prop,/cpus/cpu@0,has-cfi)

endif # SOC_SERIES_RISCV_CMRT
```
