## bootloader/rot/cmrt-zephyr-2.0.36/subsys/fs/teefs/Kconfig
```kconfig
# Kconfig - TEEFS and TEEDEV configuration options

#
# Copyright (c) 2019-2021 Cryptography Research, Inc. (CRI).
# A license or authorization from CRI is needed to use this file.
#

config TEEFS
	bool
	prompt "TEEFS Support"
	default n
	help
	  This option enables the TEEFS filesystem.

config TEEFS_MAX_INSTANCES
	int "Max number of TEEFS instances"
	depends on TEEFS
	default 1
	help
	  Defines the maximum number of TEEFS instances. One instance is
	  connected to one device and operates individually. A device is
	  connected to a mount point and needs to be there before TEEFS
	  functions will work.

config TEEFS_MAX_PAGES
	int "Max number of pages in log2"
	depends on TEEFS
	default 15
	help
	  Valid values are 31, 15 and 7 in log2.
	  With value 31 TEEFS can have 1 << 31 pages in a filesystem.
	  With value 15 TEEFS can have 1 << 15 pages in a filesystem.
	  With value 7 TEEFS can have 1 << 7 pages in a filesystem.
	  The smaller the value the more space is saved on each page header.
	  This may have a meaning in small OTP filesystems, for example,
	  where each byte counts. Note that this is common setting for all
	  teefs instances. Select the value depending on your use and your
	  devices.

config TEEFS_MAX_FILES
	int "Max number of TEEFS file descriptors"
	depends on TEEFS
	default 8
	help
	  Defines the maximum number of TEEFS pre-allocated file descriptors.
	  This means the maximum number of open files at once for all TEEFS
	  instances. File descriptors do not take much memory.

config TEEFS_MAX_DIRS
	int "Max number of TEEFS directory descriptors"
	depends on TEEFS
	default 1
	help
	  Defines the maximum number of pre-allocated TEEFS directory
	  descriptors. This means the maximum number of open directories
	  at once for all TEEFS instances. Directory descriptors are more
	  costly in terms of memory usage.

config TEEFS_MAX_PAGE_SIZE
	int "Max supported page size in log2"
	depends on TEEFS
	default 8
	help
	  Maximum supported page size. This should be tuned to match the
	  largest device page size configuration. TEEFS allocates data
	  structures based on this value.

config TEEFS_MAX_CACHE_PAGES
	int "Max supported number of pages to keep in cache"
	depends on TEEFS
	default 4
	help
	  TEEFS works fine with just one cache page. If there's more memory
	  to spare this can be set larger to reduce the need to read/write
	  pages from/to the disk device. This should be tuned to match the
	  largest device cache pages configuration.

config TEEFS_MAX_BAD_BLOCKS
	int "Reserve for possible bad blocks"
	depends on TEEFS
	default 1
	help
	  Blocks reserved to go around possible contiguous bad blocks.

config TEEFS_MAX_NAMELEN
	int "Maximum length reserved for file names"
	depends on TEEFS
	range 1 255
	default 64
	help
	  Maximum file name length. Default value is 64 which comes from the
	  TEE specification. File name will be truncated if first page cannot
	  fit maximum file name length. This setting should be tuned to fit
	  the smallest filesystem, like an OTP filesystem, where there is
	  no space to spare.

config TEEFS_MULTITHREADING
	bool
	prompt "TEEFS multithreading support"
	default y if MULTITHREADING
	default n
	help
	  Enable multithreading support in the TEEFS filesystem.
```

## bootloader/rot/cmrt-zephyr-2.0.36/subsys/portability/cmrt_v1/Kconfig
```kconfig
# # Copyright (c) 2022-2023 Cryptography Research, Inc. (CRI)

config CMRT_V1
	bool "CMRT v1 API"
	select CMRT_TEEDEV_CRYPTO if TEEFS
	select CMRT_SAC_ACCESS_FIXUP
	select CMRT_ECIES
	select CMRT_FFDH
	help
	  This enables CMRT v1 API support. This is an OS-integration
	  layer which allows applications using CMRT APIs to build on
	  Zephyr.

if CMRT_V1

DT_CHOSEN_OTP := rambus,otp

config RISCV_OTP_BASE_ADDR
	hex
	default $(dt_chosen_reg_addr_hex,$(DT_CHOSEN_OTP))

DT_CHOSEN_SRAM := zephyr,sram

config RISCV_RAM_BASE_ADDR
	hex
	default $(dt_chosen_reg_addr_hex,$(DT_CHOSEN_SRAM))

config RISCV_RAM_SIZE_KB
	int
	default $(dt_chosen_reg_size_int,$(DT_CHOSEN_SRAM),0,K)

DT_CHOSEN_EXTMEM := rambus,extmem

config RISCV_SAC_BASE_ADDR
	hex
	default $(dt_chosen_reg_addr_hex,$(DT_CHOSEN_EXTMEM))

config FPGA_SAC_SIZE
	hex
	default FPGA_EXTMEM_SIZE

config CRI_CMRT
	bool "CRI CMRT drivers"
	default y
	select POLL if MULTITHREADING

config CRI_AES_NAME
	string "Device name for AES"
	default "aes"

config CRI_CC_NAME
	string "Device name for CC"
	default "cc"

config CRI_CCP_NAME
	string "Device name for CCP"
	default "ccp"

config CRI_CSHC_NAME
	string "Device name for CSHC"
	default "cshc"

config CRI_DMAC_NAME
	string "Device name for DMAC"
	default "dmac"

config CRI_EAC_NAME
	string "Device name for EAC"
	default "eac"

config CRI_FMC_NAME
	string "Device name for FMC"
	default "fmc"

config CMRT_S2HC
	bool "Enable SHA2 Hash Core (S2HC)"
	default y if "$(dt_node_has_label_prop,/soc/hc0@20000,s2hc)"

config CMRT_S2HC2
	bool "Enable second SHA2 Hash Core (S2HC2)"
	default y if "$(dt_node_has_label_prop,/soc/hc3@26000,s2hc)"

config CMRT_S3HC
	bool "Enable SHA3 Hash Core (S3HC)"
	default y if "$(dt_node_has_label_prop,/soc/hc0@20000,s3hc)"

config CMRT_S3HC2
	bool "Enable second SHA3 Hash Core (S3HC2)"
	default y if "$(dt_node_has_label_prop,/soc/hc3@26000,s3hc)"

config CRI_HC_NAME
	string "Device name for HC"
	default "s3hc" if CMRT_S3HC
	default "s2hc"

config CRI_HC2_NAME
	string "Device name for HC2"
	default "s3hc" if CMRT_S3HC2
	default "s2hc"

config CRI_KDC_NAME
	string "Device name for KDC"
	default "kdc"

config CRI_KTC_NAME
	string "Device name for KTC"
	default "ktc"

config CRI_MPU_NAME
	string "Device name for MPU"
	default "mpu"

config CRI_OMC_NAME
	string "Device name for OMC"
	default "omc"

config CRI_PKE_NAME
	string "Device name for PKE"
	default "pke"

config CRI_TMC_NAME
	string "Device name for TMC"
	default "tmc"

config CRI_SAC_NAME
	string "Device name for SAC"
	default "sac"

config CRI_SIC_NAME
	string "Device name for SIC"
	default "sic"

config CRI_SID_NAME
	string "Device name for SID"
	default "sid"

config CRI_WHC_NAME
	string "Device name for WHC"
	default "whc"

config HEXUTIL_LIBRARY
	bool "Build hexutil library"
	default n
	depends on PRINTK

config TEEDEV_DMAC_BLOCK_SIZE
	int "DMAC erase block size in log2"
	depends on CMRT_TEEDEV_DMAC
	default 10

config TEEDEV_DMAC_PAGE_SIZE
	int "DMAC write page size in log2"
	depends on CMRT_TEEDEV_DMAC
	default 8

config TEEDEV_DMAC_CACHE_PAGES
	int "Number of pages to keep in cache"
	depends on CMRT_TEEDEV_DMAC
	default 1

config TEEDEV_FLASH_BLOCK_SIZE
	int "FLASH erase block size in log2"
	depends on CMRT_TEEDEV_FLASH
	default 12

config TEEDEV_FLASH_PAGE_SIZE
	int "FLASH write page size in log2"
	depends on CMRT_TEEDEV_FLASH
	default 8

config TEEDEV_FLASH_CACHE_PAGES
	int "Number of pages to keep in cache"
	depends on CMRT_TEEDEV_FLASH
	default 4

config CMRT_TEEDEV_RAM
	bool "TEEDEV RAM support"
	default n

config TEEDEV_RAM_BLOCK_SIZE
	int "RAM erase block size in log2"
	depends on CMRT_TEEDEV_RAM
	default 10

config TEEDEV_RAM_PAGE_SIZE
	int "RAM write page size in log2"
	depends on CMRT_TEEDEV_RAM
	default 8

config TEEDEV_RAM_CACHE_PAGES
	int "Number of pages to keep in cache"
	depends on CMRT_TEEDEV_RAM
	default 1

config TEEDEV_OTP_BLOCK_SIZE
	int "OTP erase block size in log2"
	depends on CMRT_TEEDEV_OTP
	default 7

config TEEDEV_OTP_PAGE_SIZE
	int "OTP write page size in log2"
	depends on CMRT_TEEDEV_OTP
	default 6

config TEEDEV_OTP_CACHE_PAGES
	int "Number of pages to keep in cache"
	depends on CMRT_TEEDEV_OTP
	default 2

config CRI_FBOOT
       bool
       default y if CMRT_FBOOT
       default n

config CRI_FIPS_140_MODE
       bool
       default y if CMRT_FIPS_140_MODE
       default n

config CRI_SIC_INSTANCES
	int "Number of SIC instances"
	default $(dt_node_int_prop_int,/soc/sic@1000,num-instances)

config CMRT_AES_192BIT
       bool "Enable AES 192bit keys"
       default $(dt_node_has_bool_prop,/soc/aes@10000,has-192)

endif
```

## osl/zephyr/boards/arm64/rebel_h/Kconfig.board
```kconfig
# Copyright (c) 2024 Samsung Electronics Co., Ltd.
# SPDX-License-Identifier: Apache-2.0

config BOARD_REBEL_H
	bool "Cortex AArch64 CA73 REBEL_H board"
	depends on SOC_REBEL_H
	select ARM64
```

## osl/zephyr/boards/arm64/rebel_h/Kconfig.defconfig
```kconfig
# Copyright (c) 2024 Samsung Electronics Co., Ltd.
# SPDX-License-Identifier: Apache-2.0

if BOARD_REBEL_H

config BUILD_OUTPUT_BIN
	default y

config BOARD
	default "rebel_h"

endif # BOARD_REBEL_H
```

## osl/zephyr/boards/arm64/rebel_h/rebel_h_defconfig
```kconfig
# Copyright (c) 2024 Samsung Electronics Co., Ltd.
# SPDX-License-Identifier: Apache-2.0

# Arch/Core level
CONFIG_SOC_REBEL_H=y
CONFIG_ARM_MMU=y
CONFIG_ARM64_PA_BITS_48=y
CONFIG_ARM64_VA_BITS_48=y
CONFIG_MAX_XLAT_TABLES=32

# SOC/System level
CONFIG_BOARD_REBEL_H=y
CONFIG_ARM_ARCH_TIMER=y
CONFIG_ARMV8_A_NS=y

# Board level
# Enable UART driver
CONFIG_SERIAL=y

# Enable console
CONFIG_CONSOLE=y
CONFIG_UART_CONSOLE=y

# Debug
CONFIG_OUTPUT_DISASSEMBLY=y
CONFIG_OUTPUT_SYMBOLS=y

CONFIG_KERNEL_BIN_NAME="rebel_h.zephyr"
```

## osl/zephyr/soc/arm64/rebel_h/Kconfig.defconfig
```kconfig
# Copyright (c) 2024 Samsung Electronics Co., Ltd.
# SPDX-License-Identifier: Apache-2.0

if SOC_REBEL_H

config SOC
	default "rebel_h"

config NUM_IRQS
	default 991

config SYS_CLOCK_HW_CYCLES_PER_SEC
	default 500000000

# Workaround for not being able to have commas in macro arguments
DT_CHOSEN_Z_FLASH := zephyr,flash

config FLASH_SIZE
	default $(dt_chosen_reg_size_int,$(DT_CHOSEN_Z_FLASH),0,K)

config FLASH_BASE_ADDRESS
	default $(dt_chosen_reg_addr_hex,$(DT_CHOSEN_Z_FLASH))

endif # SOC_QEMU_VIRT_ARM64
```

## osl/zephyr/soc/arm64/rebel_h/Kconfig.soc
```kconfig
# Copyright (c) 2024 Samsung Electronics Co., Ltd.
# SPDX-License-Identifier: Apache-2.0

config SOC_REBEL_H
	bool "REBEL_H platform (AArch64)"
	select ARM64
	select CPU_CORTEX_A
	select ARMV8_A
```
