## bootloader/rot/cmrt-zephyr-2.0.36/drivers/ethernet/Kconfig.xaxidma
```kconfig
# Kconfig - ETX_XAXIDMA configuration options

#
# Copyright (c) 2020-2023 Cryptography Research, Inc. (CRI).
# A license or authorization from CRI is needed to use this file.
#

menuconfig ETH_XAXIDMA
	bool "Enable Xilinx AXI Ethernet driver."
	help
	  Xilinx AXI Ethernet driver with AXI DMA and AXI Intc.

if ETH_XAXIDMA

# Hidden option
config ETH_NIC_MODEL
	string
	default "xlnx.axi-ethernet"
	help
	  Tells what Qemu network model to use. This value is given as
	  a parameter to -nic qemu command line option.

config ETH_XAXIDMA_COALESCE_COUNT
	int "Interrupt coalesce count"
	default 1
	range 1 255
	help
	  Interrupt coalesce count is the number of packets that cause an
	  interrupt to happen. On busy networks setting larger value may
	  reduce interrupt load in the expence of latency.

config ETH_XAXIDMA_COALESCE_DELAY
	int "Interrupt coalesce delay"
	default 0
	range 0 255
	help
	  Interrupt coalesce delay is used to generate interrupts even if the
	  coalesce count is not yet reached. On busy networks setting larger
	  value may reduce interrupt load in the expence of latency.
	  Timer unit is 125 x AXI clock period. Set to non zero value if
	  interrupt coalesce count is set to larger than 1.

config ETH_XAXIDMA_DMAC_COPY
	bool "Use DMAC to copy data"
	depends on CMRT_DMAC
	default y
	help
	  Use DMAC to copy data between SRAM and DRAM. Using DMAC is preferable
	  in systems with slow DRAM interface because the main CPU is then not
	  blocked by the data copy.

config ETH_XAXIDMA_DMAC_THRESHOLD
	int "Use DMAC only for larger packets"
	depends on ETH_XAXIDMA_DMAC_COPY
	default 64
	range 0 1522
	help
	  A DMAC threshold can be defined because setting up DMAC requires
	  time on its own. Copying smaller packets without DMAC may be faster.

config ETH_XAXIDMA_0
	bool "Ethernet port 0"
	default y
	help
	  Include port 0 driver. Select by default because we only have one
	  instance at the moment.

endif
```

## bootloader/rot/cmrt-zephyr-2.0.36/drivers/interrupt_controller/Kconfig
```kconfig
# interrupt controller configuration options

# Copyright (c) 2015 Intel Corporation
# SPDX-License-Identifier: Apache-2.0

menu "Interrupt Controllers"

config ARCV2_INTERRUPT_UNIT
	bool "ARCv2 Interrupt Unit"
	default y
	depends on ARC
	help
	  The ARCv2 interrupt unit has 16 allocated exceptions associated with
	  vectors 0 to 15 and 240 interrupts associated with vectors 16 to 255.
	  The interrupt unit is optional in the ARCv2-based processors. When
	  building a processor, you can configure the processor to include an
	  interrupt unit. The ARCv2 interrupt unit is highly programmable.

config PLIC
	bool "Platform Level Interrupt Controller (PLIC)"
	default y
	depends on RISCV_HAS_PLIC && !SOC_SERIES_RISCV_CMRT
	select MULTI_LEVEL_INTERRUPTS
	select 2ND_LEVEL_INTERRUPTS
	help
	  Platform Level Interrupt Controller provides support
	  for external interrupt lines defined by the RISC-V SoC;

config SWERV_PIC
	bool "SweRV EH1 Programmable Interrupt Controller (PIC)"
	default n
	help
	  Programmable Interrupt Controller for the SweRV EH1 RISC-V CPU;

config VEXRISCV_LITEX_IRQ
	bool "VexRiscv LiteX Interrupt controller"
	depends on SOC_RISCV32_LITEX_VEXRISCV
	help
	  IRQ implementation for LiteX VexRiscv

config LEON_IRQMP
	bool "GRLIB IRQMP interrupt controller"
	default y
	depends on SOC_SPARC_LEON
	help
	  GRLIB IRQMP and IRQAMP

config CMRT_PLIC
	bool "Platform Level Interrupt Controller (PLIC)"
	default y
	depends on RISCV_HAS_PLIC && SOC_SERIES_RISCV_CMRT
	select MULTI_LEVEL_INTERRUPTS
	select 2ND_LEVEL_INTERRUPTS
	help
	  Platform Level Interrupt Controller provides support
	  for external interrupt lines defined by the CMRT SoC.

config CMRT_SLIC
	bool "SoC Level Interrupt Controller (SLIC)"
	default y
	depends on RISCV_HAS_SLIC
	select 3RD_LEVEL_INTERRUPTS
	help
	  SoC Level Interrupt Controller provides support
	  for external interrupt lines terminating to CMRT SIC.

config CMRT_AXI
	bool "CMRT AXI Level Interrupt Controller (AXI)"
	default y
	depends on RISCV_HAS_AXI
	select 4TH_LEVEL_INTERRUPTS
	help
	  AXI Level Interrupt Controller provides support
	  for external interrupt lines for Xilinx AXI devices.

source "drivers/interrupt_controller/Kconfig.multilevel"

source "drivers/interrupt_controller/Kconfig.loapic"

source "drivers/interrupt_controller/Kconfig.dw"

source "drivers/interrupt_controller/Kconfig.it8xxx2"

source "drivers/interrupt_controller/Kconfig.stm32"

source "drivers/interrupt_controller/Kconfig.cavs"

source "drivers/interrupt_controller/Kconfig.rv32m1"

source "drivers/interrupt_controller/Kconfig.sam0"

source "drivers/interrupt_controller/Kconfig.gic"

source "drivers/interrupt_controller/Kconfig.npcx"

source "drivers/interrupt_controller/Kconfig.intel_vtd"

source "drivers/interrupt_controller/Kconfig.esp32"

source "drivers/interrupt_controller/Kconfig.xec"

endmenu
```

## bootloader/rot/cmrt-zephyr-2.0.36/drivers/misc/pvt_con/Kconfig
```kconfig
config PVT_SAMSUNG
	bool "Process Voltage Temperature (PVT) SAMSUNG driver"
	help
	  Driver for Samsung PVT
```

## bootloader/rot/cmrt-zephyr-2.0.36/drivers/otp/Kconfig
```kconfig
# OTPC_NONSEC configuration options

config OTP_SAMSUNG
	bool "OTP Drivers"
	default y
```

## bootloader/rot/cmrt-zephyr-2.0.36/drivers/watchdog/Kconfig.cmrt
```kconfig
# Kconfig - CMRT watchdog configuration
#
# Copyright (c) 2017-2022 Cryptography Research, Inc. (CRI).

if SOC_SERIES_RISCV_CMRT

config WDT_CMRT
	bool "Watchdog Driver for CMRT"
	default y
	help
	  Enable watchdog Driver for CMRT.

endif
```

## bootloader/rot/cmrt-zephyr-2.0.36/dts/bindings/cmrt/rambus,cmrt-aes.yaml
```yaml
# Copyright (c) 2022-2023 Cryptography Research, Inc. (CRI)

description: CMRT AES Core (AES)

compatible: "rambus,cmrt-aes"

include: rambus,cmrt-hwc.yaml

properties:
    has-cmac:
      required: false
      type: boolean
      description: flag to support cmac mode

    has-xts:
      required: false
      type: boolean
      description: flag to support xts mode

    has-ccm:
      required: false
      type: boolean
      description: flag to support ccm mode

    has-192:
      required: false
      type: boolean
      description: flag to support 192bit keys
```

## bootloader/rot/cmrt-zephyr-2.0.36/dts/bindings/cmrt/rambus,cmrt-cc.yaml
```yaml
# Copyright (c) 2022-2023 Cryptography Research, Inc. (CRI)

description: CMRT Canary Core

compatible: "rambus,cmrt-cc"

include: rambus,cmrt-hwc.yaml
```

## bootloader/rot/cmrt-zephyr-2.0.36/dts/bindings/cmrt/rambus,cmrt-ccp.yaml
```yaml
# Copyright (c) 2022-2023 Cryptography Research, Inc. (CRI)

description: CMRT CCP Core (CCP)

compatible: "rambus,cmrt-ccp"

include: rambus,cmrt-hwc.yaml
```

## bootloader/rot/cmrt-zephyr-2.0.36/dts/bindings/cmrt/rambus,cmrt-clint.yaml
```yaml
# Copyright (c) 2022-2023 Cryptography Research, Inc. (CRI)

description: CMRT Core-Local interruptor

compatible: "rambus,cmrt-clint"

include: riscv,clint0.yaml

properties:
    wdt-hw-start:
      required: false
      type: boolean
      description: Watchdog is started by HW
```

## bootloader/rot/cmrt-zephyr-2.0.36/dts/bindings/cmrt/rambus,cmrt-dmac.yaml
```yaml
# Copyright (c) 2022-2023 Cryptography Research, Inc. (CRI)

description: CMRT DMA Core

compatible: "rambus,cmrt-dmac"

include: rambus,cmrt-hwc.yaml
```

## bootloader/rot/cmrt-zephyr-2.0.36/dts/bindings/cmrt/rambus,cmrt-eac.yaml
```yaml
# Copyright (c) 2022-2023 Cryptography Research, Inc. (CRI)

description: CMRT Error Aggregator Core

compatible: "rambus,cmrt-eac"

include: rambus,cmrt-hwc.yaml
```

## bootloader/rot/cmrt-zephyr-2.0.36/dts/bindings/cmrt/rambus,cmrt-emc.yaml
```yaml
# Copyright (c) 2022-2023 Cryptography Research, Inc. (CRI)

description: CMRT Entropy Management Core (EMC)

compatible: "rambus,cmrt-emc"

include: rambus,cmrt-hwc.yaml
```

## bootloader/rot/cmrt-zephyr-2.0.36/dts/bindings/cmrt/rambus,cmrt-fmc.yaml
```yaml
# Copyright (c) 2022-2023 Cryptography Research, Inc. (CRI)

description: CMRT Feature Management Core (FMC)

compatible: "rambus,cmrt-fmc"

include: rambus,cmrt-hwc.yaml

properties:
    tdv-size:
      required: true
      type: int
      description: test and debug vector size in words

    feature-size:
      required: true
      type: int
      description: internal feature space size in words
```

## bootloader/rot/cmrt-zephyr-2.0.36/dts/bindings/cmrt/rambus,cmrt-hc.yaml
```yaml
# Copyright (c) 2022-2023 Cryptography Research, Inc. (CRI)

description: CMRT Hash Core (HC)

compatible: "rambus,cmrt-hc"

include: rambus,cmrt-hwc.yaml

properties:
    has-shake128:
      required: false
      type: boolean
      description: flag to support shake128

    has-shake256:
      required: false
      type: boolean
      description: flag to support shake256

    shake-hw-padding:
      required: false
      type: boolean
      description: flag to support HW padding for shake

    has-sha-224:
      required: false
      type: boolean
      description: flag to support sha2-224

    has-sha-256:
      required: false
      type: boolean
      description: flag to support sha2-256

    has-sha-384:
      required: false
      type: boolean
      description: flag to support sha2-384

    has-sha-512:
      required: false
      type: boolean
      description: flag to support sha2-512

    has-sha-512-224:
      required: false
      type: boolean
      description: flag to support sha2-512-224

    has-sha-512-256:
      required: false
      type: boolean
      description: flag to support sha2-512-256

    has-hmac:
      required: false
      type: boolean
      description: flag to support HMAC

    has-sha3-224:
      required: false
      type: boolean
      description: flag to support sha3-224

    has-sha3-256:
      required: false
      type: boolean
      description: flag to support sha3-256

    has-sha3-384:
      required: false
      type: boolean
      description: flag to support sha3-384

    has-sha3-512:
      required: false
      type: boolean
      description: flag to support sha3-512
```

## bootloader/rot/cmrt-zephyr-2.0.36/dts/bindings/cmrt/rambus,cmrt-hs_aes.yaml
```yaml
# Copyright (c) 2023 Cryptography Research, Inc. (CRI)

description: CMRT HS AES Core

compatible: "rambus,cmrt-hs_aes"

include: rambus,cmrt-hwc.yaml
```

## bootloader/rot/cmrt-zephyr-2.0.36/dts/bindings/cmrt/rambus,cmrt-hwc.yaml
```yaml
# Copyright (c) 2022-2023 Cryptography Research, Inc. (CRI)

description: Generic CMRT HW Core

compatible: "rambus,cmrt-hwc"

include: base.yaml

properties:
    reg:
      required: true

    label:
      required: true
```

## bootloader/rot/cmrt-zephyr-2.0.36/dts/bindings/cmrt/rambus,cmrt-kdc.yaml
```yaml
# Copyright (c) 2022-2023 Cryptography Research, Inc. (CRI)

description: CMRT Key Derivation Core (KDC)

compatible: "rambus,cmrt-kdc"

include: rambus,cmrt-hwc.yaml
```

## bootloader/rot/cmrt-zephyr-2.0.36/dts/bindings/cmrt/rambus,cmrt-ktc.yaml
```yaml
# Copyright (c) 2022-2023 Cryptography Research, Inc. (CRI)

description: CMRT Key Transport Core (KDC)

compatible: "rambus,cmrt-ktc"

include: rambus,cmrt-hwc.yaml
```

## bootloader/rot/cmrt-zephyr-2.0.36/dts/bindings/cmrt/rambus,cmrt-maui.yaml
```yaml
# Copyright (c) 2022-2023 Cryptography Research, Inc. (CRI)

description: CMRT RISC-V CPU (Maui)

compatible: "rambus,cmrt-maui"

include: riscv,cpus.yaml

properties:
    has-cfi:
      required: false
      type: boolean
      description: CPU enforces control flow integrity

    embedded:
      required: false
      type: boolean
      description: CPU implements (only) RV32E instruction set
```

## bootloader/rot/cmrt-zephyr-2.0.36/dts/bindings/cmrt/rambus,cmrt-omc.yaml
```yaml
# Copyright (c) 2022-2023 Cryptography Research, Inc. (CRI)

description: CMRT OTP Memory Controller (OMC)

compatible: "rambus,cmrt-omc"

include: rambus,cmrt-hwc.yaml

properties:
    layout-version:
      required: true
      type: int
      description: supported hardware layout version

    num-keysplits:
      required: true
      type: int
      description: number of keysplits supported by hardware

    num-roots:
      required: true
      type: int
      description: number of roots supported by hardware
```
