## CMakeLists.txt
```
# Copyright (c) 2017-2023 Cryptography Research, Inc. (CRI).

cmake_minimum_required(VERSION 3.20.0)

find_package(Zephyr REQUIRED HINTS $ENV{ZEPHYR_BASE})
project(perso)

add_definitions(-DPERSO_VERSION_INFO="${PERSO_VERSION_INFO}")

target_include_directories(app PRIVATE ${ZEPHYR_BASE}/kernel/include ${ZEPHYR_BASE}/samples/cmrt/fboot/include ${ZEPHYR_BASE}/samples/cmrt/fboot/src)
target_sources(app PRIVATE src/main.c ../../fboot/src/lifecycle.c ../../fboot/src/fboot.c ../../fboot/src/img.c ../../fboot/src/syscalls.c ../../fboot/src/supervisor.c ../../fboot/src/supervisor.S ../../fboot/src/isr.S)
target_sources_ifdef(CONFIG_CMRT_DATASTORE app PRIVATE ../../fboot/src/datastore.c)
target_sources_ifdef(CONFIG_CMRT_CFI app PRIVATE ../../fboot/src/cfi.c)
target_sources_ifdef(CONFIG_CMRT_FBOOT_HAS_RSA_VERIFY app PRIVATE ../../fboot/src/fboot_rsa_verify.c)
target_sources_ifdef(CONFIG_CMRT_FBOOT_HAS_LMS_VERIFY app PRIVATE ../../fboot/src/fboot_lms_verify.c)
target_sources_ifdef(CONFIG_CMRT_FBOOT_HAS_LMS_HSS_VERIFY app PRIVATE ../../fboot/src/fboot_lms_hss_verify.c)
target_sources_ifdef(CONFIG_CMRT_FBOOT_HAS_XMSS_VERIFY app PRIVATE ../../fboot/src/fboot_xmss_verify.c)
```

## Kconfig
```
../../fboot/Kconfig
```

## prj.conf
```kconfig
../../fboot/prj.conf
```

## src/main.c
```c
/*
 * Copyright (c) 2018-2023 Cryptography Research, Inc. (CRI).
 * A license or authorization from CRI is needed to use this file.
 */

#include <fboot.h>
#ifdef CONFIG_CMRT_CFI
#include <drivers/cmrt/util.h>
#endif

#include <logging/log.h>
LOG_MODULE_DECLARE(cmrt, CONFIG_CMRT_LOG_LEVEL);

#define PERSO_STATUS_STARTED  0x930100ff
#define PERSO_STATUS_DONE     0x93010000
#define PERSO_STATUS_ERROR    0x93010100

const static char version_info[] __version = PERSO_VERSION_INFO;

int main(void)
{
	cmrt_set_boot_status(CONTAINER_RUNNING_ID, CONTAINER_RUNNING_ID);
	uint32_t lifecycle = cmrt_read_reg(CMRT_SIC_BASE, R_SCRATCH_0);
	if (lifecycle == 0 || lifecycle == 0xffffffff) {
	    lifecycle = DLC_TESTED;
	}
	cmrt_set_perso_status(PERSO_STATUS_STARTED);
	LOG_INF("Blank perso %s starting up", version_info);

	int res;
#ifdef CONFIG_CMRT_OMC_EMULATED_OTP_INIT
	res = cmrt_init_oec_version();
	if (res) goto out;
#endif
#ifdef CONFIG_CMRT_CFI
	res = cmrt_burn_dgok();
	if (res) goto out;
#endif
	res = cmrt_set_lifecycle(lifecycle);
	if (res) goto out;

	LOG_INF("All done for blank perso");
 out:
	cmrt_set_boot_status(0, CONTAINER_RUNNING_ID);
	cmrt_set_perso_status((res < 0) ? PERSO_STATUS_ERROR : PERSO_STATUS_DONE);

	return res;
}
```
