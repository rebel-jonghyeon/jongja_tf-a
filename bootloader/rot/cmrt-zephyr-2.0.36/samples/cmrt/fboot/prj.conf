## Kconfig
```
# Copyright (c) 2023 Cryptography Research, Inc. (CRI)

mainmenu "FBOOT Options"

config MAIN_STACK_SIZE
       default 13824 if CMRT_SHSIG_XMSS_ENABLE_ALL_MODES
       default 8192 if CMRT_CALIPTRA_SUPPORT
       default 8192 if CMRT_FBOOT_HAS_LMS_VERIFY || CMRT_FBOOT_HAS_LMS_HSS_VERIFY || CMRT_FBOOT_HAS_XMSS_VERIFY || CMRT_FBOOT_HAS_XMSS_MT_VERIFY
       default 2032

config HEAP_MEM_POOL_SIZE
       default 5120 if CMRT_CALIPTRA_SUPPORT

source "Kconfig.zephyr"
```

## prj.conf
```kconfig
CONFIG_MULTITHREADING=n
CONFIG_CMRT_FBOOT=y
CONFIG_XIP=y
# make it possible to change clock frequency in sboot
CONFIG_TIMER_READS_ITS_FREQUENCY_AT_RUNTIME=y
# make RELEASE_BUILD=1 unsets these
CONFIG_LOG=y
CONFIG_LOG_MODE_MINIMAL=y
CONFIG_LOG_DEFAULT_LEVEL=4
CONFIG_DEBUG=y
```

## include/fboot.h
```c
/*
 * Copyright (c) 2017-2023 Cryptography Research, Inc. (CRI)
 * A license or authorization from CRI is needed to use this file.
 */

#ifndef FBOOT_API_H
#define FBOOT_API_H

/*
 * Fboot API for machine mode development (sboot, tboot, perso).
 */

#include <zephyr.h>
#include <device.h>
#include <sys/util.h>

#include <drivers/cmrt/cmrt.h>
#include <drivers/cmrt/dd.h>
#include <drivers/cmrt/sic.h>
#include <drivers/cmrt/hc.h>
#include <drivers/cmrt/omc.h>
#include <drivers/cmrt/dmac.h>
#include <drivers/cmrt/sac.h>
#include <drivers/cmrt/kdc.h>
#include <drivers/cmrt/ktc.h>
#ifdef CONFIG_CMRT_PKE
#include <drivers/cmrt/pke.h>
#endif
#ifdef CONFIG_CMRT_ENCRYPTED_IMAGE_SUPPORT
#include <drivers/cmrt/aes.h>
#endif
#ifdef CONFIG_CMRT_PMU
#include <drivers/cmrt/pmu.h>
#endif
#include <drivers/cmrt/fmc.h>
#include <drivers/cmrt/eac.h>
#include <drivers/cmrt/cc.h>
#include <drivers/cmrt/util.h>

#include <stdalign.h>
#include <string.h>
#include <errno.h>
#include <stdint.h>
#include <stdbool.h>

#include <cmrt/fboot/fboot_config.h>
#include <cmrt/fboot/img_format.h>

/**
 * @brief Halt the CPU.
 *
 * Set error register and print debug message to the console.
 *
 * @param major Major error code.
 * @param minor Minor error code.
 * @param fmt Format string.
 *
 * @ingroup FBOOT_API
 */
#define halt(major, minor, fmt, ...) do { LOG_ERR(fmt, ##__VA_ARGS__); cmrt_eac_halt(CORE_ID_CPU, major, minor); } while (0)

/**
 * @brief Word aligned, timing constant, secure memory compare.
 *
 * Can use the Canary Core for glitch protection.
 * Will return a mismatch if pointers or size are not word aligned.
 *
 * @param cc Canary Core context or null if not used.
 * @param s1 Word array to compare.
 * @param s2 Word array to compare.
 * @param n Number of bytes to compare.
 * @return True for matching arrays, false otherwise.
 *
 * @ingroup FBOOT_API
 */
bool fboot_memmatch(cmrt_cc_t cc, const void *s1, const void *s2, size_t n);

/**
 * @brief Generic function to calculate any supported digest.
 *
 * Will close the Hash Core context given as parameter or created internally.
 * Everything needs to be word aligned.
 *
 * @param hc Hash Core context or null to create one internally.
 * @param algo Hash algorithm, see hc.h for values.
 * @param data Data to hash.
 * @param size Size of data.
 * @param digest Buffer for returned digest, length depends on algorithm.
 * @return Zero on success, -ERRNO on error.
 *
 * @ingroup FBOOT_API
 */
int fboot_hash(cmrt_hc_t hc, cmrt_hash_algo_t algo, const void *data, size_t size, void *digest);

/**
 * @brief Generic function to calculate digest on two data areas.
 *
 * Will close the Hash Core context given as parameter or created internally.
 * Everything needs to be word aligned.
 *
 * @param hc Hash Core context or null to create one internally.
 * @param algo Hash algorithm, see hc.h for values.
 * @param data1 First data to hash.
 * @param size1 Size of the first data.
 * @param data2 Second data to hash.
 * @param size2 Size of the second data.
 * @param digest Buffer for returned digest, length depends on algorithm.
 * @return Zero on success, -ERRNO on error.
 *
 * @ingroup FBOOT_API
 */
int fboot_hash2(cmrt_hc_t hc, cmrt_hash_algo_t algo, const void *data1, size_t size1, const void *data2, size_t size2, void *digest);

/**
 * @brief Calculate digest for image and footer.
 *
 * Calculate requested algo hash for image and footer.
 * Everything needs to be word aligned.
 *
 * @param hc Hash Core context or null to create one internally.
 * @param algo Hash algorithm, see hc.h for values.
 * @param blob Start of image blob.
 * @param size Size of the image blob.
 * @param footer Start of image footer.
 * @param digest Buffer for returned digest, length depends on algorithm.
 * @return Zero on success, -ERRNO on error.
 *
 * @ingroup FBOOT_API
 */
int img_digest(cmrt_hc_t hc, cmrt_hash_algo_t algo, const void *blob, size_t size, const cmrt_img_footer_t *footer, void *digest);

/**
 * @brief Verify ECDSA signed image.
 *
 * Verify an ECDSA-P256 signed boot stage image.
 *
 * @param cc Device context to Canary core.
 * @param blob Pointer to image blob.
 * @param size Size of image blob.
 * @param pkhash Hash digest for verifying image.
 * @param footer Pointer to image footer.
 * @return Zero on success or -ERRNO on error.
 *
 * @ingroup FBOOT_API
 */
int fboot_verify_sig(cmrt_cc_t cc, const void *blob, size_t size, const void *pkhash, const cmrt_img_footer_t *footer);

/**
 * @brief Verify HMAC signed image.
 *
 * Verify an HMAC-SHA256 signed boot stage image.
 *
 * @param cc Device context to Canary core.
 * @param blob Pointer to image blob.
 * @param size Size of image blob.
 * @param pkhash Hash digest for verifying image.
 * @param footer Pointer to image footer.
 * @return Zero on success or -ERRNO on error.
 *
 * @ingroup FBOOT_API
 */
int fboot_verify_hmac(cmrt_cc_t cc, const void *blob, size_t size, const void *pkhash, const cmrt_img_footer_t *footer);

/**
 * @brief Verify RSA signed image.
 *
 * Verify an RSA signed boot stage image.
 *
 * @param cc Device context to Canary core.
 * @param pklen Modulus + exponent in bytes.
 * @param pub Public RSA key (modulus + exponent).
 * @param digest SHA3-512 digest of loaded image.
 * @param signature Image signature from footer.
 * @return Zero on success or -ERRNO on error.
 *
 * @ingroup FBOOT_API
 */
int fboot_verify_rsa(cmrt_cc_t cc, uint32_t pklen, uint32_t *pub, const uint32_t *digest, uint32_t *signature);

/**
 * @brief Verify LMS signed image.
 *
 * Verify an LMS signed boot stage image.
 *
 * @param cc Device context to Canary core.
 * @param pk Public key, contains type, otstype, I, root_hash.
 * @param digest Digest of loaded image.
 * @param dlen Digest length of loaded image.
 * @param signature Image signature from footer.
 * @return Zero on success or -ERRNO on error.
 *
 * @ingroup FBOOT_API
 */
int fboot_verify_lms(cmrt_cc_t cc, const uint8_t *pk, const uint8_t *digest, size_t dlen, const uint8_t *signature);

/**
 * @brief Verify LMS-HSS signed image.
 *
 * Verify an LMS-HSS signed boot stage image.
 *
 * @param cc Device context to Canary core.
 * @param pk Public key, contains type, otstype, I, root_hash.
 * @param digest Digest of loaded image.
 * @param dlen Digest length of loaded image.
 * @param signature Image signature from footer.
 * @return Zero on success or -ERRNO on error.
 *
 * @ingroup FBOOT_API
 */
int fboot_verify_lms_hss(cmrt_cc_t cc, const uint8_t *pk, const uint8_t *digest, size_t dlen, const uint8_t *signature);

/**
 * @brief Verify XMSS or XMSS^MT signed image.
 *
 * Verify an XMSS or XMSS^MT signed boot stage image.
 *
 * @param cc Device context to Canary core.
 * @param blob Pointer to image blob.
 * @param bsize Size of image blob.
 * @param footer Pointer to image footer.
 * @param digest Buffer for digest of loaded image and footer.
 *               Digest is calculated using algorithm given
 *               by XMSS or XMSS^MT mode from footer, max size 64B.
 * @param dsize Digest buffer size.
 * @return Zero on success or -ERRNO on error.
 *
 * @ingroup FBOOT_API
 */
int fboot_verify_xmss(cmrt_cc_t cc, const void *blob, size_t bsize, const cmrt_img_footer_t *footer, uint32_t *digest, size_t dsize);

/**
 * @brief Verify CID.
 *
 * Verify a container id (CID) from image footer.
 *
 * @param cc Device context to Canary core.
 * @param footer Pointer to image footer.
 * @param pkhash Hash digest for verifying image.
 * @return Zero on success or -ERRNO on error.
 *
 * @ingroup FBOOT_API
 */
int fboot_verify_cid(cmrt_cc_t cc, const cmrt_img_footer_t *footer, const void *pkhash);

/**
 * @brief Set test and debug vector.
 *
 * Test and debug vector is customer specific.
 *
 * @param tdv Array of TDV words.
 * @return Zero on success, -ERRNO on error.
 *
 * @ingroup FBOOT_API
 */
int fboot_set_tdv(const uint32_t tdv[CMRT_FMC_TDV_SIZE]);

/**
 * @brief Set KDC hardware state.
 *
 * KDC hardware state is a machine mode write only register.
 * Bits set cannot be unset. Its value affects key derivations.
 *
 * @param value Value to set.
 * @return Zero on success, -ERRNO on error.
 *
 * @ingroup FBOOT_API
 */
int fboot_kdc_set_hw_state(uint8_t value);

/**
 * @brief Initialize supervisor loading.
 *
 * @return Load address of supervisor image.
 *
 * @ingroup FBOOT_API
 */
uint32_t fboot_supervisor_clear(void);

/**
 * @brief Start optional tboot.
 *
 * Starts tboot is it was first in the supervisor image bundle.
 * Will return back to caller (sboot) for loading the supervisor next.
 *
 * @return Zero on success, -ERRNO on error.
 *
 * @ingroup FBOOT_API
 */
int fboot_tboot_start(void);

/**
 * @brief Make final setup and start supervisor.
 *
 * Configure supervisor environment and start running it. If supervisor is
 * non-silo then the HW security context is cleared, and the first loaded
 * user container sets the root and permissions.
 *
 * If supervisor is a monolithic application then its HW security
 * context will be set according to the footer and respective root.
 *
 * @return No return on success, -ERRNO on error.
 *
 * @ingroup FBOOT_API
 */
int fboot_supervisor_start(void);

/**
 * @brief Return boot bypass vector.
 *
 * @param state CMRT lifecycle state.
 * @return Return boot bypass vector or NULL if it is not set.
 *
 * @ingroup FBOOT_API
 */
void *fboot_bootbypass_vector(uint32_t state);

/**
 * @brief Set fboot permissions (= all permissions).
 *
 * Any error will lead to CMRT halt. Permissions must be cleared
 * by calling cmrt_clear_container_context() before calling this function.
 *
 * @param id Root id for setting the derive path, or NULL to leave it unset.
 * @param init True to initialize security monitor.
 * @return Return OMC driver handle.
 *
 * @ingroup FBOOT_API
 */
cmrt_omc_t fboot_permissions(const cmrt_omc_root_id_t *id, bool init);

#endif
```

## include/sboot.h
```c
/*
 * Copyright (c) 2017-2023 Cryptography Research, Inc. (CRI)
 * A license or authorization from CRI is needed to use this file.
 */

#ifndef FBOOT_SBOOT_H
#define FBOOT_SBOOT_H

/*
 * Sboot API for machine mode development (sboot).
 */

#include <stdint.h>
#include <drivers/cmrt/omc.h>
#include <drivers/cmrt/cmrt.h>
#ifdef CONFIG_WDT_CMRT
extern int wdt_cmrt_feed(const struct device *dev, int channel_id);
#endif

/**
 * Function to copy images from storage.
 *
 * Sboot implementation can override the default image loading function.
 *
 * @param dst Destination to copy the image.
 * @param src Source from where to copy, depends on the storage.
 * @param len Length of the image.
 * @return Zero on success, -ERRNO on error.
 */
extern int sboot_imgcpy(uint32_t dst, uint32_t src, size_t len);

/**
 * Function to load one image.
 *
 * Sboot implementation can override the default image loading function.
 * Will update parameters location and blob.
 *
 * @param location Location to load, depends on the storage.
 * @param blob Address in SRAM to load to.
 * @return Zero on success, -ERRNO on error.
 */
extern int sboot_load_image(uint32_t *location, uint32_t *blob);

/**
 * Function to load supervisor (tboot/autoload) image.
 *
 * Sboot implementation can override the default image loading function.
 *
 * @param location Location to load, depends on the storage.
 * @param blob Address in SRAM to load to.
 * @return Zero on success, -ERRNO on error.
 */
extern int sboot_load_supervisor(uint32_t location, uint32_t blob);

/**
 * Function to load image bundle from given location.
 *
 * Sboot implementation can override the default image loading function.
 *
 * @param location Location to load, depends on the storage.
 * @return Zero on success, -ERRNO on error.
 */
extern int sboot_load_bundle(uint32_t location);

#endif
```

## include/syscalls.h
```c
/*
 * Copyright (c) 2018-2024 Cryptography Research, Inc. (CRI)
 * A license or authorization from CRI is needed to use this file.
 */

#ifndef FBOOT_SYSCALLS_H
#define FBOOT_SYSCALLS_H

/*
 * Fboot syscall API for machine mode development (sboot, tboot, perso).
 */

#include <stdint.h>
#include <stdbool.h>
#include <drivers/cmrt/omc.h>
#include <cmrt/fboot/img_version.h>
#include <cmrt/fboot/datastore_attr.h>

/**
 * @brief Validate image and setup HW security context.
 *
 * Verify supervisor mode access to container image, check image signature and
 * validate container permissions. Container root must exist. If all checks are
 * good then setup HW security context.
 *
 * @param blob Pointer to container image.
 * @param size Size of container image.
 * @param raw Raw footer on return.
 * @param usr User footer on return.
 * @return Image caveat on success, -ERRNO on error.
 *
 * @ingroup FBOOT_API
 */
int fboot_load_image(void *blob, size_t size, cmrt_raw_footer_t *raw, cmrt_usr_footer_t *usr);

/**
 * Establish a new root.
 *
 * When using emulated OTP, AES and HC core must be free.
 *
 * @param index Root table index (allowed values 0-7 for OTP roots).
 * @param new_root New root entry to create.
 * @return Zero on success, -ERRNO on error.
 *
 * @ingroup FBOOT_API
 */
int fboot_create_root(int index, const cmrt_omc_root_t *new_root);

/**
 * Obliterate an existing root.
 *
 * When using emulated OTP, AES and HC core must be free.
 *
 * @param index Root table index (allowed values 0-7 for OTP roots).
 * @return Zero on success, -ERRNO on error.
 *
 * @ingroup FBOOT_API
 */
int fboot_obliterate_root(int index);

/**
 * @brief Call when supervisor exits.
 *
 * Call when supervisor exits due to a trap in essential thread
 * or when HLOS tells it to exit.
 *
 * @param major Reason for exit.
 * @param minor Lower level reason.
 * @return Does not return.
 *
 * @ingroup FBOOT_API
 */
int fboot_halt(int major, int minor);

/**
 * @brief Call to reboot CMRT.
 *
 * Reboot fully reboots and restarts CMRT.
 *
 * @return Does not return.
 *
 * @ingroup FBOOT_API
 */
int fboot_reboot(void);

/**
 * @brief Call to reset CMRT.
 *
 * Reset reboots and restarts CMRT and clears SRAM.
 * Reset can be used to alter the normal startup. For example,
 * sboot could be told to load a secondary image instead of the
 * default image, and supervisor could be told not to autoload a
 * user container. The reset info is application specific.
 *
 * @param info Information for sboot and/or supervisor.
 * @return Does not return.
 */
int fboot_reset(uint32_t info);

/**
 * @brief Get previous reset information.
 *
 * When booting up this function can be called to get the
 * reset information set in a call to fboot_reset.
 * Returns the number of low power events since last reset.
 *
 * @param info Information for sboot and/or supervisor.
 * @return Zero or positive on success, -ERRNO on error.
 */
int fboot_reset_info(uint32_t *info);

/**
 * @brief Get currently running image version string.
 *
 * Version string is set at compile time for each image.
 *
 * @param image Image identifier
 * @param version Version value
 * @param size Version value size
 * @return Zero on success, -ERRNO on error.
 */
int fboot_get_image_version(enum cmrt_image_version_id image, void *version, size_t *size);

/**
 * @brief Get enforced image version in OTP.
 *
 * At boot image footer versions are checked against values in OTP.
 * Value in the image footer must be equal or greater than the value in OTP.
 *
 * @param image Image identifier
 * @param version Pointer to the version value
 * @return Zero on success, -ERRNO on error.
 *
 * @ingroup FBOOT_API
 */
int fboot_get_enforced_version(enum cmrt_enforced_version_id image, uint32_t *version);

/**
 * @brief Set enforced image version in OTP.
 *
 * At boot image footer versions are checked against values in OTP.
 * Value in the image footer must be equal or greater than the value in OTP.
 * Typically these values are set at image upgrades only to prevent booting
 * up to older possibly buggy versions.
 *
 * @param image Image identifier
 * @param version New version value
 * @return Zero on success, -ERRNO on error.
 *
 * @ingroup FBOOT_API
 */
int fboot_set_enforced_version(enum cmrt_enforced_version_id image, uint32_t version);

/**
 * @brief Setup boot bypass when waking up from sleep.
 *
 * Called by the idle thread if PMU support has been enabled. Saves the OS
 * state just before calling WFI. HLOS can command CMRT to sleep, when waking
 * up fboot will restore the OS state and jump back to the idle thread.
 *
 * @param stack Pointer to the boot bypass stack frame.
 * @param function Pointer to the boot bypass function.
 * @return Zero on success, -ERRNO on error.
 */
int fboot_prepare_boot_bypass(const void *stack, const void *function);

/**
 * @brief Read object from security monitor data store.
 *
 * Security monitor data store can be used to pass access controlled
 * objects between CMRT boot stages and applications.
 *
 * Caller must be signed by a root that has read access to the object.
 *
 * @param [in] name Object name can be string or binary.
 * @param [in] namelen Object name length.
 * @param [out] data Object data can be string or binary.
 * @param [in,out] datalen Object data length in return.
 * @param [in] user True if the syscall was relayed by the supervisor.
 * @return Zero on success, -ERRNO on error.
 */
int fboot_data_store_read(const void *name, size_t namelen, void *data, size_t *datalen, bool user);

/**
 * @brief Write or update object in security monitor data store.
 *
 * Security monitor data store can be used to pass access controlled
 * objects between CMRT boot stages and applications.
 *
 * Caller must be signed by a root that has write access to an
 * existing object. New object will be created if the name cannot be found.
 * Default attributes for new object are zero for machine (sboot/tboot) and
 * DS_S_GRANT/DS_U_GRANT for supervisor/user. Call fboot_data_store_grant()
 * to define object visibility.
 *
 * @param [in] name Object name can be string or binary.
 * @param [in] namelen Object name length.
 * @param [in] data Object data can be string or binary.
 * @param [in] datalen Object data length in return.
 * @param [in] user True if the syscall was relayed by the supervisor.
 * @return Zero on success, -ERRNO on error.
 */
int fboot_data_store_write(const void *name, size_t namelen, const void *data, size_t datalen, bool user);

/**
 * @brief Grant or revoke access to object in security monitor data store.
 *
 * Security monitor data store can be used to pass access controlled
 * objects between CMRT boot stages and applications.
 *
 * Caller must be signed by a root that has grant access to the existing
 * object. The object will be removed if it has no access from any root after
 * the operation. Root index values 0 .. CMRT_OTP_NUM_ROOTS-1 are OTP roots
 * and index value CMRT_OTP_NUM_ROOTS is for the perso root.
 *
 * @param [in] name Object name can be string or binary.
 * @param [in] namelen Object name length.
 * @param [in] attributes Access for the root, see datastore_attr.h.
 * @param [in] index Root index to set attributes for or -1 for current root.
 * @param [in] user True if the syscall was relayed by the supervisor.
 * @return Zero on success, -ERRNO on error.
 */
int fboot_data_store_grant(const void *name, size_t namelen, uint32_t attributes, int index, bool user);

#endif
```

## src/datastore.c
```c
/*
 * Copyright (c) 2023 Cryptography Research, Inc. (CRI)
 * A license or authorization from CRI is needed to use this file.
 */

#include <kernel.h>
#include <string.h>
#include "datastore.h"

__noinit static sys_dlist_t datastore;

void data_store_init(void)
{
	sys_dlist_init(&datastore);
}

static struct data_store_object *data_store_find(const uint8_t *name, size_t namelen)
{
	struct data_store_object *object;
	SYS_DLIST_FOR_EACH_CONTAINER(&datastore, object, node) {
		if (object->namelen == namelen &&
		    memcmp(object->name, name, namelen) == 0) {
		    return object;
		}
	}
	return NULL;
}

static struct data_store_object *data_store_create(size_t namelen, size_t datalen)
{
	struct data_store_object *object = k_malloc(sizeof(struct data_store_object));
	if (object == NULL) { return NULL; }

	object->name = k_malloc(namelen);
	if (object->name == NULL) {
		k_free(object);
		return NULL;
	}
	object->data = k_malloc(datalen); /* NULL for zero datalen */
	if (datalen) {
		if (object->data == NULL) {
			k_free(object->name);
			k_free(object);
			return NULL;
		}
	}
	object->namelen = namelen;
	object->datalen = datalen;
	(void)memset(object->attributes, 0, sizeof(object->attributes));
	sys_dlist_append(&datastore, &object->node);

	return object;
}

static void data_store_remove(struct data_store_object *object)
{
	sys_dlist_remove(&object->node);
	(void)memset(object->name, 0, object->namelen);
	(void)memset(object->data, 0, object->datalen);
	k_free(object->name);
	k_free(object->data);
	k_free(object);
}

int data_store_read(const void *name, size_t namelen, void *data, size_t *datalen, uint32_t required, int root)
{
	struct data_store_object *object = data_store_find(name, namelen);
	if (object == NULL) {
		return -ENOENT;
	}
	if (required != 0 &&
	    (object->attributes[root] & required) != required) {
		/* No permissions to read. */
		return -EPERM;
	}
	if (object->datalen > *datalen) {
		/* Not enough space in caller buffer. */
		return -ENOSPC;
	}
	/* Copy data to user buffer. */
	if (object->data != NULL && object->datalen != 0) {
		(void)memcpy(data, object->data, object->datalen);
	}
	*datalen = object->datalen;
	return 0;
}

int data_store_write(const void *name, size_t namelen, const void *data, size_t datalen, uint32_t required, int root)
{
	struct data_store_object *object = data_store_find(name, namelen);
	if (object != NULL) {
		/* Already there, this is an update. */
		if (required != 0 &&
		    (object->attributes[root] & required) != required) {
			/* No permissions to update. */
			return -EPERM;
		}
		if (object->datalen == datalen) {
			/* Do update in place. */
			(void)memcpy(object->data, data, datalen);
			return 0;
		}
		/* Different size, remove data and make new. */
		k_free(object->data);
		object->datalen = 0;
		object->data = k_malloc(datalen); /* NULL for zero datalen */
		if (datalen > 0) {
			if (object->data == NULL) {
				/* No memory for new data. The object
				 * now has NULL data and zero datalen. */
				return -ENOMEM;
			}
			(void)memcpy(object->data, data, datalen);
			object->datalen = datalen;
		}
		return 0;
	}
	/* Create new empty object. */
	object = data_store_create(namelen, datalen);
	if (object == NULL) { return -ENOMEM; }

	/* Copy name, data and attributes. */
	(void)memcpy(object->name, name, namelen);
	(void)memcpy(object->data, data, datalen);
	/* Required attributes for writing existing object are zero for machine,
	 * DS_S_WRITE/DS_U_WRITE for supervisor/user. For new object we want
	 * zero for machine, DS_S_GRANT/DS_U_GRANT for supervisor/user. */
	object->attributes[root] = required << 2;
	return 0;
}

int data_store_grant(const void *name, size_t namelen, uint32_t attributes, uint32_t required, int index, int root)
{
	struct data_store_object *object = data_store_find(name, namelen);
	if (object == NULL) {
		return -ENOENT;
	}
	if (required != 0 &&
	    (object->attributes[root] & required) != required) {
		/* No permissions to grant. */
		return -EPERM;
	}
	/* Update attributes and check for remove. */
	bool all = (attributes & DS_ALL_ROOTS) == DS_ALL_ROOTS;
	bool other = (attributes & DS_OTHER_ROOTS) == DS_OTHER_ROOTS;
	uint8_t all_attributes = 0;
	for (int i = 0; i < sizeof(object->attributes); i++) {
		if (all || (other && i != index) || (!other && i == index)) {
			object->attributes[i] = attributes;
		}
		all_attributes |= object->attributes[i];
	}
	if (all_attributes == 0) {
		/* No access for any root, remove. */
		data_store_remove(object);
	}
	return 0;
}
```

## src/datastore.h
```c
/*
 * Copyright (c) 2023 Cryptography Research, Inc. (CRI)
 * A license or authorization from CRI is needed to use this file.
 */

#ifndef CMRT_DATASTORE_H
#define CMRT_DATASTORE_H

#include <sys/dlist.h>
#include <cmrt/fboot/datastore_attr.h>
#include <drivers/cmrt/omc.h>

struct data_store_object {
	sys_dnode_t node;
	uint8_t *name; /* allocated name */
	size_t namelen;
	uint8_t *data; /* allocated data */
	size_t datalen;
	uint8_t attributes[CMRT_OTP_NUM_ROOTS + 1];
};

void data_store_init(void);
int data_store_read(const void *name, size_t namelen, void *data, size_t *datalen, uint32_t required, int root);
int data_store_write(const void *name, size_t namelen, const void *data, size_t datalen, uint32_t required, int root);
int data_store_grant(const void *name, size_t namelen, uint32_t attributes, uint32_t required, int index, int root);

#endif
```

## src/fboot.c
```c
/*
 * Copyright (c) 2017-2023 Cryptography Research, Inc. (CRI).
 * A license or authorization from CRI is needed to use this file.
 */

#include <fboot.h>
#include <cmrt_mpu.h>
#include "supervisor.h"

#include <logging/log.h>
LOG_MODULE_DECLARE(cmrt, CONFIG_CMRT_LOG_LEVEL);

bool fboot_memmatch(cmrt_cc_t cc, const void *s1, const void *s2, size_t n)
{
	if (!is_aligned(s1, 4u) || !is_aligned(s2, 4u) || !is_aligned(n, 4u)) {
		/* Everything needs to be word aligned. */
		return false;
	}
	/*
	 * Timing constant word compare which returns zero if there are
	 * no differences. Feed the comparison values to canary core to
	 * make sure glitching the call to fboot_memmatch will not be enough
	 * to bypass the comparison.
	 */
	const uint32_t *w1 = s1;
	const uint32_t *w2 = s2;
	uint32_t res = 0;
	for (n >>= 2; n != 0u; n--) {
		if (cmrt_is_valid(cc)) {
			(void)cmrt_cc_mix(cc, *w1 ^ *w2);
		}
		res |= *w1 ^ *w2;
		++w1;
		++w2;
	}
	return res == 0u;
}

static inline cmrt_hc_t hash_open(uint32_t flags)
{
	/* Open fboot hash core statically without device_get_binding. */
	return (cmrt_hc_t)cmrt_dd_open(DEVICE_DT_GET(DT_CHOSEN(rambus_fboot_hc)), flags, NULL);
}

static cmrt_hc_t hash_init(cmrt_hc_t hc, cmrt_hash_algo_t algo)
{
	if (!cmrt_is_valid(hc)) {
		hc = hash_open(0);
		if (!cmrt_is_valid(hc)) { return CMRT_INVALID_HANDLE; }
	}
	int res = cmrt_hc_init(hc, algo, NULL, 0);
	if (res != 0) {
		LOG_INF("Cannot init hash: %d", res);
		cmrt_hc_close(hc);
		return CMRT_INVALID_HANDLE;
	}
	return hc;
}

static int hash_update(cmrt_hc_t hc, const void *data, size_t size)
{
	int res = cmrt_hc_update(hc, data, size);
	if (res != 0) {
		LOG_INF("Cannot update hash: %d", res);
		cmrt_hc_close(hc);
	}
	return res;
}

static int hash_final(cmrt_hc_t hc, void *digest)
{
	size_t size = SHA512_BYTES; /* max, assume caller has it right */
	int res = cmrt_hc_final(hc, NULL, 0, digest, &size);
	if (res != 0) { LOG_INF("Cannot final hash: %d", res); }
	cmrt_hc_close(hc);
	return res;
}

int fboot_hash(cmrt_hc_t hc, cmrt_hash_algo_t algo, const void *data, size_t size, void *digest)
{
	int res = -EIO;
	hc = hash_init(hc, algo);
	if (cmrt_is_valid(hc)) {
		res = hash_update(hc, data, size);
		if (res == 0) { res = hash_final(hc, digest); }
	}
	return res;
}

int fboot_hash2(cmrt_hc_t hc, cmrt_hash_algo_t algo, const void *data1, size_t size1, const void *data2, size_t size2, void *digest)
{
	int res = -EIO;
	hc = hash_init(hc, algo);
	if (cmrt_is_valid(hc)) {
		res = hash_update(hc, data1, size1);
		if (res == 0) { res = hash_update(hc, data2, size2); }
		if (res == 0) { res = hash_final(hc, digest); }
	}
	return res;
}

static int verify_ecdsa(cmrt_cc_t cc, uint32_t pktype, const uint8_t *pub, const uint8_t *digest, const uint8_t *signature)
{
	/* We cast it to uint32_t * later, so it must be well-aligned. */
	if (((uintptr_t)signature & (sizeof(uint32_t) - 1u)) != 0u) {
		return -EINVAL;
	}

	cmrt_ecc_curve_t curve;
	uint32_t digestlen;
	switch (pktype) {
	case PK_ECDSA_P256:
		curve = cmrt_pke_get_curve(CMRT_ECC_CURVE_NIST_P256);
		digestlen = SHA256_BYTES;
		break;
#ifdef CONFIG_CMRT_FBOOT_HAS_ECDSA_P521
	case PK_ECDSA_P521:
		curve = cmrt_pke_get_curve(CMRT_ECC_CURVE_NIST_P521);
		digestlen = SHA512_BYTES;
		break;
#endif
#ifdef CONFIG_CMRT_FBOOT_HAS_ECDSA_P384
	case PK_ECDSA_P384:
		curve = cmrt_pke_get_curve(CMRT_ECC_CURVE_NIST_P384);
		digestlen = SHA384_BYTES;
		break;
#endif
	default:
		return -EINVAL;
	}

	cmrt_pke_t pke = cmrt_pke_open(CMRT_O_SYNC);
	if (curve == NULL || !cmrt_is_valid(pke)) { return -ENODEV; }

	uint32_t comp_r[PKERAM_SLOT_WORDS] = { 0 };
	uint32_t curvelen = cmrt_pke_get_curve_length(curve);
	int res = cmrt_pke_ecdsa_verify_hash(pke, curve, pub, pub + curvelen,
				       digest, digestlen, signature,
				       signature + curvelen, comp_r);
	cmrt_pke_close(pke);
	const uint32_t *sign_r = (const uint32_t *)signature;
	for (size_t i = 0; i < SHA256_WORDS; i++) {
		/*
		 * Mix the minimum number of words (zeros) for all pktypes.
		 * We cannot really do more because we already have set CC
		 * to the expected value.
		 */
		if (cc != NULL) { (void)cmrt_cc_mix(cc, sign_r[i] ^ comp_r[i]); }
	}
#ifdef CONFIG_CMRT_FIPS_140_MODE
	LOG_INF("Zero ecdsa verification output");
	(void)memset(comp_r, 0x00, curvelen);
#endif
	if (res != 0) {
		LOG_INF("Ecdsa verify failed: %d", res);
		LOG_HEXDUMP_INF(digest, curvelen, "digest:");
		return -EPERM;
	}
	LOG_INF("ECDSA verify OK.");

	return 0;
}

static int derive_hmac_key(uint32_t id, uint8_t silo, cmrt_hc_t hc)
{
	cmrt_kdc_t kdc = cmrt_kdc_open(CMRT_O_SYNC);
	if (!cmrt_is_valid(kdc)) { return -ENODEV; }

	cmrt_kdc_cmd_t cmd;
	(void)memset(&cmd, 0, sizeof(cmd));
	/* Use zeroed full size diversify path. */
	cmd.diversify_len = 16;
	uint8_t *silop = (uint8_t *)cmd.diversify_path;
	/* And the 16th byte is silo. */
	silop[15] = silo;
	cmd.base_key_id = id;
	int res = cmrt_hc_kdc_cmd(hc, CMRT_HASH_SHA256, KDC_KEY_SIZE, &cmd);
	if (res == 0) { res = cmrt_kdc_derive_key(kdc, &cmd); }
	if (res != 0) { LOG_INF("Failed to derive key: %d", res); }
	cmrt_kdc_close(kdc);

	return res;
}

int fboot_verify_cid(cmrt_cc_t cc, const cmrt_img_footer_t *footer, const void *pkhash)
{
	uint32_t digest[SHA256_WORDS];
	int res = fboot_hash2(NULL, CMRT_HASH_SHA256, &footer->public_key_type,
			      sizeof(footer->public_key_type),
			      footer->public_key, footer->public_key_length,
			      digest);
	if (res != 0) { return res; }

	/* Public key hash must match to given pkhash. */
	if (pkhash != NULL) {
		if (!fboot_memmatch(cc, pkhash, digest, sizeof(digest))) {
			LOG_INF("Invalid public key hash");
			return -EFAULT;
		}
	}
	/* Container id prefix must be public key hash. */
	if (!fboot_memmatch(cc, footer->scid.cid.root.hash, digest, sizeof(digest))) {
		LOG_INF("Invalid container id");
		return -EPERM;
	}
	return 0;
}

int img_digest(cmrt_hc_t hc, cmrt_hash_algo_t algo, const void *blob, size_t size, const cmrt_img_footer_t *footer, void *digest)
{
	return fboot_hash2(hc, algo, blob,
			   size - footer->signature_length - sizeof(footer->footer_length),
			   (uint8_t *)blob + size - sizeof(footer->footer_length),
			   sizeof(footer->footer_length), digest);
}

int fboot_verify_hmac(cmrt_cc_t cc, const void *blob, size_t size, const void *pkhash, const cmrt_img_footer_t *footer)
{
	if (footer->public_key_type != PK_HMAC_SHA256) {
		LOG_INF("Invalid footer pktype: %d", (int)footer->public_key_type);
		return -EINVAL;
	}
	int res = fboot_verify_cid(cc, footer, pkhash);
	if (res != 0) { return res; }

	/* Open HC for KDC.*/
	cmrt_hc_t hc = hash_open(CMRT_O_HWC_KEYED);
	if (!cmrt_is_valid(hc)) { return -ENODEV; }

	/* Derive key for hmac, key will be put into HC. */
	res = derive_hmac_key(KEY_ID_PNAK, CAVEAT_SILO, hc); /* always silo */
	if (res != 0) {
		LOG_INF("PNAK derivation failed: %d", res);
		cmrt_hc_close(hc);
		return res;
	}
	/* Calculate hmac over the image and footer. */
	uint32_t digest[SHA256_WORDS];
	res = img_digest(hc, CMRT_HASH_SHA256, blob, size, footer, digest);
	if (res != 0) { return res; } /* hc is closed in img_digest */

	/* It must match image signature. */
	if (!fboot_memmatch(cc, footer->signature, digest, sizeof(digest))) {
		LOG_INF("Invalid signature");
		return -EPERM;
	}
	LOG_INF("HMAC verify OK.");
	return 0;
}

int fboot_verify_sig(cmrt_cc_t cc, const void *blob, size_t size, const void *pkhash, const cmrt_img_footer_t *footer)
{
	int res = fboot_verify_cid(cc, footer, pkhash);
	if (res != 0) { return res; }
	/*
	 * Reserve enough digest space for the digest for all public key types.
	 * PKE driver copies curve length amount of the digest and for P-521
	 * it is 64 bytes.
	 */
	uint32_t digest[SHA3_512_WORDS];
	const uint8_t *d = (const uint8_t *)digest;
	switch (footer->public_key_type) {
	case PK_ECDSA_P256:
		/* Calculate hash over the image and footer. */
		res = img_digest(NULL, CMRT_HASH_SHA256, blob, size, footer, digest);
		if (res != 0) { break; }
		res = verify_ecdsa(cc, footer->public_key_type, footer->public_key, d, footer->signature);
		break;
#ifdef CONFIG_CMRT_FBOOT_HAS_ECDSA_P521
	case PK_ECDSA_P521:
		/* Calculate hash over the image and footer. */
		res = img_digest(NULL, HC_HASH_ALGO_SHA_512, blob, size, footer, digest);
		if (res != 0) { break; }
		res = verify_ecdsa(cc, footer->public_key_type, footer->public_key, d, footer->signature);
		break;
#endif
#ifdef CONFIG_CMRT_FBOOT_HAS_RSA_VERIFY
	case PK_RSAPSS_3K:
	case PK_RSAPSS_4K:
		/* Calculate hash over the image and footer. */
		res = img_digest(NULL, HC_HASH_ALGO_SHA3_512, blob, size, footer, digest);
		if (res != 0) { break; }
		res = fboot_verify_rsa(cc, footer->public_key_length, (uint32_t *)footer->public_key, (const uint32_t *)digest, (uint32_t *)footer->signature);
		break;
#endif
#ifdef CONFIG_CMRT_SUPERVISOR_IN_ROM
	case PK_SHA256:
		if (!IS_IN_ROM((uint32_t)blob) ||
		    !IS_IN_ROM((uint32_t)blob + size)) {
			/* Plain SHA256 is only allowed for ROM images. */
			res = -EPERM;
			break;
		}
		/* Calculate hash over the image and footer. */
		res = img_digest(NULL, CMRT_HASH_SHA256, blob, size, footer, digest);
		if (res != 0) { break; }
		if (!fboot_memmatch(cc, digest, footer->signature, SHA256_BYTES)) {
			/* No match for the digest given in footer. */
			res = -EPERM;
		}
		break;
#endif
#ifdef CONFIG_CMRT_FBOOT_HAS_LMS_VERIFY
	case PK_LMS:
		/* Calculate hash over the image and footer. */
		res = img_digest(NULL, CMRT_HASH_SHA256, blob, size, footer, digest);
		if (res != 0) { break; }
		res = fboot_verify_lms(cc, (const uint8_t *)footer->public_key,
				       (const uint8_t *)d, SHA256_BYTES,
				       (const uint8_t *)footer->signature);
		break;
#endif
#ifdef CONFIG_CMRT_FBOOT_HAS_LMS_HSS_VERIFY
	case PK_LMS_HSS:
		/* Calculate hash over the image and footer. */
		res = img_digest(NULL, CMRT_HASH_SHA256, blob, size, footer, digest);
		if (res != 0) { break; }
		res = fboot_verify_lms_hss(cc, (const uint8_t *)footer->public_key,
					   (const uint8_t *)d, SHA256_BYTES,
					   (const uint8_t *)footer->signature);
		break;
#endif
#ifdef CONFIG_CMRT_FBOOT_HAS_XMSS_VERIFY
	case PK_XMSS:
	case PK_XMSS_MT:
		res = fboot_verify_xmss(cc, blob, size, footer, digest, sizeof(digest));
		break;
#endif
#ifdef CONFIG_CMRT_FBOOT_HAS_ECDSA_P384
	case PK_ECDSA_P384:
		/* Calculate hash over the image and footer. */
		res = img_digest(NULL, HC_HASH_ALGO_SHA_384, blob, size, footer, digest);
		if (res != 0) { break; }
		res = verify_ecdsa(cc, footer->public_key_type, footer->public_key, d, footer->signature);
		break;
#endif
	default:
		LOG_INF("Invalid footer pktype: %d", (int)footer->public_key_type);
		res = -EINVAL;
		break;
	}
#ifdef CONFIG_CMRT_FIPS_140_MODE
	LOG_INF("Zero image digest");
	(void)memset(digest, 0x00, sizeof(digest));
#endif
	return res;
}

#ifdef CONFIG_CMRT_PMU
__noinit static uint32_t bb_digest[SHA256_WORDS];

int fboot_verify_bb(bool setup)
{
	/* Make sure SRAM was retained correctly. */
	cmrt_hc_t hc = hash_init(NULL, CMRT_HASH_SHA256);
	if (!cmrt_is_valid(hc)) { return -ENODEV; }
	uint32_t regions[CONFIG_CMRT_MPU_NUM_REGIONS];
	cmrt_mpu_read_regions(0, regions);
	for (int i = 1; i < CONFIG_CMRT_MPU_NUM_REGIONS; i++) {
		/* Hash everything in SRAM that is RO or RX but not W.
		 * Note that we only need to hash M segments because
		 * supervisor X and RO segments are set to RO for M. */
		uint32_t end = CMRT_MPU_ADDRESS(regions[i]);
		uint32_t bits = CMRT_MPU_BITS(regions[i]);
		if (CMRT_MPU_PRIVILEGE(regions[i]) == MPU_PRIVILEGE_M &&
		    IS_IN_RAM(end) && (bits & MPU_MODE_WRITABLE) == 0 &&
		    (bits & MPU_MODE_READABLE) != 0) {
			uint32_t start = CMRT_MPU_ADDRESS(regions[i - 1]);
			uint32_t size = end - start;
			LOG_INF("Adding 0x%x:%u into bb digest", start, size);
			int res = hash_update(hc, (const uint8_t *)(uintptr_t)start, size);
			if (res != 0) { return res; }
		}
	}
	uint32_t digest[SHA256_WORDS];
	int res = hash_final(hc, digest);
	if (res != 0) { return res; }
	if (setup) {
		/* Called to update digest. */
		(void)memcpy(bb_digest, digest, sizeof(digest));
		LOG_INF("Updated boot bypass digest");
	} else {
		/* Called to verify that calculated digest matches. */
		if (!fboot_memmatch(NULL, bb_digest, digest, sizeof(digest))) {
			LOG_INF("Invalid boot bypass digest");
			return -EPERM;
		}
		LOG_INF("Verified boot bypass digest");
	}
	return 0;
}
#endif

int fboot_set_tdv(const uint32_t tdv[CMRT_FMC_TDV_SIZE])
{
#ifdef CONFIG_JTAG_BEFORE_BOOT
	ARG_UNUSED(tdv);
	return 0;
#else
	cmrt_fmc_t fmc = cmrt_fmc_open();
	if (!cmrt_is_valid(fmc)) { return -ENODEV; }
	int res = 0;
	for (uint32_t i = 0; i < (uint32_t)CMRT_FMC_TDV_SIZE; i++) {
		res = cmrt_fmc_write(fmc, FMC_TDV_OFFSET + i * 4u,
				     tdv[i], 0xffffffffu);
		if (res != 0) { break; }
		LOG_INF("TDV[%u] written: 0x%x", i, tdv[i]);
	}
	cmrt_fmc_close(fmc);
	return res;
#endif
}

int fboot_kdc_set_hw_state(uint8_t value)
{
	cmrt_kdc_t kdc = cmrt_kdc_open(0);
	if (!cmrt_is_valid(kdc)) { return -ENODEV; }
	int res = cmrt_kdc_set_hw_state(kdc, value);
	cmrt_kdc_close(kdc);
	return res;
}

static inline bool is_bb_state(uint32_t lc)
{
	return lc == DLC_TESTED || lc == DLC_PROVISIONED || lc == DLC_MISSION;
}

void *fboot_bootbypass_vector(uint32_t state)
{
	uint32_t bbs = cmrt_read_reg(CMRT_SIC_BASE, R_BOOT_BYPASS_STATUS);
	uint32_t bbv = cmrt_read_reg(CMRT_SIC_BASE, R_BOOT_BYPASS_VECTOR);
	uint32_t flags = BOOT_BYPASS_ALLOWED | IN_MPU_RESET;
	if ((bbs & flags) == BOOT_BYPASS_ALLOWED && bbv != 0 && is_bb_state(state)) {
		return (void *)(uintptr_t)bbv;
	}
	return NULL;
}
```

## src/fboot_lms_hss_verify.c
```c
/*
 * Copyright (c) 2023 Cryptography Research, Inc. (CRI).
 * A license or authorization from CRI is needed to use this file.
 */

#include <fboot.h>
#include <cmrt/shsig/lms.h>

#include <logging/log.h>
LOG_MODULE_DECLARE(cmrt, CONFIG_CMRT_LOG_LEVEL);

int fboot_verify_lms_hss(cmrt_cc_t cc, const uint8_t *pk, const uint8_t *digest, size_t dlen, const uint8_t *signature)
{
	cmrt_hc_t hc = (cmrt_hc_t)cmrt_dd_open(DEVICE_DT_GET(DT_CHOSEN(rambus_fboot_hc)), 0, NULL);
	if (!cmrt_is_valid(hc)) {
		return -ENODEV;
	}

	int res = cmrt_lms_hss_verify(hc, pk, digest, dlen, signature);
	cmrt_hc_close(hc);

	if (cc != NULL) {
		for (int i = 0; i < SHA256_WORDS; i++) {
			/*
			 * Mix the minimum number of words (zeros) for all pktypes.
			 * We cannot really do more because we already have set CC
			 * to the expected value.
			 */
			(void)cmrt_cc_mix(cc, res);
		}
	}
	if (res != 0) {
		LOG_INF("LMS-HSS verify failed: %d", res);
		return -EPERM;
	}
	LOG_INF("LMS-HSS verify OK.");

	return 0;
}
```

## src/fboot_lms_verify.c
```c
/*
 * Copyright (c) 2023 Cryptography Research, Inc. (CRI).
 * A license or authorization from CRI is needed to use this file.
 */

#include <fboot.h>
#include <cmrt/shsig/lms.h>

#include <logging/log.h>
LOG_MODULE_DECLARE(cmrt, CONFIG_CMRT_LOG_LEVEL);

int fboot_verify_lms(cmrt_cc_t cc, const uint8_t *pk,
				 const uint8_t *digest, size_t dlen,
				 const uint8_t *signature)
{
	cmrt_hc_t hc = (cmrt_hc_t)cmrt_dd_open(DEVICE_DT_GET(DT_CHOSEN(rambus_fboot_hc)), 0, NULL);
	if (!cmrt_is_valid(hc)) {
		return -ENODEV;
	}

	int res = cmrt_lms_verify(hc, pk, digest, dlen, signature);
	cmrt_hc_close(hc);

	if (cc != NULL) {
		for (int i = 0; i < SHA256_WORDS; i++) {
			/*
			 * Mix the minimum number of words (zeros) for all pktypes.
			 * We cannot really do more because we already have set CC
			 * to the expected value.
			 */
			(void)cmrt_cc_mix(cc, res);
		}
	}
	if (res != 0) {
		LOG_INF("LMS verify failed: %d", res);
		return -EPERM;
	}
	LOG_INF("LMS verify OK.");

	return 0;
}
```

## src/fboot_xmss_verify.c
```c
/*
 * Copyright (c) 2017-2023 Cryptography Research, Inc. (CRI).
 * A license or authorization from CRI is needed to use this file.
 */

#include <fboot.h>
#include <cmrt/shsig/xmss.h>

#ifdef CONFIG_CMRT_FBOOT_HAS_XMSS_MT_VERIFY
#include <cmrt/shsig/xmss_mt.h>
#endif

#include <logging/log.h>
LOG_MODULE_DECLARE(cmrt, CONFIG_CMRT_LOG_LEVEL);


#ifdef CONFIG_WDT_CMRT
static void wdt_feed_call(void) {
	extern int wdt_cmrt_feed(const struct device *dev, int channel_id);
	(void)wdt_cmrt_feed(NULL, 0);
}
#else
static wdt_feed_func *wdt_feed_call = NULL;
#endif

int fboot_verify_xmss(cmrt_cc_t cc,
				  const void *blob,
				  size_t bsize,
				  const cmrt_img_footer_t *footer,
				  uint32_t *digest, size_t dsize)
{
	bool mt = footer->public_key_type == PK_XMSS_MT;
	uint32_t xmss_type = XMSS_RESERVED;
	cmrt_hash_algo_t halgo;
	if (mt) {
#ifdef CONFIG_CMRT_FBOOT_HAS_XMSS_MT_VERIFY
		xmss_type = cmrt_xmss_mt_get_type(footer->public_key);
		halgo = cmrt_xmss_mt_get_hash_algo(xmss_type);
#endif
	} else {
		xmss_type = cmrt_xmss_get_type(footer->public_key);
		halgo = cmrt_xmss_get_hash_algo(xmss_type);
	}
	if (xmss_type == XMSS_RESERVED) {
		return -EINVAL; /* wrong or unspported OID */
	}

	size_t dlen = cmrt_hc_hash_size(halgo, false, dsize);
	if (dlen > dsize) {
		return -EINVAL;
	}

	/* Calculate given hash over the image and footer, rambus_fboot_hc
	 * should support given hash algo, hash_final() closes HC */
	int res = img_digest(NULL, halgo, blob, bsize, footer, digest);
	if (res != 0) {
		return res;
	}
	cmrt_hc_t hc = (cmrt_hc_t)cmrt_dd_open(DEVICE_DT_GET(DT_CHOSEN(rambus_fboot_hc)), 0, NULL);
	if (!cmrt_is_valid(hc)) {
		return -ENODEV;
	}

	if (mt) {
#ifdef CONFIG_CMRT_FBOOT_HAS_XMSS_MT_VERIFY
		res = cmrt_xmss_mt_verify(hc, footer->public_key,
					  (const uint8_t *)digest, dlen,
					  footer->signature, wdt_feed_call);
#else
		res = -EINVAL;
#endif
	} else {
		res = cmrt_xmss_verify(hc, footer->public_key,
				       (const uint8_t *)digest, dlen,
				       footer->signature, wdt_feed_call);
	}
	cmrt_hc_close(hc);

	if (cc != NULL) {
		for (int i = 0; i < SHA256_WORDS; i++) {
			/*
			 * Mix the minimum number of words (zeros) for all hash
			 * algo types. We cannot really do more because we
			 * already have set CC to the expected value.
			 */
			(void)cmrt_cc_mix(cc, res);
		}
	}
	if (res != 0) {
		LOG_INF("XMSS verify failed: %d", res);
		return -EPERM;
	}
	LOG_INF("XMSS verify OK.");

	return 0;
}
```

## src/img.h
```c
/*
 * Copyright (c) 2018-2023 Cryptography Research, Inc. (CRI)
 * A license or authorization from CRI is needed to use this file.
 */

#ifndef FBOOT_IMG_H
#define FBOOT_IMG_H

#include <stdint.h>
#include <stdbool.h>

#include <cmrt/fboot/img_format.h>

/**
 * @brief Parse image footer into given parameter.
 *
 * @param blob Pointer to the image start (start of ELF).
 * @param size Size of the image (ELF + footer).
 * @param footer Pointer to struct that will hold parsed values on return.
 * @return Footer length on success, -ERRNO on error.
 */
int cmrt_img_footer_parse(void *blob, size_t size, cmrt_img_footer_t *footer);

/**
 * @brief Parse binary footer into given parameter.
 *
 * @param blob Pointer to the image start.
 * @param size Size of the image (bin + footer).
 * @param relocate Relocate footer fields.
 * @param footer Pointer to struct that will hold parsed values on return.
 * @return Footer length on success, -ERRNO on error.
 */
int cmrt_raw_footer_parse(void *blob, size_t size, bool relocate, cmrt_raw_footer_t *footer);

/**
 * @brief Clear image BSS section.
 *
 * @param footer Pointer to footer initialized with @ref cmrt_raw_footer_parse.
 */
void cmrt_raw_image_init(const cmrt_raw_footer_t *footer);

/**
 * @brief Parse container footer into given parameter.
 *
 * @param blob Pointer to the image start.
 * @param size Size of the image (bin + footer).
 * @param raw Already parsed raw footer.
 * @param footer Pointer to struct that will hold parsed values on return.
 * @return Footer length on success, -ERRNO on error.
 */
int cmrt_usr_footer_parse(void *blob, size_t size, const cmrt_raw_footer_t *raw, cmrt_usr_footer_t *footer);

#endif
```
