## CMakeLists.txt
```
# Copyright (c) 2017-2023 Cryptography Research, Inc. (CRI).

cmake_minimum_required(VERSION 3.20.0)

find_package(Zephyr REQUIRED HINTS $ENV{ZEPHYR_BASE})
project(supervisor)

if(CONFIG_DEBUG)
  zephyr_cc_option(-Os)
endif()
add_definitions(-DSUPERVISOR_VERSION_INFO="${SUPERVISOR_VERSION_INFO}")

zephyr_include_directories_ifdef(
  CONFIG_TEST_REBEL_H
  src/test
  )

target_include_directories(app PRIVATE
  ${ZEPHYR_BASE}/samples/cmrt/fboot/include
  ${ZEPHYR_BASE}/drivers/dma
  ${ZEPHYR_BASE}/drivers/ipm
  ${ZEPHYR_BASE}/drivers/spi
  ${ZEPHYR_BASE}/drivers/misc/pvt_con
  ${ZEPHYR_BASE}/include
  ${ZEPHYR_BASE}/lib/gpt/include
  ${ZEPHYR_BASE}/lib/integrity/include
  ${ZEPHYR_BASE}/drivers/otp
  src/pcie
  )

target_sources_ifdef(CONFIG_TEST_REBEL_H
  app
  PRIVATE
  src/test/test_main.c
  src/test/test_mailbox.c
  src/test/test_crypto.c
  src/test/test_qspi.c
  )

target_sources(app PRIVATE
  src/cmrt_container.c
  src/main.c
  ${ZEPHYR_BASE}/drivers/dma/dma_pl330.c
  ${ZEPHYR_BASE}/drivers/ipm/ipm_samsung.c
  ${ZEPHYR_BASE}/drivers/misc/pvt_con/pvt_con.c
  ${ZEPHYR_BASE}/drivers/syscon/sysreg_rot.c
  ${ZEPHYR_BASE}/drivers/spi/qspi.c

  src/pcie/pcie_ide.c
  src/test/test_pvt_con.c
  src/test/test_otp.c
  ${ZEPHYR_BASE}/drivers/otp/otp.c
  )
target_link_libraries(app PUBLIC "-Wl,-e__reset")

if(CONFIG_CMRT_CALIPTRA_SUPPORT)
  target_sources(app PRIVATE src/caliptra.c)
  target_link_libraries(app PRIVATE caliptra)
endif()
```

## Kconfig
```
# Kconfig - Private config options for MW

mainmenu "MW supervisor"

config CMRT_NUM_CONTAINERS
       int "Number of containers"
       default 2
       range 1 2
       help
        Number of supported loadable containers in MW.


config CMRT_CONTAINER_STACK_SIZE
       hex "Container stack size in bytes"
       default 0x3000
       help
          Stack size allocated for each user thread.  This must be larger
          than PRIVILEGED_STACK_SIZE which is reserved from this area for
          system call execution.  The remaining size is available for the
          container's user thread.


source "Kconfig.zephyr"
```

## prj.conf
```kconfig
CONFIG_SUPERVISOR_MODE=y
#CONFIG_WDT_DISABLE_AT_BOOT=y
CONFIG_USERSPACE=y
CONFIG_POSIX_CLOCK=y
CONFIG_CMRT_SID=y
CONFIG_CMRT_RSA=y
CONFIG_CMRT_RSA_CRT=y
CONFIG_CMRT_ECIES=y
CONFIG_CMRT_FFDH=y
CONFIG_CMRT_SAC_ACCESS_FIXUP=y
CONFIG_RISCV_MISALIGNED_FIXUP=y
CONFIG_CMRT_USERSPACE_SYSCALLS=n
CONFIG_CMRT_CONTAINER_SYSCALLS=y
# make RELEASE_BUILD=1 unsets these
CONFIG_LOG=y
CONFIG_LOG_MODE_MINIMAL=y
CONFIG_LOG_MODE_MINIMAL_TIMESTAMP=y
CONFIG_LOG_DEFAULT_LEVEL=4
CONFIG_DEBUG=y
CONFIG_THREAD_MONITOR=y
CONFIG_PVT_SAMSUNG=y
```

## src/caliptra.c
```c
/*
 * Copyright (c) 2023 Cryptography Research, Inc. (CRI).
 * A license or authorization from CRI is needed to use this file
 */
#include <stddef.h>
#include <stdint.h>
#include <stdbool.h>

#include <cmrt/caliptra/flow.h>
#include <cmrt/caliptra/x509.h>
#include <cmrt/caliptra/assets.h>
#include <cmrt/caliptra/handover.h>

#include <drivers/cmrt/fboot.h>

#include "caliptra.h"

int cmrt_caliptra_fmc_init(cmrt_caliptra_fmc_context_t *context)
{
	/* Retrieve and erase FMC-only assets from the data store. */

	/* This has to be done before the container is loaded, and
	 * current root is considered to be 0 (due to the fallback in
	 * datastore API). If the container is loaded then MW cannot
	 * anymore retrieve assets destined for root 0.
	 */

	size_t len = sizeof(context->cdi_fmc);
	int res = cmrt_caliptra_rta_retrieve(CMRT_CALIPTRA_RTA_CDI_FMC,
					     &context->cdi_fmc, &len, true);
	if (res == 0) {
		len = sizeof(context->aliasfmc_priv);
		res = cmrt_caliptra_rta_retrieve(CMRT_CALIPTRA_RTA_ALIASFMC_PRIV,
						 &context->aliasfmc_priv, &len, true);
	}
	if (res == 0) {
		len = sizeof(context->aliasfmc_pub);
		res = cmrt_caliptra_rta_retrieve(CMRT_CALIPTRA_RTA_ALIASFMC_PUB,
						 &context->aliasfmc_pub, &len, true);
	}
	return res;
}

/* If this function completes successfully, the following new assets
 * shall be available to RT:
 *
 * - CDI_rt
 * - AliasRT keypair
 * - AliasRT certificate
 * - Owner AliasRT CSR
 */
int cmrt_caliptra_fmc_flow(cmrt_caliptra_fmc_context_t *context,
			       const void *rt_address, size_t rt_size)
{
	int res = 0;

	cmrt_caliptra_deviceinfo_t devinfo;
	if (res == 0) {
		res = cmrt_caliptra_get_deviceinfo(&devinfo);
	}

	/* TCI_rt := HASH(RT image) */
	cmrt_caliptra_digest_t tci_rt;
	if (res == 0) {
		res = cmrt_caliptra_hash(rt_address, rt_size, &tci_rt);
	}

	/* CDI_rt := HMAC(CDI_fmc, TCI_rt) */
	cmrt_caliptra_digest_t cdi_rt;
	if (res == 0) {
		res = cmrt_caliptra_hmac(&context->cdi_fmc, sizeof(context->cdi_fmc),
					 &tci_rt, sizeof(tci_rt),
					 &cdi_rt);
	}

	if (res == 0) {
		res = cmrt_caliptra_rta_store(CMRT_CALIPTRA_RTA_CDI_RT, &cdi_rt, sizeof(cdi_rt));
	}

	/* AliasRT {priv, pub} := eccKPDF(CDI_rt, "AliasRT Key Pair") */
	cmrt_caliptra_privkey_t aliasrt_priv;
	cmrt_caliptra_pubkey_t aliasrt_pub;
	if (res == 0) {
		res = cmrt_caliptra_ecckpdf(&cdi_rt, sizeof(cdi_rt),
					    CMRT_KP_INFO_AliasRT, strlen(CMRT_KP_INFO_AliasRT),
					    &aliasrt_priv, &aliasrt_pub);
	}

	if (res == 0) {
		res = cmrt_caliptra_rta_store(CMRT_CALIPTRA_RTA_ALIASRT_PRIV,
				  &aliasrt_priv, sizeof(aliasrt_priv));
	}
	if (res == 0) {
		res = cmrt_caliptra_rta_store(CMRT_CALIPTRA_RTA_ALIASRT_PUB,
				  &aliasrt_pub, sizeof(aliasrt_pub));
	}

	/* AliasRT certificate */
	cmrt_caliptra_tcb_t aliasfmc = {
		.identity = CMRT_CALIPTRA_ID_AliasFMC,
		.privkey = &context->aliasfmc_priv,
		.pubkey = &context->aliasfmc_pub,
	};
	cmrt_caliptra_tcb_t aliasrt = {
		.identity = CMRT_CALIPTRA_ID_AliasRT,
		.privkey = &aliasrt_priv,
		.pubkey = &aliasrt_pub,
	};
	const cmrt_caliptra_digest_t *rt_fwids[] = {
		&tci_rt,
	};
	// TODO do containers have a version that we can get here?
	const char *rt_ver = "rt version";
	size_t rt_ver_len = strlen(rt_ver);
	cmrt_caliptra_tcbinfo_t rt_tcbis[] = {
		{
			.version = rt_ver,
			.version_len = rt_ver_len,
			.layer = 2,
			.fwids = rt_fwids,
			.fwids_len = ARRAY_SIZE(rt_fwids),
		},
	};
	cmrt_caliptra_cert_params_t aliasrt_cert_params = {
		.issuer = &aliasfmc,
		.subject = &aliasrt,
		.deviceinfo = &devinfo,
		.tcbinfos = rt_tcbis,
		.tcbinfos_len = ARRAY_SIZE(rt_tcbis),
	};
	alignas(4) uint8_t der[CMRT_CALIPTRA_MAX_DER_LEN];
	size_t der_len = sizeof(der);
	if (res == 0) {
		res = cmrt_caliptra_write_cert(der, &der_len, &aliasrt_cert_params);
	}

	if (res == 0) {
		res = cmrt_caliptra_rta_store(CMRT_CALIPTRA_RTA_ALIASRT_CERT, der, der_len);
	}

	/* Owner AliasFMC CSR */
	cmrt_caliptra_csr_params_t owner_aliasfmc_csr_params = {
		.subject = &aliasfmc,
		.deviceinfo = &devinfo,
		.tcbinfos = rt_tcbis,
		.tcbinfos_len = ARRAY_SIZE(rt_tcbis),
	};
	if (res == 0) {
		res = cmrt_caliptra_write_csr(der, &der_len, &owner_aliasfmc_csr_params);
	}
	if (res == 0) {
		res = cmrt_caliptra_rta_store(CMRT_CALIPTRA_RTA_OWNER_ALIASFMC_CSR, der, der_len);
	}

	/* Clear secrets from memory. */
	cmrt_caliptra_zeroize(context, sizeof(*context));

	/* These have been handed over to RT; clear them from FMC
	 * memory.
	 */
	cmrt_caliptra_zeroize(&tci_rt, sizeof(tci_rt));
	cmrt_caliptra_zeroize(&cdi_rt, sizeof(cdi_rt));

	return res;
}

int cmrt_caliptra_plat_datastore_read(const char *name, size_t namelen,
				      void *data, size_t *datalen)
{
	return fboot_data_store_read(name, namelen, data, datalen, false);
}

int cmrt_caliptra_plat_datastore_write(const char *name, size_t namelen,
				       const void *data, size_t datalen)
{
	return fboot_data_store_write(name, namelen, data, datalen, false);
}

int cmrt_caliptra_plat_datastore_grant(const char *name, size_t namelen, int root, uint32_t attr)
{
	return fboot_data_store_grant(name, namelen, attr, root, false);
}
```

## src/caliptra.h
```c
/*
 * Copyright (c) 2023 Cryptography Research, Inc. (CRI).
 * A license or authorization from CRI is needed to use this file
 */
#ifndef CMRT_MW_CALIPTRA_H
#define CMRT_MW_CALIPTRA_H
#include <stddef.h>
#include <stdint.h>
#include <stdbool.h>
#include <cmrt/caliptra/types.h>

#ifdef __cplusplus
extern "C" {
#endif


/*
 * Collection of runtime Caliptra assets transferred from sboot to MW.
 *
 * The Caliptra boot flow for the First Mutable Code (FMC) requires
 * certain assets from the previous layer. These are stored in the
 * security monitor datastore by sboot. Middleware must retrieve these
 * before it (auto-)loads the Caliptra RT container, because
 * afterwards the user container's root's permissions are applied and
 * prevent access to these assets.
 *
 * Therefore the boot flow is split into two stages:
 * cmrt_caliptra_fmc_init() fills this structure, which is then
 * consumed by cmrt_caliptra_fmc_flow().
 */
typedef struct cmrt_caliptra_fmc_context {
	cmrt_caliptra_digest_t cdi_fmc;
	cmrt_caliptra_privkey_t aliasfmc_priv;
	cmrt_caliptra_pubkey_t aliasfmc_pub;
} cmrt_caliptra_fmc_context_t;

int cmrt_caliptra_fmc_init(cmrt_caliptra_fmc_context_t *context);
int cmrt_caliptra_fmc_flow(cmrt_caliptra_fmc_context_t *context,
			       const void *rt_address, size_t rt_size);

#ifdef __cplusplus
}
#endif
#endif
```

## src/cmrt_container.c
```c
/*
 * Copyright (c) 2018-2023 Cryptography Research, Inc. (CRI).
 * A license or authorization from CRI is needed to use this file.
 */

#include "cmrt_container.h"
#include <linker/linker-defs.h>
#include <logging/log.h>
LOG_MODULE_DECLARE(cmrt_container, CONFIG_CMRT_LOG_LEVEL);
#include <assert.h>

/* Array of containers. */
cmrt_container_t cmrt_containers[CONFIG_CMRT_NUM_CONTAINERS];

/* Defines array of data threads. */
struct k_thread cmrt_containers_threads[CONFIG_CMRT_NUM_CONTAINERS];

/* Defines array of thread stacks. */
K_THREAD_STACK_ARRAY_DEFINE(cmrt_containers_thread_stacks,
	CONFIG_CMRT_NUM_CONTAINERS, CONFIG_CMRT_CONTAINER_STACK_SIZE);

#define CMRT_MAX_CONTAINER_FLOW_ID 0x7FF

int cmrt_container_load(int flowid, int8_t thread_priority, void *img, size_t img_size)
{
	/* Check input parameters. */
	if (flowid <= 0 || flowid > CMRT_MAX_CONTAINER_FLOW_ID ||
	    img == NULL || img_size <= 0) {
		LOG_INF("MW %s(): Invalid parameters", __func__);
		return -EINVAL;
	}

	if (!(thread_priority > 0 && thread_priority <= (CONFIG_NUM_PREEMPT_PRIORITIES - 1))) {
		LOG_INF("MW %s(): Invalid parameter priority %d",
			__func__, thread_priority);
		return -EINVAL;
	}

	cmrt_container_t *ptr_container = NULL;
	uint32_t container_size = 0;
	cmrt_container_get_next_empty(&ptr_container, &container_size);
	if (container_size == 0) {
		/* This code should never execute even with a dedicated test case. */
		LOG_INF("MW %s(): Invalid container found", __func__);
		return -EINVAL;
	}

	ptr_container->flowid = flowid;
	ptr_container->thread_priority = thread_priority;
	ptr_container->img_size = img_size;

	/* Creating container thread. */
	ptr_container->thread_id = k_thread_create(ptr_container->ptr_thread_data,
						   ptr_container->ptr_thread_stack,
						   ptr_container->thread_stack_size,
						   (k_thread_entry_t)img, (void *)
						   ptr_container->flowid, NULL, NULL,
						   ptr_container->thread_priority,
						   K_USER | K_CONTAINER, K_FOREVER);

	/* Documentation does not indicate which is the value returned when
	 * functions fails to create thread. Assuming NULL. */
	if (ptr_container->thread_id == NULL) {
		LOG_INF("MW %s(): Failure creating thread for flowid %d",
			__func__, ptr_container->flowid);
		return -EINVAL;
	}

	/* At this stage we could have a dead thread, meaning the image
	 * loading operation failed. We simply inform the user and leave
	 * the image in memory. The user should proceed to stop and unload
	 * the image from memory to free the container. */
	if (ptr_container->thread_id->base.thread_state == _THREAD_DEAD) {
		ptr_container->state = CMRT_CONTAINER_MALFUNCT;
		LOG_INF("Container FAILED to load");
	} else {
		/* Assign container state and return. */
		ptr_container->state = CMRT_CONTAINER_STARTING;
		LOG_INF("Container LOADED");
	}

	return 0;
}

int cmrt_container_unload(cmrt_container_t *ptr_container)
{
	if (ptr_container == NULL) {
		return -EINVAL;
	}

	int rval = 0;
	switch (ptr_container->state) {
		case CMRT_CONTAINER_MALFUNCT:
		case CMRT_CONTAINER_RUNNING:
		case CMRT_CONTAINER_SUSPENDED:
		case CMRT_CONTAINER_STARTING:
			LOG_INF("MW %s(): Aborting Thread %p",
				__func__, ptr_container->thread_id);
			k_thread_abort(ptr_container->thread_id);
			if (ptr_container->state != CMRT_CONTAINER_STARTING) {
				LOG_INF("Closing contexts for Thread %p", ptr_container->thread_id);
				cmrt_dd_free(ptr_container->thread_id);
			}
			/* [[fall-through]]; */
		case CMRT_CONTAINER_EXITING:
			LOG_INF("MW %s(): Unloading Thread %p",
				__func__, ptr_container->thread_id);
			cmrt_container_initialize_one(ptr_container);
			rval = 1;
			break;
		default:
			rval = -EBADF;
			break;
	}
	return rval;
}

int cmrt_container_run_resume(cmrt_container_t *ptr_container)
{
	if (ptr_container == NULL) {
		return -EINVAL;
	}

	int rval = 0;
	switch (ptr_container->state) {
	case CMRT_CONTAINER_RUNNING:
		/* Container thread is already running. */
		rval = 0;
		break;
	case CMRT_CONTAINER_STARTING:
		LOG_INF("MW %s(): Started Thread %p", __func__,
			ptr_container->thread_id);
		k_thread_start(ptr_container->thread_id);
		ptr_container->state = CMRT_CONTAINER_RUNNING;
		rval = 1;
		break;
	case CMRT_CONTAINER_SUSPENDED:
		LOG_INF("MW %s(): Resuming Thread %p", __func__,
			ptr_container->thread_id);
		k_thread_resume(ptr_container->thread_id);
		ptr_container->state = CMRT_CONTAINER_RUNNING;
		rval = 1;
		break;
	default:
		rval = -EBADF;
		break;
	}

	return rval;
}

int cmrt_container_stop(cmrt_container_t *ptr_container)
{
	if (ptr_container == NULL) {
		return -EINVAL;
	}

	int rval = 0;
	switch (ptr_container->state) {
	case CMRT_CONTAINER_MALFUNCT:
	case CMRT_CONTAINER_RUNNING:
	case CMRT_CONTAINER_STARTING:
	case CMRT_CONTAINER_SUSPENDED:
		LOG_INF("MW %s(): Aborting Thread %p", __func__,
			ptr_container->thread_id);
		k_thread_abort(ptr_container->thread_id);
		LOG_INF("Closing contexts for Thread %p",
			ptr_container->thread_id);
		cmrt_dd_free(ptr_container->thread_id);
		ptr_container->state = CMRT_CONTAINER_EXITING;
		rval = 1;
		break;
	default:
		rval = -EBADF;
		break;
	}
	return rval;
}

int cmrt_container_suspend(cmrt_container_t *ptr_container)
{
	if (ptr_container == NULL) {
		return -EINVAL;
	}

	int rval = 0;
	switch (ptr_container->state) {
	case CMRT_CONTAINER_RUNNING:
		LOG_INF("MW() %s: Suspending Thread %p", __func__,
			ptr_container->thread_id);
		k_thread_suspend(ptr_container->thread_id);
		ptr_container->state = CMRT_CONTAINER_SUSPENDED;
		rval = 1;
		break;
	case CMRT_CONTAINER_STARTING:
	case CMRT_CONTAINER_SUSPENDED:
		/* Container thread is already suspended/inactive. */
		rval = 0;
		break;
	default:
		rval = -EBADF;
		break;
	}
	return rval;
}

void cmrt_container_initialize(void)
{
	LOG_INF("User container max size: %d bytes", CONTAINER_RAM_TOTAL);
	LOG_INF("Max concurrent user containers: %d", CONFIG_CMRT_NUM_CONTAINERS);
	cmrt_container_initialize_all();
}

int cmrt_container_number_of_containers(void)
{
	return CONFIG_CMRT_NUM_CONTAINERS;
}

/* Returns an array with the status for each container. */
void *cmrt_container_statuses(cmrt_container_status_t *ptr_statuses, int *ptr_size)
{
	if (ptr_statuses == NULL || ptr_size == NULL) {
		return NULL;
	}

	cmrt_container_status_t aux[CONFIG_CMRT_NUM_CONTAINERS];
	for (int i = 0; i < CONFIG_CMRT_NUM_CONTAINERS; i++) {
		aux[i].flowid = cmrt_containers[i].flowid;
		aux[i].thread_priority = cmrt_containers[i].thread_priority;
		aux[i].state = cmrt_containers[i].state;
	}
	*ptr_size = CONFIG_CMRT_NUM_CONTAINERS;
	return memcpy((void *)ptr_statuses, (void *)aux,
		      CONFIG_CMRT_NUM_CONTAINERS * sizeof(cmrt_container_status_t));
}

/*******************************************************************************
 * CONTAINERS INTERNAL MANAGEMENT
*******************************************************************************/

/* Sets container to initial values. */
void cmrt_container_initialize_one(cmrt_container_t *ptr_container)
{
	if (ptr_container == NULL) {
		return;
	}

	ptr_container->state = CMRT_CONTAINER_IDLE;
	ptr_container->flowid = -1;
	ptr_container->thread_priority = -1;

	/* Delete memory image. */
	(void)memset(ptr_container->ptr_img, 0, ptr_container->img_size);
	ptr_container->img_size = 0;

	/* Delete stack memory: Security concern. */
	(void)memset(ptr_container->ptr_thread_stack, 0, ptr_container->thread_stack_size);

	/* Point thread id to null. */
	ptr_container->thread_id = NULL;
}

/* Sets all the containers to initial values. */
void cmrt_container_initialize_all(void)
{
	for (unsigned int i = 0; i < CONFIG_CMRT_NUM_CONTAINERS; i++) {
		cmrt_containers[i].id = i;
		cmrt_containers[i].state = CMRT_CONTAINER_IDLE;
		cmrt_containers[i].flowid = -1;
		cmrt_containers[i].img_size = 0;
		cmrt_containers[i].ptr_thread_data = &cmrt_containers_threads[i];
		cmrt_containers[i].ptr_thread_stack = cmrt_containers_thread_stacks[i];
		cmrt_containers[i].thread_stack_size = CMRT_CONTAINERS_THREAD_STACK_SIZE;
		cmrt_containers[i].thread_priority = -1;
	}

	static_assert(CONFIG_CMRT_NUM_CONTAINERS <= 2, "only 2 containers work");
	CONTAINER_A.ptr_img = CONTAINER_RAM_START;
	CONTAINER_A.img_write_direction = 0;
#if CMRT_CONTAINER_MAX_NUM > 1
	CONTAINER_B.ptr_img = CONTAINER_RAM_END;
	CONTAINER_B.img_write_direction = CMRT_SIC_ALIGN_RIGHT;
#endif
}

/* Search for container based in flow id number.
 */
cmrt_container_t *cmrt_container_search_per_flowid(int flowid)
{
	for (int i = 0; i < CONFIG_CMRT_NUM_CONTAINERS; i++) {
		if (cmrt_containers[i].flowid == flowid) {
			return &cmrt_containers[i];
		}
	}
	return NULL;
}


/* Maximum size of a container to load.  "Using guard to compensate
 * for all the alignments" (?)
 */
static size_t cmrt_container_max_size(void)
{
	size_t n = CONTAINER_RAM_TOTAL - CONTAINER_RAM_GUARD;
	for (unsigned i = 0; i < CONFIG_CMRT_NUM_CONTAINERS; ++i) {
		n -= cmrt_containers[i].img_size;
	}
	return n;
}

/*
  Returns the next empty container based in flow id.
  also changes it start address based in the container size.
 */
void cmrt_container_get_next_empty(cmrt_container_t **ptr_container, size_t *container_size)
{
	cmrt_container_t *container = &cmrt_containers[0];
	size_t size = 0;
	char *pimg = CONTAINER_RAM_START;
	for (int i = 0; i < CONFIG_CMRT_NUM_CONTAINERS; i++) {
		if (cmrt_containers[i].flowid == -1) {
			container = &cmrt_containers[i];
			container->ptr_img = pimg;
			size = cmrt_container_max_size();
			break;
		}
		pimg += ROUND_UP(cmrt_containers[i].img_size, 4);
	}
	*ptr_container = container;
	*container_size = size;
}

/* Sets dead container to malfunctioning. */
/* Transition to other state shall be initiated by user. */
void cmrt_container_update_malfunctioning(void)
{
	for (int i = 0; i < CONFIG_CMRT_NUM_CONTAINERS; i++) {
		if ((cmrt_containers_threads[i].base.thread_state == _THREAD_DEAD) &&
		    (cmrt_containers[i].state <= CMRT_CONTAINER_RUNNING) &&
		    (cmrt_containers[i].state > CMRT_CONTAINER_IDLE)) {
			LOG_INF("Detected container %d malfunctioning", cmrt_containers[i].flowid);
			cmrt_containers[i].state = CMRT_CONTAINER_MALFUNCT;
		}
	}
}

/* Indicates if there is at least one container running */
int cmrt_container_is_there_one_running(void)
{
	for (int i = 0; i < CONFIG_CMRT_NUM_CONTAINERS; ++i) {
		if (cmrt_containers[i].state == CMRT_CONTAINER_RUNNING) {
			return true;
		}
	}
	return false;
}
```

## src/cmrt_container.h
```c
/*
 * Copyright (c) 2018-2023 Cryptography Research, Inc. (CRI).
 * A license or authorization from CRI is needed to use this file.
 */

#ifndef CMRT_CONTAINER_H
#define CMRT_CONTAINER_H

#include <kernel_structs.h>
#include <stdalign.h>
#include <zephyr.h>
#include <device.h>
#include <string.h>
#include <sys/util.h>

#include <drivers/cmrt/dd.h>
#include <drivers/cmrt/cmrt.h>
#include <drivers/cmrt/sic.h>
#include <drivers/cmrt/util.h>
#include <cmrt/fboot/fboot_config.h>

// Maximum limitation for static management of containers.
// WARNING: Increasing beyond 2 requires containers memory management.
#define CMRT_CONTAINERS_MAX_NUM           2
// Containers thread stack size.
#define CMRT_CONTAINERS_THREAD_STACK_SIZE 12288

/*
 *
 * CONTAINER STATE FLOW:
 *
 * ===================== LEGEND ==========================
 * capital case: mw commands.
 * lowercase: cmrt_container function calls.
 *
 *
 *                     +-----------+
 *                     |    INIT   |
 *                     +-----------+
 *                           |
 *                           | cmrt_container_initialize_all()
 *                           |
 *                           v          cmrt_container_unload()                       cmrt_container_stop()
 *                      +--------+      UNLOAD                      +---------+       STOP                        +----------------+
 *                      |  IDLE  | <------------------------------- | EXITING | <-------------------------------- | MALFUNCTIONING |
 *                      +--------+                                  +---------+                                   +----------------+
 *                       |      ^                                        ^
 * cmrt_container_load() |      | cmrt_container_unload()                |
 *                  LOAD |      | UNLOAD                                 |
 *                       v      |                                        |
 *                     +----------+                                      |
 *                     |          |                                      |
 *                     | STARTING |                                      | cmrt_container_stop()
 *                     |          |                                      | 2nd STOP
 *                     +----------+                                      |
 *                          |                                            |
 *                          | cmrt_container_run()                       |
 *                          | START                                      |
 *                          |                                            |
 *                          v                                            |
 *                     +---------+     cmrt_container_resume()     +-----------+
 *                     |         |     START                       |           |
 *                     | RUNNING | <------------------------------ | SUSPENDED |
 *                     |         | ------------------------------> |           |
 *                     +---------+     cmrt_container_suspend()    +-----------+
 */

/*
 * CONTAINER A or B SIC BUFFER:
 * ----------------------------
 * To reduce the memory footprint, the SIC buffer for reception will be switched between containers
 * A and B. Its lengths it is limited by the available memory for the containers
 * Once both containers are full, all LOAD operations will be ignored, and SIC buffer will
 * default to the SIC buffer under Container A.
 *
 * | Start Container A or B.
 * v
 * +------------+---------------------------+
 * | SIC BUFFER | BEGINNING OF IMAGE LOADED |
 * +------------+                           |
 * |                                        |
 * |                                        |
 * |                                        |
 * +----------------------------------------+
 *                                          ^
 *                  End of Container A or B |
 */


// Container created without threads.
// All containers exists in IDLE state once the program start execution.
#define CMRT_CONTAINER_IDLE 0
// Container thread created but not yet running.
#define CMRT_CONTAINER_STARTING 1
// Container thread running.
#define CMRT_CONTAINER_RUNNING 2
//
#define CMRT_CONTAINER_EXIT_REQUESTED 3
// Container thread has been aborted.
#define CMRT_CONTAINER_EXITING 4
//
#define CMRT_CONTAINER_MALFUNCT 5
// Container thread suspended.
#define CMRT_CONTAINER_SUSPENDED 6

/**
 * @struct cmrt_container_t
 * @brief This structure controls the containers internal state and other
 * parameters of interest.
 */
/**
 * @var cmrt_container_t::id
 * Identification number used internally for the only purpose of memory allocation.
 */
/**
 * @var cmrt_container_t::*ptr_img
 * Pointer to the memory address where the container image starts.
 */
/**
 * @var cmrt_container_t::img_size
 * Contains the container image size.
 */
/**
 * @var cmrt_container_t::state
 * Stores the intenal state of the container. These states are defined as IDLE,
 * STARTING, RUNNING, EXITING, SUSPENDED, MALFUNCTIONING, AND EXIT_REQUESTED.
 */
/**
 * @var cmrt_container_t::flowid
 * Indicates the flowid used by the container when using the SIC interface.
 */
/**
 * @var cmrt_container_t::*ptr_thread_data
 * Pointer to Zephyr's thread data.
 */
/**
 * @var cmrt_container_t::*ptr_thread_stack
 * Pointer to Zephyr's thread stack.
 */
/**
  * @var cmrt_container_t::thread_stack_size
  * Zephyr's thread stack size.
  */
/**
 * @var cmrt_container_t::thread_id
 * Zephyr's thread id.
 */
/**
 * @var cmrt_container_t::thread_priority
 * Zephyr's thread priority.
 */
typedef struct cmrt_container cmrt_container_t;
struct cmrt_container {

	/* CONTAINER RELATED PROPERTIES */
	/* Container id. */
	unsigned int id;
	/* Container image memory location. */
	void *ptr_img;
	/* Container write direction */
	int img_write_direction;
	/* Container image size. */
	size_t img_size;
	/* Container internal State. */
	int state;
	/* Container flowid. */
	int flowid;

	/* ZEPHYR THREADS RELATED PROPERTIES */
	/* Thread data. */
	struct k_thread *ptr_thread_data;
	/* Thread stack. */
	k_thread_stack_t *ptr_thread_stack;
	/* Thread stack size. */
	size_t thread_stack_size;
	/* Thread id returned upon thread creation.
	 * Note: typedef struct k_thread * k_tid_t */
	k_tid_t thread_id;
	/* Thread priority */
	int8_t thread_priority;
};

typedef struct cmrt_container_status cmrt_container_status_t;
struct cmrt_container_status {
	int flowid;
	int thread_priority;
	int state;
};


/* CONTAINER ACTIONS */
/**
 * @brief Allocates container into memory and creates thread.
 *
 * @param flowid Indicates the flowid used by the container for SIC communication.
 * @param img Pointer to image to load into container.
 * @param img_size Container image size.
 *
 * @return Zero on success or negative value on error.
 */
int cmrt_container_load(int flowid, int8_t thread_priority, void *img, size_t img_size);

/**
 * @brief Deallocates container from memory.
 *
 * @param ptr_container Pointer to the container to unload.
 *
 * @return Zero on success or negative value on error.
 */
int cmrt_container_unload(cmrt_container_t *ptr_container);

/**
 * @brief Runs or resumes container (in function of its state when the call takes effect).
 *
 * @param ptr_container Pointer to the container to unload.
 *
 * @return Zero on success or negative value on error.
 */
int cmrt_container_run_resume(cmrt_container_t *ptr_container);

/**
 * @brief Stops container execution (Thread abortion).
 *
 * @param ptr_container Pointer to the container to unload.
 *
 * @return Zero on success or negative value on error.
 */
int cmrt_container_stop(cmrt_container_t *ptr_container);

/**
 * @brief Suspends container executtion (Thread suspension).
 *
 * @param ptr_container Pointer to the container to unload.
 *
 * @return Zero on success or negative value on error.
 */
int cmrt_container_suspend(cmrt_container_t *ptr_container);


int cmrt_container_number_of_containers(void);
/* Returns an array with the status for each container. */
void *cmrt_container_statuses(cmrt_container_status_t *ptr_statuses, int *ptr_size);

/********************************************************************************
// CONTAINERS INTERNAL MANAGEMENT
********************************************************************************/

/**
 * @brief Initilizes all global variables to predefined values.
 *
 */
void cmrt_container_initialize(void);

/**
 * @brief Initializes one single container to predefined values.
 *
 * @param ptr_container Pointer to the container to unload.
 */
void cmrt_container_initialize_one(cmrt_container_t *ptr_container);

/**
 * @brief Initilizes all containers to predefined values.
 *
 */
void cmrt_container_initialize_all(void);

/**
 * @brief Searchs container per flow id.
 *
 * @param flowid Flow id container to be search.
 *
 * @return Pointer to container found, otherwise NULL.
 */
cmrt_container_t *cmrt_container_search_per_flowid(int flowid);

/**
 * @brief Retrieves next available empty container based in flowid value.
 *
 * @return Pointer to container found, otherwise NULL.
 */
void cmrt_container_get_next_empty(cmrt_container_t **ptr_container, size_t *container_size);

void cmrt_container_update_malfunctioning(void);

int cmrt_container_is_there_one_running(void);

/******************************************************************************
     CONTAINERS INTERNAL MEMORY MANAGEMENT (Maximum 2 containers only)

     All functions below this point are non-generic, meaning there are
     written with a maximum number of containers (2) in mind. To increase
     the number of containers a different approach should be followed.
*******************************************************************************/
/*

| <-- Container A Start                 Container B End --> |
|                                                           |
|                     Container B Start                     |
|                             |-->                          |
├─────────────────────────────┼─────────────────────────────┤
|      MEMORY CONTAINER A     |      MEMORY CONTAINER B     |
├─────────────────────────────┴─────────────────────────────┤
|                        TOTAL MEMORY                       |
└───────────────────────────────────────────────────────────┘

 */

/*!
 * Pointer to RAM end (immediately past the end of the
 * container-available total RAM.
 */

#define CONTAINER_RAM_END     ((char *) RISCV_RAM_BASE + RISCV_RAM_SIZE)

#define CONTAINER_RAM_START   ((char *)(ROUND_UP(_image_ram_end, 4)))
#define CONTAINER_RAM_TOTAL   ((size_t)(CONTAINER_RAM_END - CONTAINER_RAM_START))
#define CONTAINER_RAM_GUARD   (16)

/* Array of containers. */
extern cmrt_container_t cmrt_containers[CMRT_CONTAINERS_MAX_NUM];

#define CONTAINER_A cmrt_containers[0]
#define CONTAINER_B cmrt_containers[1]


#endif // CMRT_CONTAINER_H
```

## src/main_edl.c
```c
/*
 * Copyright (c) 2018-2023 Cryptography Research, Inc. (CRI).
 * A license or authorization from CRI is needed to use this file.
 */

#include <stdalign.h>
#include <zephyr.h>
#include <device.h>
#include <string.h>
#include <sys/util.h>

#include <drivers/cmrt/cmrt.h>
#include <drivers/cmrt/eac.h>
#include <drivers/cmrt/sic.h>
#include <drivers/cmrt/util.h>
#ifdef CONFIG_CMRT_PMU
#include <drivers/cmrt/pmu.h>
#endif
#include <drivers/watchdog.h>
#include <drivers/cmrt/fboot.h>
#include <cmrt/fboot/fboot_config.h>

#include <logging/log.h>
#include <rebel_h.h>

#include <drivers/cmrt/fmc.h>
LOG_MODULE_DECLARE(main, CONFIG_CMRT_LOG_LEVEL);

const static char version_info[] __version = SUPERVISOR_VERSION_INFO;

/*
 * functions below(related to OTP) are only for feature test.
 * will be implemented in driver format.
 */
#define OTP_CON_PRIVATE				(0x1E00250000ULL)
#define OTP_CON_CONTROL				(0x110)
	#define STANDBY_CMD				(0x8)
	#define PROGRAM_CMD				(0x4)
	#define INIT_CMD				(0x1)
#define OTP_INT_STATUS				(0x11C)
	#define INIT_DONE				(0x1)
	#define PROGRAM_DONE			(0x4)
	#define SECURE_FAIL				(0x20)
#define OTP_IF						(0x118)
	#define PROGRAM_DATA			(0x80000000ULL)

#define FIPS_MODE_START_BIT_ADDR	(0x500)

#define FIPS_MODE_0					(0x1024)	/* preloading value in sfr */

int set_count_in_value(uint32_t value)
{
	uint32_t set_count = 0;

	for (int i = 0; i < 32; i++) {
		if (((value >> i) & BIT(0)) == BIT(0)) {
			set_count++;
		}
	}
	return set_count;
}

int is_fips_enabled(void)
{
	cmrt_sac_set_base(NULL, OTP_CON_PRIVATE);
	uint32_t fips_mode = cmrt_sac_read32(SAC_MEMORY_BASE + FIPS_MODE_0);

	LOG_INF("FIPS_MODE value in SFR(preloading) : 0x%x", fips_mode);

	uint32_t set_count = set_count_in_value(fips_mode);

	/*
	 * return 0 --> fips mode disabled
	 * return 1 --> fips mode enabled
	 */
	return !(set_count % 2);
}

void otp_init(void)
{
	LOG_INF("OTP init start");

	cmrt_sac_set_base(NULL, OTP_CON_PRIVATE);
	cmrt_sac_write32(INIT_CMD, SAC_MEMORY_BASE + OTP_CON_CONTROL);

	do {
		;
	} while ((cmrt_sac_read32(SAC_MEMORY_BASE + OTP_INT_STATUS) & BIT(0)) != INIT_DONE);

	LOG_INF("OTP init done");
}

/*
 * if fips-mode is on, calling this func will make fips-mode is off when next booting.
 * if fips-mode is off, calling this func will make fips-mode is on when next booting.
 */
int invert_fips_mode(void)
{
	cmrt_sac_set_base(NULL, OTP_CON_PRIVATE);
	uint32_t fips_mode = cmrt_sac_read32(SAC_MEMORY_BASE + FIPS_MODE_0); /* preload value in sfr */
	uint32_t set_count = set_count_in_value(fips_mode);

	if (set_count == 32) {
		LOG_INF("OTP FIPS_MODE all wasted");
		return -1;
	}

	for (int i = 0; i < 32; i++) {
		if (((fips_mode >> i) & BIT(0)) == BIT(0)) {
			continue;
		} else {
			LOG_INF("OTP FIPS_MODE program in [%d]bit", i);
			cmrt_sac_write32(PROGRAM_DATA | FIPS_MODE_START_BIT_ADDR | (BIT(i) - 1),
							 SAC_MEMORY_BASE + OTP_IF);
			cmrt_sac_write32(PROGRAM_CMD, SAC_MEMORY_BASE + OTP_CON_CONTROL);
			volatile uint32_t otp_int_status;

			do {
				otp_int_status = cmrt_sac_read32(SAC_MEMORY_BASE + OTP_INT_STATUS);
				if ((otp_int_status & BIT(5)) == SECURE_FAIL) {
					LOG_INF("OTP program secure fail");
					return -1;
				}
			} while ((otp_int_status & BIT(2)) != PROGRAM_DONE);

			cmrt_sac_write32(otp_int_status, SAC_MEMORY_BASE + OTP_INT_STATUS);

			break;
		}
	}

	cmrt_sac_write32(STANDBY_CMD, SAC_MEMORY_BASE + OTP_IF);

	return 0;
}

void set_tdv(void)
{
	uint32_t tdv[4];

	tdv[0] = 0xffffffff;
	tdv[1] = 0xffffffff;
	tdv[2] = 0xffffffff;
	tdv[3] = 0xffffffff;
	cmrt_fmc_t fmc = cmrt_fmc_open();

	uint32_t tdv_read[4];

	for (uint32_t i = 0; i < (uint32_t)CMRT_FMC_TDV_SIZE; i++) {
		cmrt_fmc_write(fmc, FMC_TDV_OFFSET + i * 4u,
					   tdv[i], 0xffffffffu);
		LOG_INF("***************TDV[%u] written: 0x%x", i, tdv[i]);
	}
	(uint32_t)cmrt_fmc_set_debug_mode(fmc);

	for (uint32_t i = 0; i < (uint32_t)CMRT_FMC_TDV_SIZE; i++) {
		cmrt_fmc_read(fmc, FMC_TDV_OFFSET + i * 4u, &tdv_read[i]);
		LOG_INF("***************TDV[%u] read 0x%x", i, tdv_read[i]);
	}
	cmrt_fmc_close(fmc);
}

int main(void)
{
	LOG_INF("start main\n");
	cmrt_set_boot_status(SUPERVISOR_RUNNING_ID, SUPERVISOR_RUNNING_ID);
#ifdef SUPERVISOR_SAMPLE_STARTED
	cmrt_write_reg(CMRT_SIC_BASE, R_SCRATCH_0, SUPERVISOR_SAMPLE_STARTED);
#endif

	otp_init();
	if (is_fips_enabled() == 1) {
		LOG_INF("currently, FIPS MODE is **ENABLED**");
		if (invert_fips_mode() == 0) {
			LOG_INF("write FIPS_MODE 1 bit in OTP to disable FIPS_MODE done.");
			LOG_INF("FIPS_MODE will be off when reboot");
			LOG_INF("Also can check otp mem by this command,"
					" memory -store top.dut.BLK_ROT.OTP_CON_SOC_mem_wrapper."
					"sf_otp64kb_cp_s101_ln04lpp_3207000_inst.mem1 -file otp_dump_c0.txt");
			LOG_INF(" memory -store top.dut1.BLK_ROT.OTP_CON_SOC_mem_wrapper."
					"sf_otp64kb_cp_s101_ln04lpp_3207000_inst.mem1 -file otp_dump_c1.txt");
			LOG_INF(" memory -store top.dut2.BLK_ROT.OTP_CON_SOC_mem_wrapper."
					"sf_otp64kb_cp_s101_ln04lpp_3207000_inst.mem1 -file otp_dump_c2.txt");
			LOG_INF(" memory -store top.dut3.BLK_ROT.OTP_CON_SOC_mem_wrapper."
					"sf_otp64kb_cp_s101_ln04lpp_3207000_inst.mem1 -file otp_dump_c3.txt");
			LOG_INF("dump file will be generated in zebu.run/zrci.db/");

			LOG_INF("waiting reset,   force top.nRESET_tri 'b0 -radix bin -deposit");
			LOG_INF("		force top.nRESET_tri 'b1 -radix bin -deposit");

			LOG_INF("set tdv sfr with fmc.");
			set_tdv();
			LOG_INF("try to attach to RISC-V (expect not available)");
			__asm__("j .");
		} else {
			LOG_INF("write FIPS_MODE 1 bit in OTP to disable FIPS_MODE fail.");
			__asm__("j .");
		}
	} else {
		LOG_INF("currently, FIPS MODE is **DISABLED**");
		LOG_INF("set tdv sfr with fmc.");
		set_tdv();

		LOG_INF("try t32 attach to RISC-V (expect available)");
		__asm__("j .");
	}

	return 0;
}
```

## src/mw_protocol.h
```c
/*
 * Middleware protocol definitions.
 *
 * Copyright (c) 2017-2022 Cryptography Research, Inc. (CRI).
 * A license or authorization from CRI is needed to use this file.
 */

#ifndef MW_PROTOCOL_H
#define MW_PROTOCOL_H

#include <stdint.h>
#include <rebel_h_gpt.h>
#include "../../../../common/rebel_h_sic.h"
/**
 * @struct cmrt_mw_request_t
 * CMRT MW command format. CMRT MW listens for commands from HLOS at
 * flow ID 100. Command should be sent using this struct. For select commands an
 * optional payload may follow this struct. MW responds to commands with
 * cmrt_mw_response_t.
 */
typedef struct {
	/**
	 * Command ID.
	 *
	 * @ref CMRT_MW_COMMANDS
	 */
	uint32_t cmd;

	/**
	 * Flow ID of the container. It is use by only those commands that operate
	 * on containers directly.
	 */
	uint32_t flowid;

	/**
	 * Container priority. It is used by load container only and indicate the
	 * container priority.
	 */
	uint32_t container_priority;

	/**
	 * Bytes. Used by #CMRT_MW_CHECK_CONTAINER and #CMRT_MW_LOAD_CONTAINER
	 * commands.
	 */
	uint32_t length;
} cmrt_mw_request_t;

/**
 * @struct cmrt_mw_response_t
 * CMRT MW response format. CMRT responds to HLOS command using this struct.
 */
typedef struct {
	/**
	 * If command execution results in an error, "errno" is returned in this
	 * field, it is 0 otherwise.
	 */
	uint32_t error;

	/**
	 * Container status. This field is set if cmd is #CMRT_MW_PROBE_CONTAINER
	 *
	 * @ref CRI_CONTAINER_STATE
	 */
	uint32_t status; /* container status, see below */
} cmrt_mw_response_t;

/**
 * MW responds to command #CMRT_MW_READ_LOGS with this struct. It is followed by
 * content of the ring buffer.
 */
typedef struct {
	uint32_t size; /**< Size of the log buffer, which follows this struct */

	/**
	 * Offset to the oldest log message. Message may be partial, due to wrap
	 * around in ring buffer.
	 */
	uint32_t head;
} cmrt_log_header_t;

typedef struct cmrt_mw_command_response_header cmrt_mw_command_response_header_t;
struct cmrt_mw_command_response_header {
	uint32_t command;
	uint32_t version;
	uint32_t size;
};

#define CMRT_MW_COMMAND_PS 1

typedef struct cmrt_mw_command_ps_response cmrt_mw_command_ps_response_t;
struct cmrt_mw_command_ps_response {
	uint32_t flowid;
	int32_t container_priority;
	uint32_t state;
};

typedef struct cmrt_mw_command_ps_containers_response cmrt_mw_command_ps_containers_response_t;
struct cmrt_mw_command_ps_containers_response {
	cmrt_mw_response_t mw_response;
	cmrt_mw_command_response_header_t cmd_header;
	cmrt_mw_command_ps_response_t cmd_response[2];
};

/**
 * @name CMRT_MW_COMMANDS
 * Commands accepted by CMRT MW in cmrt_mw_request_t.cmd.
 * @anchor CMRT_MW_COMMANDS
 * @{
 */

/**
 * Check container command is used for checking if a container can be loaded.
 * Check must be done before #CMRT_MW_LOAD_CONTAINER command is issued.
 * cmrt_mw_request_t.length must be set to size of image of container to be
 * loaded.
 * @deprecated
 */
#define CMRT_MW_CHECK_CONTAINER   0x01

/**
 * Command to load container. cmrt_mw_request_t.length must be set to
 * size of container image.
 * cmrt_mw_request_t.flowid must be set to flow ID that will be used to
 * interact or control this container. Container body must be appended
 * after cmrt_mw_request_t.
 *
 * The request can be accompanied by CMRT_MW_START_CONTAINER set in
 * the same request, which will automatically start container
 * execution once it's been successfully loaded.
 */
#define CMRT_MW_LOAD_CONTAINER    0x02

/**
 * Unload command, unloads a container. Container must be identified by its
 * flowid in cmrt_mw_request_t.flowid.
 */
#define CMRT_MW_UNLOAD_CONTAINER  0x04

/**
 * @cond INCLUDE_CRI_INTERNAL
 */
#define CMRT_MW_START_CONTAINER   0x08
#define CMRT_MW_STOP_CONTAINER    0x10

/**
 * @endcond
 * Probe command, checks container status. Container can be in one of the
 * @ref CRI_CONTAINER_STATE. If container has been unloaded or it has crashed
 * then ENOENT is returned in cmrt_mw_response_t.error.
 */
#define CMRT_MW_PROBE_CONTAINER   0x20

/*!
 * Query container information.  Returns information structure according to
 * passed in buffer size information.
 */
#define CMRT_MW_QUERY_CONTAINER   0x21

/**
 * Command returns log messages. This command is not supported for QEMU target.
 * Unlike any other command, response is in cmrt_log_header_t format.
 */
#define CMRT_MW_READ_LOGS         0x40

/**
 * Perform soft reset. MW thread is terminated and executed again.
 */
#define CMRT_MW_SOFT_RESET        0x41

#define CMRT_MW_PS_CONTAINERS     0x50

/**
 * Command from 0x60 reserved for load images (refer to common/rebel_h_sic.h)
 */

/**
 * @}
 * @name CRI_CONTAINER_STATE
 * Container status returned in cmrt_mw_response_t.status.
 * @anchor CRI_CONTAINER_STATE
 * @{
 */
#define CRI_CONTAINER_IDLE 0
#define CRI_CONTAINER_STARTING 1
#define CRI_CONTAINER_RUNNING 2
#define CRI_CONTAINER_EXIT_REQUESTED 3
#define CRI_CONTAINER_EXITING 4
#define CRI_CONTAINER_MALFUNCT 5

/*
 * ERROR CODES FROM MW.
 */
#define CMRT_MW_COMMAND_NOT_FOUND           1
#define CMRT_MW_COMMAND_NOT_SUPPORTED       2
#define CMRT_MW_CONTAINER_NOT_FOUND         3
#define CMRT_MW_CONTAINER_ALREADY_EXISTS    4
#define CMRT_MW_CONTAINER_NOT_AVAILABLE     5
#define CMRT_MW_CONTAINER_NO_MEM_AVAILABLE  6

#define CMRT_MW_DO_NOT_RESPOND 254

/**
 * @struct cmrt_mw_service_t
 * Structure used for SIC2 communications.
 */
typedef struct cmrt_mw_service cmrt_mw_service_t;
struct cmrt_mw_service {
	/* SIC context */
	cmrt_sic_t sic;
	/* Container Flow id. The flow id for MW is set via main call. */
	uint32_t flowid;
	/* Initially it takes the maximum value allowed for the container, but once
	 * a SIC read takes place, its value equals the size of the container loaded
	 * into SRAM (for the case of load operations)
	 */
	size_t buflen;
	uint32_t peerid;
	/* Before the container is loaded from SIC we only know the maximum available
	 * size, therefore we store it to calculate the offset on right aligned write
	 * operations.
	 */
	uint32_t max_buflen;
	/* It indicates whether SIC will perform an aligned to the right operation. */
	uint32_t mem_dir;
	uint8_t *buffer;
};

extern cmrt_mw_service_t srv;

/**
 * @}
 */
#endif
```
