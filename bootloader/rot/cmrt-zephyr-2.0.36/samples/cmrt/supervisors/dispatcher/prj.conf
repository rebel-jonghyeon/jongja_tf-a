## CMakeLists.txt
```
# Copyright (c) 2017-2024 Cryptography Research, Inc. (CRI).

cmake_minimum_required(VERSION 3.20.0)

find_package(Zephyr REQUIRED HINTS $ENV{ZEPHYR_BASE})
project(supervisor)

zephyr_cc_option(-Wno-pointer-arith)

if(NOT BUILDDIR)
  if(DEFINED ENV{BUILDDIR})
    set(BUILDDIR $ENV{BUILDDIR})
  else()
    set(BUILDDIR build)
  endif()
endif()

add_definitions(-DSUPERVISOR_VERSION_INFO="${SUPERVISOR_VERSION_INFO}")

target_include_directories(app
  PRIVATE
  src
  ${ZEPHYR_BASE}/include/portability
  ${ZEPHYR_BASE}
)

target_sources(                             app PRIVATE src/main.c)
target_sources(                             app PRIVATE src/cmd_echo.c)
target_sources(                             app PRIVATE src/cmd_enable_debug.c)
target_sources(                             app PRIVATE src/cmd_list.c)
target_sources(                             app PRIVATE src/cmd_sha.c)
target_sources(                             app PRIVATE src/cmd_fmc.c)
target_sources(                             app PRIVATE src/cmd_ecdsa.c)
target_sources(                             app PRIVATE src/cmd_rsa.c)
target_sources(                             app PRIVATE src/cmd_rsa_key_exch.c)
target_sources(                             app PRIVATE src/cmd_aes.c)
target_sources(                             app PRIVATE src/cmd_kdc.c)
target_sources(                             app PRIVATE src/cmd_random.c)
target_sources(                             app PRIVATE src/common.c)
target_sources(                             app PRIVATE src/rsa_padding.c)
target_sources(                             app PRIVATE src/swap_endian.c)
if(CONFIG_SHELL)
  target_sources(                           app PRIVATE src/cmrt_shell.c)
  target_sources_ifdef(CONFIG_FLASH         app PRIVATE src/flash_shell.c)
  target_sources_ifdef(CONFIG_CRI_OMC_EMULATED_OTP app PRIVATE src/shell_otp.c)
endif()
target_sources_ifdef(CONFIG_CMRT_SID        app PRIVATE src/cmd_sid.c)
target_sources_ifdef(CONFIG_CMRT_FFDH       app PRIVATE src/cmd_ffdh.c)
target_sources_ifdef(CONFIG_UART_NS16550    app PRIVATE src/cmd_uart_config.c)
target_sources_ifdef(CONFIG_CMRT_ECIES      app PRIVATE src/cmd_ecies.c)
target_sources_ifdef(CONFIG_CRI_OMC_EMULATED_OTP app PRIVATE src/cmd_otp.c)
target_sources_ifdef(CONFIG_CRI_OMC_EMULATED_OTP app PRIVATE src/oec_common.c)
target_sources(                             app PRIVATE src/cmd_ecdh.c)
target_sources_ifdef(CONFIG_CMRT_CCP        app PRIVATE src/cmd_ccp.c)
target_sources_ifdef(CONFIG_SV_PERF_MEAS    app PRIVATE src/cmd_perf.c)

target_link_libraries(app PUBLIC "-Wl,-e__reset")
```

## Kconfig
```
# Kconfig - Private config options for the Dispatcher supervisor

mainmenu "Dispatcher supervisor"

config SV_PERF_MEAS
	bool "Enable Supervisor Performance Measures"
	default y
	help
	  Enables logging Supervisor Performance Measures data and
	  dispatcher-client's 'Perf' option.

source "Kconfig.zephyr"
```

## prj.conf
```kconfig
CONFIG_CMRT_V1=y
CONFIG_MULTITHREADING=y
CONFIG_POLL=y
CONFIG_MAIN_THREAD_PRIORITY=14
CONFIG_SUPERVISOR_MODE=y
CONFIG_WDT_DISABLE_AT_BOOT=y
CONFIG_CMRT_SCRATCHPAD=y
CONFIG_CMRT_AES=y
CONFIG_CMRT_RSA=y
CONFIG_CMRT_RSA_CRT=y
#CONFIG_PIX=y
CONFIG_TEEFS=y
CONFIG_TEEFS_MAX_INSTANCES=1
CONFIG_TEEFS_MAX_PAGES=15
CONFIG_TEEFS_MAX_FILES=4
CONFIG_TEEFS_MAX_PAGE_SIZE=8
CONFIG_TEEFS_MAX_DIRS=1
CONFIG_TEEFS_MAX_CACHE_PAGES=4
CONFIG_TEEFS_MAX_BAD_BLOCKS=1
CONFIG_TEEFS_MAX_NAMELEN=64
CONFIG_CMRT_TEEDEV_DMAC=y
CONFIG_TEEDEV_DMAC_BLOCK_SIZE=12
CONFIG_TEEDEV_DMAC_PAGE_SIZE=8
CONFIG_TEEDEV_DMAC_CACHE_PAGES=4
CONFIG_MAIN_STACK_SIZE=32768
CONFIG_CMRT_SID=y
# make RELEASE_BUILD=1 unsets these
CONFIG_LOG=y
CONFIG_LOG_MODE_MINIMAL=y
CONFIG_LOG_DEFAULT_LEVEL=4
CONFIG_DEBUG=y
CONFIG_THREAD_MONITOR=y
```

## src/main.c
```c
/*
 * Copyright (c) 2020-2023 Cryptography Research, Inc. (CRI).
 * A license or authorization from CRI is needed to use this file.
 */

#include <stdalign.h>
#include <zephyr.h>
#include <stdio.h>
#include <string.h>
#include <linker/linker-defs.h>

#include <fs/teefs.h>
#ifdef CONFIG_CMRT_TEEDEV_FLASH
#include <cri/cmrt/teedev_flash.h>
#else
#include <cri/cmrt/teedev_dmac.h>
#endif

#include <uart.h>
#ifdef CONFIG_UART_NS16550
#include <drivers/serial/uart_ns16550.h>
#endif
#include <cri/cmrt/dd.h>
#include <cri/cmrt/sic.h>
#include "common.h"

#ifdef CONFIG_CMRT_NETWORKING
#include <cri/cmrt/networking.h>
/* Network config. */
static netx_config_t netx_cfg;
#endif

#include <cri/cmrt/scratchpad.h>
#include <cri/cmrt/axi_flash_layout.h>
/*
 * Sample dispatcher monolithic supervisor
 */

#ifdef CONFIG_CMRT_TEEDEV_FLASH
#define TEEFS_BASE AXI_FLASH_TEEFS_BASE
/*
 * DEMO_FS_BLOCKS = log2(number_of_blocks
 *                = log2(teefs_size / (4 * 1024)
 *                = __builtin_ctz(teefs_size >> 12)
 */
#define TEEFS_BLOCKS (__builtin_ctz(AXI_FLASH_TEEFS_SZ >> 12))
#else
/* 512KB SAC: 0x2F800 reserves 190kB for os.img, 64KB teefs and 2kB for logs */
#define TEEFS_BASE (CONFIG_RISCV_SAC_BASE_ADDR +		\
		    (CONFIG_FPGA_SAC_SIZE / 2) + 0x2F800)
#define TEEFS_BLOCKS 4 /* 1 << 4 = 16 blocks of 4k each, 64KB in total. */
#endif
#define TEEFS_MP "" /* mount point */
#define TEEFS_MPLEN (sizeof(TEEFS_MP) - 1)

#ifdef CONFIG_CMRT_AXI
#define SCRATCHPAD_START AXI_DDR_FILE_XFER_START
#define SCRATCHPAD_END (AXI_DDR_FILE_XFER_START + AXI_DDR_FILE_XFER_SIZE)
#else
#define SCRATCHPAD_START ((u32_t)&_image_ram_end)
#define SCRATCHPAD_END (CONFIG_RISCV_RAM_BASE_ADDR + KB(CONFIG_RISCV_RAM_SIZE_KB))
#endif
#define SCRATCHPAD_SIZE (SCRATCHPAD_END - SCRATCHPAD_START)

#define NO_ENCRYPTION

const static char version_info[] __used = SUPERVISOR_VERSION_INFO;

/* Update SIC.SW_BOOT_STATUS register. */
static void set_boot_status(u32_t bits, u32_t mask)
{
	u32_t value = cri_read_reg(CMRT_SIC_BASE, R_SW_BOOT_STATUS);
	value &= ~mask;
	value |= bits & mask;
	cri_write_reg(CMRT_SIC_BASE, R_SW_BOOT_STATUS, value);
}

/* The command array. */
const cmd_t *const cmds[] = {
	&cmd_list,
	&cmd_echo,
	&cmd_sha2,
	&cmd_ecdsa,
	&cmd_aes,
#ifdef CONFIG_CMRT_SID
	&cmd_sid,
#endif
#ifdef CONFIG_CMRT_FFDH
	&cmd_ffdh,
#endif
	&cmd_rsa,
#ifdef CONFIG_UART_NS16550
	&cmd_uart,
#endif
#ifdef CONFIG_CMRT_ECIES
	&cmd_ecies,
#endif
#ifdef CONFIG_CRI_OMC_EMULATED_OTP
	&cmd_otp,
#endif
	&cmd_ecdh,
#if defined(CONFIG_CMRT_S3HC) || defined (CONFIG_CMRT_S3HC2)
	&cmd_sha3,
#endif
	&cmd_random,
	&cmd_rsa_key_exch,
	&cmd_hmac,
#ifdef CONFIG_CMRT_CCP
	&cmd_ccp,
#endif
	&cmd_kdc,
	&cmd_fmc,
	&cmd_enable_debug,
#ifdef CONFIG_SV_PERF_MEAS
	&cmd_perf,
#endif
};
const u32_t nr_cmds = (sizeof(cmds) / sizeof(cmds[0]));

/* Input output buffer headers are located at the start of SAC memory. */
buffer_ctrl_t *sac_buffers = (buffer_ctrl_t *)CONFIG_RISCV_SAC_BASE_ADDR;

/*
 * Initialize SAC buffer headers.
 * Use first half for input parameters and other half for output parameters.
 */
static void init_sac_buffer_headers(void)
{
	u32_t usable_sac = (CONFIG_FPGA_SAC_SIZE/2) - sizeof(buffer_ctrl_t);
	*sac_buffers = (buffer_ctrl_t) {
		{sizeof(buffer_ctrl_t), usable_sac/2},
		{sizeof(buffer_ctrl_t) + (usable_sac/2), usable_sac/2}
	};
};

/* Return pointers to SAC buffer header fields. */
static void set_buffer_pointers(u8_t **in, u32_t **i_used, u32_t **i_size,
				u8_t **out, u32_t **o_used, u32_t **o_size)
{
	*in = (u8_t *) (CONFIG_RISCV_SAC_BASE_ADDR + sac_buffers->to_esw.offset);
	*out = (u8_t *) (CONFIG_RISCV_SAC_BASE_ADDR + sac_buffers->to_hlos.offset);
	*i_used = &sac_buffers->to_esw.used;
	*i_size = &sac_buffers->to_esw.size;
	*o_used = &sac_buffers->to_hlos.used;
	*o_size = &sac_buffers->to_hlos.size;
}

#define PRINT_BUF_CTRL() \
	printk("in 0x%8x %u/%u, out 0x%8x %u/%u\n", \
		CONFIG_RISCV_SAC_BASE_ADDR + sac_buffers->to_esw.offset, \
		sac_buffers->to_esw.used, \
		sac_buffers->to_esw.size, \
		CONFIG_RISCV_SAC_BASE_ADDR + sac_buffers->to_hlos.offset, \
		sac_buffers->to_hlos.used, \
		sac_buffers->to_hlos.size)

/* Create initial files to an empty TEEFS filesystem. */
static int create_initial_files(void)
{
	int res = 0;
#ifdef CONFIG_UART_NS16550
#define UART_CONFIG "uart_config"

	/* Initial UART configuration. */
	static const struct uart_config uc = {
		.baudrate = 115200,
		.parity = UART_CFG_PARITY_NONE,
		.stop_bits = UART_CFG_STOP_BITS_1,
		.data_bits = UART_CFG_DATA_BITS_8,
		.flow_ctrl = UART_CFG_FLOW_CTRL_NONE,
	};
	int fd1 = teefs_create(UART_CONFIG, sizeof(UART_CONFIG) - 1,
			       &uc, sizeof(uc));
	teefs_close(fd1);
	if (fd1 < 0) res = fd1;
#endif
#ifdef CONFIG_CMRT_NETWORKING
	/* Initial NETX configuration. */
	netx_cfg_set_default(&netx_cfg);
	int fd2 = teefs_create(NETX_CONFIG, sizeof(NETX_CONFIG) - 1,
			       &netx_cfg, sizeof(netx_cfg));
	teefs_close(fd2);
	if (fd2 < 0) res = fd2;
#endif
	return res;
}

#ifdef CONFIG_UART_NS16550
/* Setup configuration based on files in TEEFS filesystem. */
static int initial_uart_config(bool disable)
{
	const struct device *uart = device_get_binding("uart0");
	if (!uart) return -ENODEV;

	int res = teefs_open(UART_CONFIG, sizeof(UART_CONFIG) - 1, 0);
	if (res >= 0) {
		/* File exists, configure UART. */
		int fd = res;
		struct uart_config uc;
		size_t len = sizeof(uc);
		int res = teefs_read(fd, &uc, &len);
		teefs_close(fd);
		if ((res >= 0) && (len == sizeof(uc))) {
			res = uart_configure(uart, &uc);
			if (!res) res = uart_drv_cmd(uart, CMD_SET_NOP, 0);
			return res;
		}
	}
	if (disable) {
		printk("Disable UART due to error :%d\n", res);
		/* No file or error above, disable UART. */
		uart_drv_cmd(uart, CMD_SET_NOP, 1);
	}
	return res;
}
#endif

#ifdef CONFIG_CMRT_NETWORKING
static int initial_netx_config(void)
{
	netx_cfg_set_default(&netx_cfg);

	netx_config_t teefs_cfg;
	int res = teefs_open(NETX_CONFIG, sizeof(NETX_CONFIG) - 1, 0);
	if (res >= 0) {
		/* File exists, configure netx. */
		int fd = res;
		size_t size = sizeof(teefs_cfg);
		res = teefs_read(fd, &teefs_cfg, &size);
		(void)teefs_close(fd);
		if ((res >= 0) && (size == sizeof(teefs_cfg))) {
			printk("Setting netx config from TEEFS\n");
			memcpy(&netx_cfg, &teefs_cfg, sizeof(netx_cfg));
		}
	}
	cri_network_init_from_cfg(&netx_cfg);
	return res;
}
#endif

/*
 * Process incoming request.
 * Lookup command and call requested operation.
 */
int process_request(u32_t cmd_id,
		    u8_t *in, u32_t *i_used, u32_t *i_size,
		    u8_t *out, u32_t *o_used, u32_t *o_size)
{
	int ret = EINVAL;

	/* Forget past output. */
	*o_used = 0;
	PRINT_BUF_CTRL();

	u32_t cmd_num = cmd_id - CMDID_BASE;
	printk("cmd %d:...\n", cmd_num);
	if (*i_size < *i_used) {
		printk("Input buffer overflow!\n");
		return ret;
	}
	for (int i = 0; i < nr_cmds; i++) {
		if (cmds[i]->id == cmd_id) {
			const cmd_t *cmd = cmds[i];
			ret = cmd->run(in, *i_used, out, o_used, *o_size);
			break;
		}
	}
	printk("cmd %d: ret: %s (%d)\n", cmd_num, ret ? "Err" : "OK", ret);
	PRINT_BUF_CTRL();
	return ret;
}

static int create_filesystem(tee_device_t *dev)
{
	printk("Creating filesystem\n");
	int res = teefs_mkfs(dev, 0);
	if (res < 0) {
		printk("teefs_mkfs failed: %d!\n", res);
		return res;
	}
	res = teefs_mount(TEEFS_MP, TEEFS_MPLEN, dev, TEEFS_FLAG_AUTOSYNC);
	if (res < 0) {
		printk("teefs_mount failed: %d!\n", res);
		return res;
	}
	res = create_initial_files();
	if (res < 0) {
		printk("Failed to create initial files: %d!\n", res);
	}
	return res;
}

#define FREE_RAM_START ((u32_t)&_image_ram_end)
#define FREE_RAM_END (CONFIG_RISCV_RAM_BASE_ADDR + KB(CONFIG_RISCV_RAM_SIZE_KB))

#if 1 /* samples may have its own code, 0x5fXX, to be recognized from HLOS */
#include <drivers/cmrt/cmrt.h>
#define SUPERVISOR_SAMPLE_STARTED 0x5f020000
#endif

int main(void)
{
/* Write buffer headers to the start of SAC, client program will read it
 * before sending messages. */
	init_sac_buffer_headers();

/* Update SIC.SW_BOOT_STATUS register. */
	set_boot_status(SUPERVISOR_RUNNING_ID, SUPERVISOR_RUNNING_ID);
#ifdef SUPERVISOR_SAMPLE_STARTED
	cmrt_write_reg(CMRT_SIC_BASE, R_SCRATCH_0, SUPERVISOR_SAMPLE_STARTED);
#endif
	printk("Supervisor (dispatcher) %s running...\n", version_info);

	printk("SRAM left: %u bytes\n", FREE_RAM_END - FREE_RAM_START);

	/* Create and mount filesystem. */
#ifdef NO_ENCRYPTION
	const u8_t *path = NULL;
	size_t pathlen = 0;
#else
	const u8_t *path = "secret pin";
	size_t pathlen = strlen(path);
#endif
	tee_device_t *dev;
#ifdef CONFIG_CMRT_TEEDEV_FLASH
	dev = teedev_flash_open(TEEFS_BASE, TEEFS_BLOCKS, path, pathlen);
#else
	dev = teedev_dmac_open(TEEFS_BASE, TEEFS_BLOCKS, path, pathlen);
#endif
	if (dev == NULL) {
		printk("teedev open failed!\n");
		return -ENODEV;
	}
	int res = teefs_mount(TEEFS_MP, TEEFS_MPLEN, dev, TEEFS_FLAG_AUTOSYNC);
	if (res < 0) {
		printk("no teefs found to be mounted: %d\n", res);
		res = create_filesystem(dev);
	}
	if (res < 0) {
		printk("teefs mkfs failed: %d!\n", res);
		return -EFAULT;
	}
	printk("Filesystem mounted\n");

#ifdef CONFIG_UART_NS16550
	res = initial_uart_config(false);
	if (res < 0) {
		printk("Failed to setup initial UART config: %d!\n", res);
		/* might be intentional, just continue */
	}
#endif
#ifdef CONFIG_CMRT_NETWORKING
	res = initial_netx_config();
	if (res < 0) {
		printk("Failed to setup initial NETX config: %d!\n", res);
		/* might be intentional, just continue */
	}
#endif
	cri_scratchpad_open((void *)SCRATCHPAD_START, SCRATCHPAD_SIZE);

	u8_t *in, *out;
	u32_t *i_used, *i_size, *o_used, *o_size;
	set_buffer_pointers(&in, &i_used, &i_size, &out, &o_used, &o_size);

/* Open a SIC flow 0. */
	cri_sic_t sic = cri_sic_open(0, 0);
	if (!cri_is_valid(sic)) {
		printk("Cannot open SIC\n");
		return -ENODEV;
	}

	for (;;) {
		static alignas(4) u8_t buffer[16];
		size_t buflen = sizeof(buffer);
		u32_t peerid;

/* Set SIC receive buffer. */
		int res = cri_sic_read(sic, buffer, &buflen, &peerid);
		if (res < 0) {
			printk("Failed to setup SIC read from HLOS: %d!\n", res);
			continue;
		}

/* Wait for command from HLOS over SIC. */
		printk("Waiting for SIC command...\n");
		cri_handle_t handles = sic;
		cri_wait(1, &handles, CRI_FOREVER);
		res = cri_sic_sync(sic);
		if (res < 0) {
			printk("Failed to read from HLOS: %d!\n", res);
			continue;
		}

/* Process command. */
		printk("New command...\n");
		const struct {
			u32_t cmd_id;
		} *const r = (void *)buffer;

		if (buflen < sizeof(*r)) {
			printk("Invalid command\n");
			continue;
		}

		int rsp = process_request(r->cmd_id,
					  in, i_used, i_size,
					  out, o_used, o_size);

/* Send return code over SIC to HLOS. */
		res = cri_sic_write(sic, (u8_t *)&rsp, sizeof(rsp), peerid);
		if (res < 0) {
			printk("Failed to setup SIC write to HLOS: %d!\n", res);
			continue;
		}
	}
	return 0; /* Never reached */
}
```

## src/cmd_aes.c
```c
/*
 * Copyright (c) 2020-2023 Cryptography Research, Inc. (CRI).
 * A license or authorization from CRI is needed to use this file.
 */

#include <stdalign.h>
#include <stdio.h>
#include <string.h>

#include <device.h>
#include <cri/cmrt/aes.h>
#include <hexutil.h>

#include "common.h"

/*
 * This basic example shows how to use AES calculations.
 *
 * It handles one data block, whose size is limited by available SAC memory
 * size. It pushes almost all of the data with cri_aes_update() call. The
 * trailing non-word size data, if any, is pushed with cri_aes_final() call.
 * It is possible to support data larger than SAC memory size. For that
 * cri_aes_update() is to be called multiple times. A minimum of 4 bytes must
 * be pushed with cri_aes_update() in each call. cri_aes_update() can only
 * handle data in multiple of word sizes. Input and output buffer address must
 * always be word aligned.
 */

typedef struct {
	u32_t algorithm;
	u32_t operation;
	u8_t *key;
	u32_t keylen;
	u8_t *iv;
	u32_t ivlen;
	u8_t *aad;
	u32_t aadlen;
	u8_t *tag;
	u32_t taglen;
	u8_t *msg;
	u32_t msglen;
} input_args_t;

static int do_aes(input_args_t *args,
		  u32_t in_used,
		  void *output,
		  u32_t *out_used,
		  u32_t out_size)
{
	printk("do_aes:\n");
	/* Open and initialize AES. */
	cri_aes_t aes = cri_aes_open(0);
	if (!cri_is_valid(aes)) {
		err("Cannot open %s!\n", CONFIG_CRI_AES_NAME);
		return -ENOENT;
	}

	printk("cri_aes_init:\n");
	if (args->ivlen == 0) {
		args->iv = NULL;
	}

	int ret = cri_aes_init(aes, args->operation, args->algorithm,
			       args->key, args->keylen,
			       args->iv, args->ivlen,
			       args->taglen);
	if (ret) {
		err("AES init failed %d\n", ret);
		goto out;
	}

	/*
	 * Push most of the data.
	 * _update() can only handle data that is well aligned
	 * (address to word boundary and size to block boundary.)
	 */
	printk("cri_aes_update: %d\n", in_used & ~15);
	ret = cri_aes_update(aes, args->msg, in_used & ~15, output);
	if (ret) {
		err("AES update failed %d\n", ret);
		goto out;
	}
	/*
	 * Push any remaining data and retrieve PT/CT.
	 * It is OK if data size is not a multiple of word size (4).
	 */
	printk("cri_aes_final: %d\n", in_used & 15);
	ret = cri_aes_final(aes, (char *)(args->msg) + (in_used & ~15),
			    in_used & 15, output + (in_used & ~15));
	if (ret) {
		err("AES final failed %d\n", ret);
		goto out;
	}
	printk("Core out:\n");
	hexdump(output, args->msglen);
	*out_used = args->msglen;

out:
	/* Close AES when done. */
	cri_aes_close(aes);
	return ret;
}

static int do_aes_xts(input_args_t *args,
		      u32_t in_used,
		      void *output,
		      u32_t *out_used,
		      u32_t out_size)
{
	printk("do_aes_xts:\n");

	if ((args->keylen != 32) && (args->keylen != 64)) {
		printk("Invalid key length %d\n", args->keylen);
		return false;
	}
	if (args->ivlen != AES_BLOCK_BYTES) {
		printk("invalid XTS iv (tweak) length %d\n", args->ivlen);
		return false;
	}

	/* Open and initialize AES. */
	cri_aes_t aes = cri_aes_open(0);
	if (!cri_is_valid(aes)) {
		err("Cannot open %s!\n", CONFIG_CRI_AES_NAME);
		return -ENOENT;
	}

	printk("cri_aes_init:\n");
	int ret = cri_aes_init(aes, args->operation, args->algorithm,
			       args->key, args->keylen,
			       args->iv, args->ivlen,
			       args->taglen);
	if (ret) {
		err("AES init failed %d\n", ret);
		goto out;
	}

	/* Final must be called with at least AES_BLOCK_BYTES or 0 */
	u32_t in_final = (in_used % AES_BLOCK_BYTES) == 0 ? 0 :
		AES_BLOCK_BYTES + (in_used % AES_BLOCK_BYTES);

	if (in_used > in_final) {
		printk("cri_aes_update: %d\n", in_used - in_final);
		ret = cri_aes_update(aes, args->msg,
				     in_used - in_final, output);
		if (ret) {
			err("AES update failed %d\n", ret);
			goto out;
		}
		*out_used = in_used - in_final;
	}

	printk("cri_aes_final: %d\n", in_final);
	ret = cri_aes_final(aes, (char *)(args->msg) + *out_used,
			    in_final, output + *out_used);
	if (ret) {
		err("AES final failed %d\n", ret);
		goto out;
	}
	*out_used += in_final;

	printk("Core out:\n");
	hexdump(output, *out_used);

out:
	/* Close AES when done. */
	cri_aes_close(aes);
	return ret;
}

static int do_aes_gcm(input_args_t *args,
		      u32_t in_used,
		      void *output,
		      u32_t *out_used,
		      u32_t out_size)
{
	printk("do_aes_gcm:\n");
	if ((args->algorithm == CRI_AES_GCM) && (args->ivlen != 12)) {
		printk("invalid iv length for aes-gcm: %u\n", args->ivlen);
		return -1;
	}
	/* Open and initialize AES. */
	cri_aes_t aes = cri_aes_open(0);
	if (!cri_is_valid(aes)) {
		err("Cannot open %s!\n", CONFIG_CRI_AES_NAME);
		return -ENOENT;
	}

	printk("cri_aes_init:\n");
	if (args->ivlen == 0) {
		args->iv = NULL;
	}
	if (args->algorithm == CRI_AES_CMAC) {
		/*
		 * In case of AES CMAC, input tag is empty and
		 * it is always calculated with full length of 16 bytes.
		 */
		args->taglen = 16;
	}
	int ret = cri_aes_init(aes, args->operation, args->algorithm,
			       args->key, args->keylen,
			       args->iv, args->ivlen,
			       args->taglen);
	if (ret) {
		err("AES init failed %d\n", ret);
		goto out;
	}

	printk("cri_aes_final_aad: %d\n", args->aadlen);
	ret = cri_aes_final_aad(aes, args->aad, args->aadlen);
	if (ret) {
		err("cri_aes_final_aad failed %d\n", ret);
		goto out;
	}
	/*
	 * Push any remaining data and retrieve PT/CT.
	 * It is OK if data size is not a multiple of word size (4).
	 */
	printk("cri_aes_ae_final: %d\n", args->msglen);
	ret = cri_aes_ae_final(aes, args->msg, args->msglen, output,
			       args->tag, &args->taglen);
	if (ret) {
		err("cri_aes_ae_final failed %d\n", ret);
		goto out;
	}
	printk("Core out:\n");
	if (args->algorithm == CRI_AES_CMAC) {
		hexdump(args->tag, args->taglen);
		memcpy(output, args->tag, args->taglen);
		*out_used = args->taglen;
	} else {
		hexdump(output, args->msglen);
		if (args->operation == CRI_AES_ENCRYPT) {
			printk("Tag:\n");
			hexdump(args->tag, args->taglen);
			memcpy((u8_t *)(output + args->msglen), args->tag, args->taglen);
			*out_used = args->msglen + args->taglen;
		} else {
			*out_used = args->msglen;
		}
	}

out:
	/* Close AES when done. */
	cri_aes_close(aes);
	return ret;
}


static int do_aes_ccm(input_args_t *args,
		      u32_t in_used,
		      void *output,
		      u32_t *out_used,
		      u32_t out_size)
{
	printk("do_aes_ccm:\n");
	/* Open and initialize AES. */
	cri_aes_t aes = cri_aes_open(0);
	if (!cri_is_valid(aes)) {
		err("Cannot open %s!\n", CONFIG_CRI_AES_NAME);
		return -ENOENT;
	}

	printk("cri_aes_init:\n");
	if (args->ivlen == 0) {
		args->iv = NULL;
	}
	bool has_aad = (args->aadlen > 0);
	static u32_t b0[16];
	static u32_t bn[256];
	u32_t bnlen = 0;
	/* Prepare b0 and bn */
	int ret = cri_aes_ccm_encode_nonce(b0, sizeof(b0),
					   args->iv,
					   args->ivlen,
					   args->msglen,
					   args->taglen,
					   has_aad);

	info("b0 encode: %d\n", ret);
	if (ret < 0) {
		goto out;
	}
	ret = cri_aes_ccm_encode_aad(bn, sizeof(bn), args->aad, args->aadlen);
	if (ret < 0) {
		err("cri_aes_ccm_encode_aad failed %d\n", ret);
		goto out;
	}
	bnlen = ret;
	ret = cri_aes_init(aes, args->operation, args->algorithm,
			   args->key, args->keylen,
			   b0, sizeof(b0),
			   args->taglen);
	if (ret) {
		err("AES init failed %d\n", ret);
		goto out;
	}

	ret = cri_aes_final_aad(aes, bn, bnlen);
	if (ret) {
		err("cri_aes_final_aad failed %d\n", ret);
		goto out;
	}
	/*
	 * Push any remaining data and retrieve PT/CT.
	 * It is OK if data size is not a multiple of word size (4).
	 */
	ret = cri_aes_ae_final(aes, args->msg, args->msglen, output,
			       args->tag, &args->taglen);
	if (ret) {
		err("cri_aes_ae_final failed %d\n", ret);
		goto out;
	}
	printk("Core out:\n");
	hexdump(output, args->msglen);
	if (args->operation == CRI_AES_ENCRYPT) {
		printk("Tag:\n");
		hexdump(args->tag, args->taglen);
		memcpy((u8_t *)(output + args->msglen), args->tag, args->taglen);
		*out_used = args->msglen + args->taglen;
	} else {
		*out_used = args->msglen;
	}

out:
	/* Close AES when done. */
	cri_aes_close(aes);
	return ret;
}

typedef struct {
	u32_t algorithm;
	u32_t encrypt;
	u32_t keylen;
	u32_t ivlen;
	u32_t aadlen;
	u32_t taglen;
	u32_t msglen;
	u8_t data[0];
} aes_args_t;

#ifdef CONFIG_SV_PERF_MEAS
static const char *aes_mode_names[] = {
		"ECB",
		"CBC",
		"CFB",
		"CTR",
		"GCM",
		"CCM",
		"XTS",
		"CMAC"
};

static const char *aes_operation_names[] = {
		"ENCRYPTION",
		"DECRYPTION"
};
#endif

static int aes_run(void *input, u32_t in_used,
		   void *output, u32_t *out_used, u32_t out_size)
{
#ifdef CONFIG_SV_PERF_MEAS
	u32_t cycles;
	plog_reset();
	plog_set_ref();
#endif
	int ret;

	printk("aes_run:\n");
	aes_args_t *c = (aes_args_t *) input;

	char *key_offset = c->data;
	char *iv_offset = key_offset + ((c->keylen + 3) & ~3);
	char *aad_offset = iv_offset + ((c->ivlen + 3) & ~3);
	char *tag_offset = aad_offset + ((c->aadlen + 3) & ~3);
	char *msg_offset = tag_offset;
	if (c->encrypt == CRI_AES_DECRYPT) {
		msg_offset = tag_offset + ((c->taglen + 3) & ~3);
	}

	input_args_t input_args = {
		 .algorithm = c->algorithm,
		 .operation = c->encrypt,
		 .key = key_offset,
		 .keylen = c->keylen,
		 .iv = iv_offset,
		 .ivlen = c->ivlen,
		 .aad = aad_offset,
		 .aadlen = c->aadlen,
		 .tag = tag_offset,
		 .taglen = c->taglen,
		 .msg = msg_offset,
		 .msglen = c->msglen
	};

	printk("algorithm: %d\n", c->algorithm);
	printk("operation: %d\n", c->encrypt);
	printk("key: %d\n", c->keylen);
	hexdump(input_args.key, c->keylen);
	printk("iv: %d\n", c->ivlen);
	hexdump(input_args.iv, c->ivlen);
	printk("aad: %d\n", c->aadlen);
	hexdump(input_args.aad, c->aadlen);
	printk("tag: %d\n", c->taglen);
	hexdump(input_args.tag, c->taglen);
	printk("msg: %d\n", c->msglen);
	hexdump(input_args.msg, c->msglen);
	printk("in_used: %d\n", in_used);

	if (c->algorithm == CRI_AES_GCM || c->algorithm == CRI_AES_CMAC) {
		ret = do_aes_gcm(&input_args,
				 c->msglen,
				 output,
				 out_used,
				 out_size);
	} else if (c->algorithm == CRI_AES_CCM) {
		ret = do_aes_ccm(&input_args,
				 c->msglen,
				 output,
				 out_used,
				 out_size);
	} else if (c->algorithm == CRI_AES_XTS) {
		ret = do_aes_xts(&input_args,
				 c->msglen,
				 output,
				 out_used,
				 out_size);
	} else {
		ret = do_aes(&input_args,
			     c->msglen,
			     output,
			     out_used,
			     out_size);
	}

#ifdef CONFIG_SV_PERF_MEAS
	cycles = plog_get_cycles();
	plog("AES,AES-%s,%s,%d,%d,%u", aes_mode_names[c->algorithm],
		aes_operation_names[c->encrypt], c->msglen, c->keylen * 8, cycles);
#endif
	return ret;
}

const cmd_t cmd_aes = { CMDID_AES, "AES",
			"Compute AES over input data", aes_run };
```

## src/cmd_ccp.c
```c
/*
 * Copyright (c) 2021 Cryptography Research, Inc. (CRI).
 * A license or authorization from CRI is needed to use this file.
 */

#include <stdalign.h>
#include <stdio.h>
#include <string.h>

#include <device.h>
#include <cri/cmrt/ccp.h>

#include "common.h"

/*
 * Examples for chacha20, Poly1305, and ChachaPoly usage
 */

typedef struct {
	u32_t op;
	u32_t mode;
	u32_t keylen;
	u32_t ivlen;
	u32_t aadlen;
	u32_t taglen;
	u32_t msglen;
	u8_t data[0];
} ccp_args_t;

static bool verify_inputs(const ccp_args_t *args);

static int do_ccp_operation(ccp_args_t * const args, u32_t in_used,
			    void * const output, u32_t * const out_used)
{
	printk("do_ccp_operation:\n");
	cri_ccp_t ccp = cri_ccp_open(0);
	if (!cri_is_valid(ccp)) {
		err("CCP context open failed\n");
		return -EIO;
	}

	printk("ccp operation: %s\n",
	       args->op == CIPHER_OP_ENCRYPT ? "encrypt" : "decrypt");

	const char * const key = args->data;
	const char * const iv = key + ((args->keylen + 3) & ~3);
	const char * const aad = iv + ((args->ivlen + 3) & ~3);
	const char * const tag_in = aad + ((args->aadlen + 3) & ~3);
	const char *msg = tag_in + ((args->taglen + 3) & ~3);

	DEBUG_HEXDUMP_VAR(key, args->keylen);
	DEBUG_HEXDUMP_VAR(iv, args->ivlen);
	DEBUG_HEXDUMP_VAR(aad, args->aadlen);
	DEBUG_HEXDUMP_VAR(tag_in, args->taglen);
	DEBUG_HEXDUMP_VAR(msg, args->msglen);

	int res = -EINVAL;
	const int block = args->mode == CCP_MODE_POLY ?
		POLY_BLOCK_BYTES : CHACHA_BLOCK_BYTES;
	int taglen = args->mode == CCP_MODE_CHACHA ? 0 : POLY_TAG_LENGTH_BYTES;

	res = cri_ccp_init(ccp, args->op, args->mode, key, args->keylen,
			   args->ivlen == 0 ? NULL : iv, args->ivlen, taglen);
	if (res != 0) {
		err("cri_ccp_init() failed %d\n", res);
		goto out;
	}

	if (args->mode == CCP_MODE_CHACHA_POLY_AEAD) {
		res = cri_ccp_final_aad(ccp, aad, args->aadlen);
		if (res != 0) {
			err("cri_ccp_final_aad() failed %d\n", res);
			goto out;
		}
	}

	u32_t len = args->msglen;
	char *out = output;
	alignas(4) u8_t out_block[CHACHA_BLOCK_BYTES] = {0};
	for (; len > block; len -= block) {
		if (args->mode == CCP_MODE_POLY) {
			res = cri_ccp_update_aad(ccp, msg, block);
		} else {
			res = cri_ccp_update(ccp, msg, block, out_block);
			memcpy(out, &out_block, block);
			out += block;
		}
		if (res != 0) {
			err("ccp update failed %d\n", res);
			goto out;
		}
		msg += block;
	}

	alignas(4) u8_t tag[POLY_TAG_LENGTH_BYTES] = {0};
	switch (args->mode) {
	case CCP_MODE_CHACHA:
		res = cri_ccp_final(ccp, msg, len, out_block);
		if (res != 0) {
			err("cri_ccp_final() failed %d\n", res);
			goto out;
		}
		memcpy(out, &out_block, len);
		*out_used = args->msglen;
		break;
	case CCP_MODE_CHACHA_POLY_AEAD:
		if (args->op == CIPHER_OP_DECRYPT) {
			memcpy(tag, tag_in, taglen);
		}
		res = cri_ccp_ae_final(
			ccp, msg, len, out_block, tag, &taglen);
		if (res != 0) {
			err("cri_ccp_ae_final() failed %d\n", res);
			goto out;
		}
		memcpy(out, &out_block, len);
		*out_used = args->msglen;
		if (args->op == CIPHER_OP_ENCRYPT) {
			memcpy(out + len, &tag, taglen);
			DEBUG_HEXDUMP_VAR(tag, taglen);
			*out_used += taglen;
		}
		res = cri_ccp_invalidate_key(ccp, 0);
		if (res != 0) {
			err("cri_ccp_invalidate_key() failed %d\n", res);
			goto out;
		}
		break;
	case CCP_MODE_POLY:
		res = cri_ccp_final_aad(ccp, msg, len);
		if (res != 0) {
			err("cri_ccp_final_aad() failed %d\n", res);
			goto out;
		}
		res = cri_ccp_ae_final(ccp, NULL, 0, NULL, out_block, &taglen);
		if (res != 0) {
			err("cri_ccp_ae_final() failed %d\n", res);
			goto out;
		}
		memcpy(out, &out_block, taglen);
		*out_used = taglen;
		break;
	default:
		goto out;
	}
	DEBUG_HEXDUMP_VAR(output, *out_used);
 out:
	cri_ccp_close(ccp);
	return res;
}

static int ccp_run(void *input, u32_t in_used,
		   void *output, u32_t *out_used, u32_t out_size)
{
	printk("ccp_run:\n");
	ccp_args_t *args = (ccp_args_t *) input;
	if (!verify_inputs(args)) {
		return -EINVAL;
	}
	return do_ccp_operation(args, in_used, output, out_used);
}

const cmd_t cmd_ccp = { CMDID_CCP, "CCP",
			 "Run ChachaPoly operations", ccp_run };

static bool verify_inputs(const ccp_args_t * const args)
{
	bool res = true;
	switch (args->mode) {
	case CCP_MODE_CHACHA:
		if ((args->taglen != 0) || (args->aadlen != 0)) {
			err("Invalid mode chacha input\n");
			res = false;
		}
		break;
	case CCP_MODE_POLY:
		if ((args->ivlen != 0) ||
		    (args->msglen == 0) ||
		    (args->op == CIPHER_OP_DECRYPT)) {
			err("Invalid mode poly input\n");
			res = false;
		}
		break;
	case CCP_MODE_CHACHA_POLY_AEAD:
		if ((args->op == CIPHER_OP_DECRYPT) &&
		    (args->taglen != POLY_TAG_LENGTH_BYTES)) {
			err("Invalid mode chachapoly input\n");
			res = false;
		}
		break;
	default:
		err("Invalid ccp mode %d\n", args->mode);
		res = false;
		break;
	}
	if ((args->op != CIPHER_OP_ENCRYPT) &&
	    (args->op != CIPHER_OP_DECRYPT)) {
		err("Invalid ccp operation %d\n", args->op);
		res = false;
	}
	if ((args->op == CIPHER_OP_ENCRYPT) && (args->taglen != 0)) {
		err("Tag length should be zero during encrypt\n");
		res = false;
	}
	return res;
}
```

## src/cmd_ecdh.c
```c
/*
 * Copyright (c) 2021-2023 Cryptography Research, Inc. (CRI).
 * A license or authorization from CRI is needed to use this file.
 */

#include <stdalign.h>
#include <stdio.h>
#include <string.h>
#include <device.h>
#include <cri/cmrt/pke.h>

#include "common.h"

/*
 * The following example shows how to perform a basic ECDH operation.
 */

typedef struct {
	u32_t mode;
	u32_t curve;
	u32_t curve_len;
	u8_t data[0];
} ecdh_args_t;

enum { MAX_KEY_SIZE = 68 };

static int sync(cri_pke_t pke, int res)
{
	if (res >= 0) {
		res = cri_pke_sync(pke);
	}
	return res;
}

static int do_ecdh_operation(ecdh_args_t *args,
			     u32_t in_used,
			     void *output,
			     u32_t *out_used)
{
	printk("do_ecdh_operation:\n");
	/*************************/
#ifdef CONFIG_SV_PERF_MEAS
	u32_t cycles;

	plog_reset();
	plog_set_ref();
#endif

	const u32_t key_size = args->curve_len;
	u8_t *priv_key = args->data;
	HEXDUMP_VAR(priv_key, key_size);

	/* Open and initialize */
	cri_pke_t pke = cri_pke_open(CRI_O_SYNC);
	int ret = cri_is_valid(pke);
	if (!ret) {
		err("Cannot open %s!\n", CONFIG_CRI_PKE_NAME);
		return -EIO;
	}

	printk("cri_pke_get_curve: 0x%x\n", args->curve);
	cri_ecc_curve_t curve = cri_pke_get_curve(args->curve);
	if (curve == NULL) {
		err("Failed to obtain a curve: %u\n", args->curve);
		ret = -ENOENT;
		goto out;
	}

	alignas(4) u8_t key[MAX_KEY_SIZE] = {0};

	switch (args->mode) {
	case 0: {
		u8_t *peer_key = priv_key + ((key_size + 3) & ~3);
		HEXDUMP_VAR(peer_key, key_size);
		if (args->curve == CRI_ECC_CURVE_448 ||
		    args->curve == CRI_ECC_CURVE_25519){
			printk("cri_pke_rfc7748:\n");
#ifdef CONFIG_SV_PERF_MEAS
			plog_set_ref();
#endif
			ret = cri_pke_rfc7748(pke, curve, priv_key,
					      peer_key, key);
			ret = sync(pke, ret);
#ifdef CONFIG_SV_PERF_MEAS
			cycles = plog_get_cycles();
			plog("PKE_cri_pke_rfc7748,0x%x,%d,%u", args->curve, key_size*8, cycles);
#endif

		} else {
			printk("cri_pke_ecdh:\n");
#ifdef CONFIG_SV_PERF_MEAS
			plog_set_ref();
#endif
			ret = cri_pke_ecdh(pke, curve, priv_key, peer_key, key);
			ret = sync(pke, ret);
#ifdef CONFIG_SV_PERF_MEAS
			cycles = plog_get_cycles();
			plog("PKE_cri_pke_ecdh,0x%x,%d,%u", args->curve, key_size*8, cycles);
#endif
		}
		break;
	}
	case 1: {
		if (args->curve == CRI_ECC_CURVE_448 ||
		    args->curve == CRI_ECC_CURVE_25519) {
			printk("cri_pke_rfc7748_keygen:\n");
#ifdef CONFIG_SV_PERF_MEAS
			plog_set_ref();
#endif
			ret = cri_pke_rfc7748_keygen(pke, curve, priv_key, key);
			ret = sync(pke, ret);
#ifdef CONFIG_SV_PERF_MEAS
			cycles = plog_get_cycles();
			plog("PKE_cri_pke_ecdh_rfc7748_keygen,0x%x,%d,%u",
			     args->curve, key_size*8, cycles);
#endif
		} else {
			printk("cri_pke_ecdh_keygen:\n");
#ifdef CONFIG_SV_PERF_MEAS
			plog_set_ref();
#endif
			ret = cri_pke_ecdh_keygen(pke, curve, priv_key, key);
			ret = sync(pke, ret);
#ifdef CONFIG_SV_PERF_MEAS
			cycles = plog_get_cycles();
			plog("PKE_cri_pke_ecdh_keygen,0x%x,%d,%u", args->curve, key_size*8, cycles);
#endif
		}
		break;
	}
	default: {
		err("Unsupported ECDH mode: %d\n", args->mode);
		ret = -ENOENT;
		goto out;
	}
	}

	if (ret) {
		err("Cri pke ecdh operation failed: %d\n", ret);
		ret = -ENOENT;
		goto out;
	}

	hexdump_var("secret", key, key_size);
	memcpy(output, &key, key_size);
	*out_used = key_size;

 out:
	/* Close always */
	cri_pke_close(pke);
	return ret;
}

static int ecdh_run(void *input, u32_t in_used,
		    void *output, u32_t *out_used, u32_t out_size)
{
	printk("ecdh_run:\n");
	ecdh_args_t *args = (ecdh_args_t *) input;
	return do_ecdh_operation(args, in_used, output, out_used);
}

const cmd_t cmd_ecdh = { CMDID_ECDH, "ECDH",
			 "Run ECDH key exchange operations", ecdh_run };
```

## src/cmd_ecdsa.c
```c
/*
 * Copyright (c) 2020-2023 Cryptography Research, Inc. (CRI).
 * A license or authorization from CRI is needed to use this file.
 */

#include <stdalign.h>
#include <stdio.h>
#include <string.h>

#include <device.h>
#include <cri/cmrt/pke.h>
#include <cri/cmrt/hc.h>

#include "common.h"


/*
 * This basic example shows how to use ECDSA calculations.
 *
 * Key and signature parameters are big endian numbers and size of those
 * must match the size of the curve (i.e. 384 bits for P-384 and so on).
 * When input parameters are serialized, padding may need to be added so
 * all parameters are addressed from word-aligned locations. This is
 * particularly important with P521 curve since key size is 521 bits,
 * meaning 65 bytes plus one bit. If hash len is longer than key len,
 * the bytes beyond the key len are ignored.
 *
 * Following example handles one data block, whose size is limited by available
 * SAC memory size. It pushes almost all of the data with cri_ecdsa_update()
 * call. The trailing non-word size data, if any, is pushed with
 * cri_ecdsa_final() call. It is possible to support data larger than SAC
 * memory size. For that cri_ecdsa_update() is to be called multiple times.
 * A minimum of 4 bytes must be pushed with cri_ecdsa_update() in each call.
 * cri_ecdsa_update() can only handle data in multiple of word sizes.
 * Input and output buffer address must always be word aligned.
 */

typedef struct {
	u32_t mode;
	u32_t curve;
	u32_t algorithm;
	u32_t keylen;
	u32_t siglen;
	u32_t msglen;
	u8_t data[0];
} ecdsa_args_t;

enum { MAX_SIG_LEN = 68 };

static int do_ecdsa_sign(ecdsa_args_t *args,
			 u32_t in_used,
			 void *output,
			 u32_t *out_used)
{
	printk("do_ecdsa_sign:\n");
#ifdef CONFIG_SV_PERF_MEAS
	u32_t cycles;
#endif
	u8_t *priv_key = args->data;
	u8_t *msg      = priv_key + ((args->keylen + 3) & ~3);

	HEXDUMP_VAR(priv_key, args->keylen);
	HEXDUMP_VAR(msg, args->msglen);

	/* Open and initialize PKE */
	cri_pke_t pke = cri_pke_open(0);
	if (!cri_is_valid(pke)) {
		err("Cannot open %s!\n", CONFIG_CRI_PKE_NAME);
		return -EIO;
	}
	printk("cri_pke_get_curve: 0x%x\n", args->curve);
	cri_ecc_curve_t curve = cri_pke_get_curve(args->curve);
	int ret;
	if (!curve) {
		err("Failed to obtain a curve: %d\n", args->curve);
		ret = -ENOENT;
		goto out;
	}
	alignas(4) u8_t sig_r_out[MAX_SIG_LEN] = {0};
	alignas(4) u8_t sig_s_out[MAX_SIG_LEN] = {0};
	if (args->curve == CRI_ECC_CURVE_ED448 ||
	    args->curve == CRI_ECC_CURVE_ED25519) {
		printk("cri_pke_eddsa_sign:\n");
#ifdef CONFIG_SV_PERF_MEAS
		plog_set_ref();
#endif
		ret = cri_pke_eddsa_sign(pke, curve, priv_key,
					 msg, args->msglen,
					 &sig_r_out, &sig_s_out);
#ifdef CONFIG_SV_PERF_MEAS
		cycles = plog_get_cycles();
		plog("PKE_cri_pke_eddsa_sign,0x%x,%d,%u", args->curve, args->keylen * 8, cycles);
#endif
	} else {
		printk("cri_pke_ecdsa_sign:\n");
#ifdef CONFIG_SV_PERF_MEAS
		plog_set_ref();
#endif
		ret = cri_pke_ecdsa_sign_hash(pke, curve, priv_key,
					      msg, args->msglen,
					      &sig_r_out, &sig_s_out);
#ifdef CONFIG_SV_PERF_MEAS
		cycles = plog_get_cycles();
		plog("PKE_cri_pke_ecdsa_sign_hash,0x%x,%d,%u",
		     args->curve, args->keylen * 8, cycles);
#endif
	}
	if (ret) {
		err("ecdsa/eddsa sign failed: %d\n", ret);
		ret = -ENOENT;
		goto out;
	}
	ret = cri_pke_sync(pke);
	printk("Core out:\n");
	HEXDUMP_VAR(sig_r_out, args->siglen);
	HEXDUMP_VAR(sig_s_out, args->siglen);
	memcpy(output, &sig_r_out, args->siglen);
	memcpy(output + args->siglen, &sig_s_out, args->siglen);
	*out_used = args->siglen*2;
 out:
	/* Close PKE when done */
	if (cri_is_valid(pke))
		cri_pke_close(pke);
	return ret;
}

static int do_ecdsa_verify(ecdsa_args_t *args,
			   u32_t in_used,
			   void *output,
			   u32_t *out_used)
{
	printk("do_ecdsa_verify:\n");
#ifdef CONFIG_SV_PERF_MEAS
	u32_t cycles;
#endif
	u8_t *pub_x = args->data;
	u8_t *pub_y = pub_x + ((args->keylen + 3) & ~3);
	u8_t *sig_r = pub_y + ((args->keylen + 3) & ~3);
	u8_t *sig_s = sig_r + ((args->siglen + 3) & ~3);
	u8_t *msg   = sig_s + ((args->siglen + 3) & ~3);

	HEXDUMP_VAR(pub_x, args->keylen);
	HEXDUMP_VAR(pub_y, args->keylen);
	HEXDUMP_VAR(sig_r, args->siglen);
	HEXDUMP_VAR(sig_s, args->siglen);
	HEXDUMP_VAR(msg, args->msglen);

	u32_t *result = output;
	result[0] = 0x1; /* FAIL */
	*out_used = 1;

	/* Open and initialize PKE */
	cri_pke_t pke = cri_pke_open(0);
	if (!cri_is_valid(pke)) {
		err("Cannot open %s!\n", CONFIG_CRI_PKE_NAME);
		return -EIO;
	}
	printk("cri_pke_get_curve: %d\n", args->curve);
	cri_ecc_curve_t curve = cri_pke_get_curve(args->curve);
	int ret;
	if (!curve) {
		err("Failed to obtain a curve: %d\n", args->curve);
		ret = -ENOENT;
		goto out;
	}
	const bool eddsa_curve =
		args->curve == CRI_ECC_CURVE_ED448 ||
		args->curve == CRI_ECC_CURVE_ED25519;

	/* Verify ECDSA signature */
	if (eddsa_curve) {
		printk("cri_pke_eddsa_verify:\n");
#ifdef CONFIG_SV_PERF_MEAS
		plog_set_ref();
#endif
		ret = cri_pke_eddsa_verify(pke, curve, pub_x, msg, args->msglen,
					   sig_r, sig_s, NULL);
#ifdef CONFIG_SV_PERF_MEAS
		cycles = plog_get_cycles();
		plog("PKE_cri_pke_eddsa_verify,0x%x,%d,%u", args->curve, args->keylen * 8, cycles);
#endif
	} else {
		printk("cri_pke_ecdsa_verify:\n");
#ifdef CONFIG_SV_PERF_MEAS
		plog_set_ref();
#endif
		ret = cri_pke_ecdsa_verify_hash(pke, curve, pub_x, pub_y,
						msg, args->msglen,
						sig_r, sig_s, NULL);
#ifdef CONFIG_SV_PERF_MEAS
		cycles = plog_get_cycles();
		plog("PKE_cri_pke_ecdsa_verify_hash,0x%x,%d,%u",
		     args->curve, args->keylen * 8, cycles);
#endif
	}
	if (ret) {
		err("ecdsa/eddsa verify failed: %d\n", ret);
		ret = -ENOENT;
		goto out;
	}
	ret = cri_pke_sync(pke);
	if (ret == 0) {
		result[0] = 0x0; /* PASS */
	}
	ret = 0; /* verify failure is not an error */
	printk("Core out: %d\n", result[0]);
 out:
	/* Close PKE when done */
	if (cri_is_valid(pke))
		cri_pke_close(pke);
	return ret;
}

static int do_ecdsa_keygen(ecdsa_args_t *args, u32_t in_used,
			   void *output, u32_t *out_used)
{
	printk("do_ecdsa_keygen:\n");
#ifdef CONFIG_SV_PERF_MEAS
	u32_t cycles;
#endif
	hexdump_var("priv_key", args->data, args->keylen);

	/* Open and initialize PKE */
	cri_pke_t pke = cri_pke_open(0);
	if (!cri_is_valid(pke)) {
		err("Cannot open %s!\n", CONFIG_CRI_PKE_NAME);
		return -EIO;
	}
	printk("cri_pke_get_curve: 0x%x\n", args->curve);
	cri_ecc_curve_t curve = cri_pke_get_curve(args->curve);
	const bool eddsa_curve =
		args->curve == CRI_ECC_CURVE_ED448 ||
		args->curve == CRI_ECC_CURVE_ED25519;
	int ret;
	if (!curve) {
		err("Failed to obtain a curve: %d\n", args->curve);
		ret = -ENOENT;
		goto out;
	}
	alignas(4) u8_t pub_x_out[MAX_SIG_LEN] = {0};
	alignas(4) u8_t pub_y_out[MAX_SIG_LEN] = {0};
	if (eddsa_curve) {
		printk("cri_pke_eddsa_keygen:\n");
#ifdef CONFIG_SV_PERF_MEAS
		plog_set_ref();
#endif
		ret = cri_pke_eddsa_keygen(
			pke, curve, args->data, &pub_x_out);
#ifdef CONFIG_SV_PERF_MEAS
		cycles = plog_get_cycles();
		plog("PKE_cri_pke_eddsa_keygen,0x%x,%d,%u", args->curve, args->keylen * 8, cycles);
#endif
	} else {
		printk("cri_pke_ecdsa_keygen:\n");
#ifdef CONFIG_SV_PERF_MEAS
		plog_set_ref();
#endif
		ret = cri_pke_ecdsa_keygen(
			pke, curve, args->data, &pub_x_out, &pub_y_out);
#ifdef CONFIG_SV_PERF_MEAS
		cycles = plog_get_cycles();
		plog("PKE_cri_pke_ecdsa_keygen,0x%x,%d,%u", args->curve, args->keylen * 8, cycles);
#endif
	}
	if (ret) {
		err("ecdsa/eddsa keygen failed: %d\n", ret);
		ret = -ENOENT;
		goto out;
	}
	ret = cri_pke_sync(pke);
	printk("Core out:\n");
	HEXDUMP_VAR(pub_x_out, args->keylen);
	memcpy(output, &pub_x_out, args->keylen);
	*out_used = args->keylen;
	if (!eddsa_curve) {
		HEXDUMP_VAR(pub_y_out, args->keylen);
		memcpy(output + args->keylen, &pub_y_out, args->keylen);
		*out_used = args->keylen*2;
	}
 out:
	/* Close PKE when done */
	if (cri_is_valid(pke))
		cri_pke_close(pke);
	return ret;
}

static int ecdsa_run(void *input, u32_t in_used,
		     void *output, u32_t *out_used, u32_t out_size)
{
	printk("ecdsa_run:\n");
#ifdef CONFIG_SV_PERF_MEAS
	plog_reset();
#endif

	ecdsa_args_t *args = (ecdsa_args_t *) input;
	int ret;
	switch (args->mode) {
	case 0:
		ret = do_ecdsa_sign(args, in_used, output, out_used);
		break;
	case 1:
		ret = do_ecdsa_verify(args, in_used, output, out_used);
		break;
	case 2:
		ret = do_ecdsa_keygen(args, in_used, output, out_used);
		break;
	default:
		ret = -EINVAL;
		break;
	}
	return ret;
}

const cmd_t cmd_ecdsa = { CMDID_ECDSA, "ECDSA",
			  "Compute ECDSA over input data", ecdsa_run };
```

## src/cmd_echo.c
```c
/*
 * Copyright (c) 2020-2021 Cryptography Research, Inc. (CRI).
 * A license or authorization from CRI is needed to use this file.
 */

#include <stdio.h>
#include <string.h>

#include "common.h"

/* Simple command to echo back input data. */

static int echo_run(void *input, u32_t in_used,
		    void *output, u32_t *out_used, u32_t out_size)
{
	info("Echo command: input data size %u output buffer size %u\n",
	     in_used, out_size);

	if (in_used > out_size) {
		err("Output buffer is too small %u vs %u\n",
		    in_used, *out_used);
		return -ENOSPC;
	}

	memcpy(output, input, ROUND_UP(in_used, 4));
	*out_used = in_used;
	return 0;
}

const cmd_t cmd_echo = { CMDID_ECHO, "Echo",
			 "Simply return input data", echo_run };
```

## src/cmd_ecies.c
```c
/*
 * Copyright (c) 2021-2023 Cryptography Research, Inc. (CRI).
 * A license or authorization from CRI is needed to use this file.
 */

#include <string.h>
#include <cri/cmrt/ecies.h>

#include "common.h"

/*
  * This basic example shows how to use ECIES operations.
 *
 * It handles one data block, whose size is limited by available SAC memory
 * size. It pushes almost all of the data with cri_ecies_update() call. The
 * trailing non-word size data, if any, is pushed with cri_ecies_final() call.
 * It is possible to support data larger than SAC memory size. For that
 * cri_ecies_update() is to be called multiple times. A minimum of 16 bytes must
 * be pushed with cri_ecies_update() in each call. cri_ecies_update() can only
 * handle data in multiple of word sizes. Input and output buffer address must
 * always be word aligned.
 */

enum { AES_BLOCK_BYTES = 16 };

typedef enum {
	/* Close devices and reset context. */
	ECIES_CMD_CLOSE = 0,
	/* Set up encryption operation. */
	ECIES_CMD_ENCRYPT_INIT = 1,
	/* Feed block aligned size PT and receive CT */
	ECIES_CMD_ENCRYPT_UPDATE = 2,
	/* Feed the rest of PT and optional shared info,
	 * receive CT and tag. */
	ECIES_CMD_ENCRYPT_FINAL = 3,
	/* Set up decryption operation. */
	ECIES_CMD_DECRYPT_INIT = 4,
	/* Feed block aligned size CT and receive PT */
	ECIES_CMD_DECRYPT_UPDATE = 5,
	/* Feed the rest of CT, tag and optional shared info,
	 * receive PT and verification result. */
	ECIES_CMD_DECRYPT_FINAL = 6,
} ecies_cmd_t;

typedef struct {
	ecies_cmd_t cmd;
	uint32_t hc_id;
	cri_ecies_mode_t mode;
	size_t textlen;
	size_t sharedinfolen;
	size_t taglen;
	uint8_t data[0];
} ecies_args_t;

typedef struct {
	cri_ecies_t ecies;
	size_t curvelen;
	size_t hashlen;
} ecies_context_t;
static ecies_context_t context = { CRI_INVALID_HANDLE, 0, 0 };

#define ROUNDUP(n, align) (((n) + align - 1) & (~(align - 1)))

static void ecies_close(void)
{
	if (cri_is_valid(context.ecies)) {
		cri_ecies_close(context.ecies);
	}
	memset(&context, 0, sizeof(context));
	context.ecies = CRI_INVALID_HANDLE;
}

static int ecies_open(uint32_t hc_id, cri_ecies_mode_t mode)
{
	switch (mode) {
	case CRI_ECIES_P256_KDF1_SHA256_AES128_HMAC_SHA256:
		context.hashlen = 32;
		context.curvelen = 32;
		break;
	case CRI_ECIES_P384_KDF1_SHA384_AES128_HMAC_SHA384:
		context.hashlen = 48;
		context.curvelen = 48;
		break;
	case CRI_ECIES_P521_KDF1_SHA512_AES256_HMAC_SHA512:
		context.hashlen = 64;
		context.curvelen = 66;
		break;
	default:
		err("Invalid mode: %u\n", mode);
		return -EINVAL;
	}

	uint32_t oflags = (hc_id == 2) ? CRI_ECIES_O_USE_HC2 : 0;
	context.ecies = cri_ecies_open(oflags);
	if (!cri_is_valid(context.ecies)) {
		err("Cannot open ECIES\n");
		memset(&context, 0, sizeof(context));
		return -EBUSY;
	}

	return 0;
}

static int ecies_run(void *input, uint32_t in_used, void *output, uint32_t *out_used,
		     uint32_t out_size)
{
	int rc = 0;
	*out_used = 0;
	printk("ecies_run:\n");

	ecies_args_t *args = (ecies_args_t *) input;
	printk("cmd: %u\n", args->cmd);

	if (out_size < sizeof(ecies_args_t)) {
		err("output buffer too small\n");
		return -ENOSPC;
	}
	ecies_args_t *argsout = (ecies_args_t *) output;
	argsout->cmd = args->cmd;
	argsout->textlen = 0;

	switch (args->cmd) {
	case ECIES_CMD_CLOSE:
		ecies_close();
		break;
	case ECIES_CMD_ENCRYPT_INIT: {
		printk("encrypt init hc%u mode:%u\n", args->hc_id, args->mode);
		ecies_close();
		rc = ecies_open(args->hc_id, args->mode);
		if (rc) {
			break;
		}
		/* peerpubx in, pub_key out */
		rc = cri_ecies_init(context.ecies, args->mode,
				    CRI_ECIES_ENCRYPT, NULL, context.curvelen,
				    args->data, context.curvelen, argsout->data,
				    context.curvelen);
		if (rc == 0) {
			argsout->textlen = context.curvelen;
		}
		break;
	}
	case ECIES_CMD_ENCRYPT_UPDATE:
		printk("encrypt update %u:\n", args->textlen);
		rc = cri_ecies_update(context.ecies, args->data, args->textlen,
				      argsout->data);
		if (rc == 0) {
			argsout->textlen = args->textlen;
		}
		break;
	case ECIES_CMD_ENCRYPT_FINAL: {
		argsout->taglen = context.hashlen;
		printk("encrypt final text:%u sharedinfo:%u, tag:%u\n",
		       args->textlen, args->sharedinfolen, argsout->taglen);
		size_t textlen_aligned = ROUNDUP(args->textlen, 4);
		rc = cri_ecies_final(context.ecies, args->data, args->textlen,
				     args->data + textlen_aligned,
				     args->sharedinfolen,
				     argsout->data + argsout->taglen,
				     argsout->data,
				     argsout->taglen);
		if (rc == 0) {
			argsout->textlen = textlen_aligned;
			*out_used += argsout->taglen;
		}
		break;
	}
	case ECIES_CMD_DECRYPT_INIT: {
		printk("decrypt init hc%u mode:%u\n", args->hc_id, args->mode);
		ecies_close();
		rc = ecies_open(args->hc_id, args->mode);
		if (rc) {
			break;
		}
		if (context.curvelen != args->textlen) {
			printk("wrong private key length: %u != %u\n",
			       args->textlen, context.curvelen);
			break;
		}
		/* peerpriv, epubkey in, pub_key out */
		rc = cri_ecies_init(context.ecies, args->mode,
				    CRI_ECIES_DECRYPT,
				    args->data, context.curvelen,
				    args->data + context.curvelen,
				    context.curvelen, argsout->data,
				    context.curvelen);
		if (rc == 0) {
			argsout->textlen = context.curvelen;
		}
		break;
	}
	case ECIES_CMD_DECRYPT_UPDATE:
		printk("decrypt update %u:\n", args->textlen);
		rc = cri_ecies_update(context.ecies, args->data, args->textlen,
				      argsout->data);
		if (rc == 0) {
			argsout->textlen = args->textlen;
		}
		break;
	case ECIES_CMD_DECRYPT_FINAL: {
		argsout->taglen = context.hashlen;
		printk("decrypt final text:%u sharedinfo:%u tag:%u\n",
		       args->textlen, args->sharedinfolen, argsout->taglen);
		rc = cri_ecies_final(context.ecies, args->data, args->textlen,
				     args->data + args->textlen,
				     args->sharedinfolen,
				     argsout->data + argsout->taglen,
				     argsout->data, argsout->taglen);
		if (rc == 0) {
			argsout->textlen = args->textlen;
			*out_used += argsout->taglen;
		}

		break;
	}
	default:
		return -EINVAL;
		break;
	}
	if (rc) {
		info("ECIES operation %u failed\n", args->cmd);
		ecies_close();
	} else {
		info("ECIES operation %u done\n", args->cmd);
		*out_used += sizeof(*argsout) + ROUNDUP(argsout->textlen, 4);
	}
	return rc;
}

const cmd_t cmd_ecies = { CMDID_ECIES, "ECIES", "ECIES operations", ecies_run };
```
