## CMakeLists.txt
```
# Copyright (c) 2017-2023 Cryptography Research, Inc. (CRI).

cmake_minimum_required(VERSION 3.20.0)

find_package(Zephyr REQUIRED HINTS $ENV{ZEPHYR_BASE})
project(supervisor)

zephyr_cc_option(-Os -Wno-pointer-arith)
add_definitions(-DSUPERVISOR_VERSION_NUMBER=${SUPERVISOR_VERSION_NUMBER} -DSUPERVISOR_VERSION_INFO="${SUPERVISOR_VERSION_INFO}")

target_sources(app PRIVATE src/cri_utils.c)
target_sources(app PRIVATE src/fips_aes.c)
target_sources(app PRIVATE src/fips_asset.c)
target_sources(app PRIVATE src/fips.c)
target_sources(app PRIVATE src/fips_drbg.c)
target_sources(app PRIVATE src/fips_ecc.c)
target_sources(app PRIVATE src/fips_ecdh.c)
target_sources(app PRIVATE src/fips_ecdsa.c)
target_sources(app PRIVATE src/fips_kat.c)
target_sources(app PRIVATE src/fips_kdf.c)
target_sources(app PRIVATE src/fips_key_importexport.c)
target_sources(app PRIVATE src/fips_ktc.c)
target_sources(app PRIVATE src/fips_log.c)
target_sources(app PRIVATE src/fips_pk_test.c)
target_sources(app PRIVATE src/fips_rsa_keygen.c)
target_sources(app PRIVATE src/fips_rsa_pss.c)
target_sources(app PRIVATE src/fips_service.c)
target_sources(app PRIVATE src/fips_sha.c)
target_sources(app PRIVATE src/fips_status.c)
target_sources(app PRIVATE src/fips_sym.c)
target_sources(app PRIVATE src/fips_tmc.c)
target_sources(app PRIVATE src/fips_user.c)
target_sources(app PRIVATE src/main.c)
target_sources(app PRIVATE src/pke_kat.c)
target_sources(app PRIVATE src/sw_kdf_kat.c)
target_sources(app PRIVATE src/teec_cmvp.c)
target_sources(app PRIVATE src/teefs_cmvp.c)


target_sources_ifdef(CONFIG_CMRT_SHSIG_LMS app PRIVATE src/fips_lms_hss.c)
target_sources_ifdef(CONFIG_CMRT_SHSIG_XMSS app PRIVATE src/fips_xmss.c)

target_link_libraries(app PUBLIC "-Wl,-e__reset")
```

## Kconfig
```
# Kconfig - Private config options for the FIPS supervisor

mainmenu "FIPS supervisor"

config FIPS_RAM_TEEFS_SIZE
	hex
	default 0x8000

config FIPS_OTP_TEEFS_SIZE
	hex
	default 0x400

config FIPS_OTP_TMC_PARAM_SIZE
	hex
	default 0x8

config MAIN_STACK_SIZE
       default 13824 if CMRT_SHSIG_XMSS_ENABLE_ALL_MODES
       default 8192 if CMRT_SHSIG_LIBRARY
       default 4092

source "Kconfig.zephyr"
```

## prj.conf
```kconfig
CONFIG_CMRT_V1=y
CONFIG_MULTITHREADING=n
CONFIG_SUPERVISOR_MODE=y
CONFIG_WDT_DISABLE_AT_BOOT=y
CONFIG_CMRT_PKE=y
CONFIG_CMRT_AES=y
CONFIG_TEEFS=y
CONFIG_TEEFS_MAX_INSTANCES=2
CONFIG_TEEFS_MAX_PAGES=31
CONFIG_TEEFS_MAX_FILES=4
CONFIG_TEEFS_MAX_PAGE_SIZE=7
CONFIG_TEEFS_MAX_DIRS=1
CONFIG_TEEFS_MAX_CACHE_PAGES=4
CONFIG_TEEFS_MAX_BAD_BLOCKS=1
CONFIG_TEEFS_MAX_NAMELEN=69
CONFIG_CMRT_TEEDEV_RAM=y
CONFIG_TEEDEV_RAM_BLOCK_SIZE=9
CONFIG_TEEDEV_RAM_PAGE_SIZE=7
CONFIG_TEEDEV_RAM_CACHE_PAGES=1
CONFIG_CMRT_TEEDEV_OTP=y
CONFIG_TEEDEV_OTP_BLOCK_SIZE=9
CONFIG_TEEDEV_OTP_PAGE_SIZE=7
CONFIG_TEEDEV_OTP_CACHE_PAGES=4
CONFIG_CMRT_FIPS_140_MODE=y
CONFIG_CMRT_RSA=y
CONFIG_CMRT_RSA_CRT=y
CONFIG_CMRT_FFDH=n
CONFIG_CMRT_PKE_SECP256K1=n
CONFIG_CMRT_PKE_BRAINPOOL_P192R1=n
CONFIG_CMRT_PKE_BRAINPOOL_P224R1=n
CONFIG_CMRT_PKE_BRAINPOOL_P256R1=n
CONFIG_CMRT_PKE_BRAINPOOL_P320R1=n
CONFIG_CMRT_PKE_BRAINPOOL_P384R1=n
CONFIG_CMRT_PKE_BRAINPOOL_P512R1=n
CONFIG_CMRT_PKE_BRAINPOOL_P192T1=n
CONFIG_CMRT_PKE_BRAINPOOL_P224T1=n
CONFIG_CMRT_PKE_BRAINPOOL_P256T1=n
CONFIG_CMRT_PKE_BRAINPOOL_P320T1=n
CONFIG_CMRT_PKE_BRAINPOOL_P384T1=n
CONFIG_CMRT_PKE_BRAINPOOL_P512T1=n
CONFIG_CMRT_PKE_ED25519_CURVE=n
CONFIG_CMRT_PKE_X25519_CURVE=n
CONFIG_CMRT_PKE_X448_CURVE=n
CONFIG_CMRT_PKE_ED448_CURVE=n
CONFIG_CMRT_PKE_FRP256_CURVE=n
# make RELEASE_BUILD=1 unsets these
CONFIG_LOG=y
CONFIG_LOG_MODE_MINIMAL=y
CONFIG_LOG_DEFAULT_LEVEL=4
CONFIG_DEBUG=y
```

## src/main.c
```c
/*
 * Copyright (c) 2020-2024 Cryptography Research, Inc. (CRI).
 * A license or authorization from CRI is needed to use this file.
 */

#include <zephyr.h>
#include <device.h>
#include <stdint.h>
#include <stddef.h>
#include <string.h>
#include <ctype.h>
#include <stdalign.h>

#include <smcalls.h>
#include <teedev_dmac.h>
#include <teefs.h>

#include <cri/cmrt/dd.h>
#include <cri/cmrt/aes.h>
#include <cri/cmrt/hc.h>
#include <cri/cmrt/sic.h>
#include <cri/cmrt/kdc.h>
#include <cri/cmrt/ktc.h>
#include <cri/cmrt/pke.h>
#include <cri/cmrt.h>

#include <tee_client_api.h> /* TEEC_MEMREF values */
#include <tee_client_abi.h>

#include <cri/cmrt/fips/fips_types.h>

#include "fips.h"
#include "teec_cmvp.h"
#include "teefs_cmvp.h"
#include "cmvp_sw.h"
#include "cri_crypto.h"

extern const char version_info[];

static alignas(4) u8_t buffer[1024];
alignas(4) uint8_t workcontext[MAX_WORKCONTEXT_LEN];
cri_sic_t sic;

static void set_boot_status(u32_t bits, u32_t mask)
{
	u32_t value = cri_read_reg(CMRT_SIC_BASE, R_SW_BOOT_STATUS);
	value &= ~mask;
	value |= bits & mask;
	cri_write_reg(CMRT_SIC_BASE, R_SW_BOOT_STATUS, value);
}

static u32_t get_fips_need(void)
{
	u32_t value = cri_read_reg(CMRT_SIC_BASE, R_FIPS_MODE);
	dprintk("FIPS mode: %i\n", value);
	return value & FIPS_MODE_ENTER_FLAG;
}

static void set_fips_mode(void)
{
	u32_t value = cri_read_reg(CMRT_SIC_BASE, R_FIPS_MODE);
	value |= FIPS_MODE_RUNNING_FLAG;
	cri_write_reg(CMRT_SIC_BASE, R_FIPS_MODE, value);
}

int main(void)
{
	int res;
	fips_state_t state;
	io_t io;
	teec_abi_header_t *h = (teec_abi_header_t *) buffer;

	dprintk("Supervisor CMVP %s running...\n", version_info);

	/* OTP TMC configuration has to be applied before first use of TMC,
	   in mission+fips it is rsa_run_kat() */
	res = init_tmc_with_otp_config();
	if (res < 0) {
		dprintk("Failed to init TMC: %d!\n", res);
		return res;
	}

	if (get_fips_need()) {
		if (run_all_kats()) {
			set_fips_mode();
		}
	}

	io.data = buffer;
	fips_intialize_state(&state);

	/* Running in supervisor mode here. */
	sic = cri_sic_open(CRI_O_SYNC, FIPS_LOCAL_ADDRESS);
	if (!cri_is_valid(sic)) {
		dprintk("Cannot open SIC\n");
		return -ENODEV;
	}
	set_boot_status(SUPERVISOR_RUNNING_ID, SUPERVISOR_RUNNING_ID);
	memset(workcontext, 0x00, MAX_WORKCONTEXT_LEN);

	res = setup_teefs_RAM();
	if (res < 0) {
		dprintk("Failed to setup teefs (RAM): %d!\n", res);
		return res;
	}
#if CONFIG_FIPS_OTP_TEEFS_SIZE > 0
	res = setup_teefs_OTP();
	if (res < 0) {
		dprintk("Failed to setup teefs (OTP): %d!\n", res);
		return res;
	}
#endif
#ifdef CONFIG_DEBUG
	workcontext[MAX_WORKCONTEXT_LEN - 2] = 0xA5;
	workcontext[MAX_WORKCONTEXT_LEN - 1] = 0x5A;
#endif

	while (1) {
		dprintk("Waiting for SIC command ...\n");
		io.size = sizeof(buffer);
		u32_t peerid;
		res = cri_sic_read(sic, io.data, &io.size, &peerid);
		if (res < 0) {
			dprintk("failed to read from HLOS: %d!\n", res);
			continue;
		}

		res = process_tee_message(&state, &io);
		if (res < 0) {
			dprintk("Request failed: %d!\n", res);
		}

#ifdef CONFIG_DEBUG
		if ((workcontext[MAX_WORKCONTEXT_LEN - 1] != 0x5A) ||
			(workcontext[MAX_WORKCONTEXT_LEN - 2] != 0xA5)) {
			dprintk("Work context overflow\n");
			if (!res) {
				res = -EIO;
			}
		}
		if (((uint32_t *)workcontext)[0] == 0) {
			uint32_t addr = 0;
			uint8_t sum = 0;
			for (int i = 1; i < (MAX_WORKCONTEXT_LEN - 2); i++) {
				sum |= workcontext[i];
				if (workcontext[i] != 0) {
					if (i > addr) { addr = i; }
				}
			}
			if (sum != 0) {
				dprintk("Memory not zeroed correctly\n");
				dprintk("Maximum observed index: %i\n", addr);
				dhexdump("Memory", workcontext, addr);
				if (!res) {
					res = -EIO;
				}
			}
		}
#endif

		dprintk("Sending output back\n");
		h->session = state.teec_session;
		if (res < 0) {
			res = -res;
		}
		h->cmdres = res | (state.approved_mode << 31);
		state.approved_mode = 0;
		res = cri_sic_write(sic, io.data, io.size, peerid);
		if (res < 0) {
			dprintk("failed to write to HLOS: %d!\n", res);
			continue;
		}

		if (state.do_reset == true) {
			state.do_reset = false;
			cri_mcall_soft_reset();
		}
	}

	return 0;
}
```

## src/cmvp_sw.h
```c
/*
 * Copyright (c) 2020-2023 Cryptography Research, Inc. (CRI).
 * A license or authorization from CRI is needed to use this file.
 */

#ifndef CRI_CMVP_SW_H
#define CRI_CMVP_SW_H

#include <stdint.h>
#include <stddef.h>
#include <stdalign.h>

#include <cri/cmrt/fips/fips_types.h>

#include <hexutil.h>

#define MAX_WORKCONTEXT_LEN 0x4800
extern alignas(4) uint8_t workcontext[MAX_WORKCONTEXT_LEN];

#include <cri/cmrt/sic.h>
extern cri_sic_t sic;

#ifdef CONFIG_DEBUG
#define dprintk printk
#else
#define dprintk(f_, ...) while (0)
#endif

#ifdef CONFIG_DEBUG
#define dhexdump(x, y, z) do { dprintk(x); dprintk("\n"); hexdump((y), (z)); } while (0)
#else
#define dhexdump(x, y, z) while (0)
#endif

#endif
```

## src/cri_crypto.h
```c
/*
 * Copyright (c) 2020-2024 Cryptography Research, Inc. (CRI).
 * A license or authorization from CRI is needed to use this file.
 */

#ifndef CRI_CRYPTO_H
#define CRI_CRYPTO_H

#include <stdint.h>
#include <stddef.h>

#include <cri/cmrt/pke.h>
#include <cri/cmrt.h>

#include "fips.h"


int32_t init_tmc_with_otp_config();
int32_t cri_get_randomness(uint8_t *buffer, size_t size);

int32_t cri_ecdh(cri_ecc_curve_t curve,
		const uint8_t *priv_key,
		const uint8_t *public_key,
		uint8_t *secret);

int32_t cri_ecdsa_sign(const uint32_t pke_curve, uint8_t *priv_key,
		uint8_t *digest, uint32_t digest_len, uint8_t *r, uint8_t *s);

int32_t cri_full_ecdsa_public_key_validation(cri_ecc_curve_t curve,
		uint8_t *public_key_x,
		uint8_t *public_key_y);

int32_t rsa_pairwise_consistency_check(const uint32_t *n,
		const uint32_t *d,
		uint32_t bit_length,
		uint32_t *work_buffer);

int32_t cri_ecdsa_verify(cri_ecc_curve_t curve, uint8_t *r, uint8_t *s,
		uint8_t *public_key_x, uint8_t *public_key_y, uint8_t *digest, uint32_t digest_len,
		uint8_t *rp);

int32_t cri_hash(hash_work_struct *sha, uint8_t *in_dataarray,
		size_t inlen, uint8_t *out_hash, size_t outlen, const fips_hc_id hc_id);

int32_t cri_mac_gen(hash_work_struct *sha, uint8_t *in_dataarray,
		size_t inlen, uint8_t *key, size_t keylen, uint8_t *out_hash,
		size_t outlen);

int32_t sp800_108_kdf(uint8_t *derived_key,
		uint32_t derived_key_length,
		uint8_t *salt,
		uint32_t salt_length,
		uint8_t *z,
		uint32_t z_length,
		uint8_t *fixed_info,
		uint32_t fixed_info_length,
		uint8_t *work_area);

int32_t kdf_component_extraction_expansion(uint8_t *derived_key,
		uint32_t derived_key_length,
		uint8_t *salt,
		uint32_t salt_length,
		uint8_t *z,
		uint32_t z_length,
		uint8_t *label,
		uint32_t label_length,
		uint8_t *component,
		uint32_t component_length,
		uint8_t *work_area);

bool run_all_kats(void);

#endif
```

## src/cri_utils.c
```c
/*
 * Copyright (c) 2020-2024 Cryptography Research, Inc. (CRI).
 * A license or authorization from CRI is needed to use this file.
 */

#include <zephyr.h>
#include <device.h>
#include <stdint.h>
#include <stddef.h>
#include <string.h>
#include <ctype.h>

#include <errno.h>
#include <hexutil.h>

#include <cri/cmrt/teedev_dmac.h>
#include <cri/cmrt/sac.h>
#include <cri/cmrt/sic.h>
#include <cri/cmrt/hc.h>
#include <cri/cmrt/aes.h>
#include <cri/cmrt/tee_client_api.h> /* TEEC_MEMREF values */
#include <cri/cmrt/tee_client_abi.h>
#include <cri/cmrt.h>
#include <cri/cmrt/pke.h>

#include "cmvp_sw.h"
#include "cri_utils.h"
#include "cri_crypto.h"

uint32_t swap32(uint32_t x)
{
	x = (x << 16) ^ (x >> 16);
	x = ((x & 0x00ff00ff) << 8) ^ ((x >> 8) & 0x00ff00ff);
	return x;
}

void reverse_words(const void *in, const size_t length, void *out)
{
	const uint32_t *iptr = in;
	uint32_t *optr = out;

	for (size_t i = 0; i < length; i++) {
		optr[i] = swap32(iptr[length - 1 - i]);
	}
}

void reverse_endian_words(const void *in, const size_t length, void *out)
{
	const uint32_t *iptr = in;
	uint32_t *optr = out;

	for (size_t i = 0; i < length; i++) {
		optr[i] = swap32(iptr[i]);
	}
}

int32_t fips_write_to_shared_memory(const uint8_t *buffer,
		uint32_t buffer_length,
		teec_abi_invokecommand_t *h,
		uint32_t index)
{
	int32_t status = 0;

	if (buffer_length > h->params[index].memref.size) {
		dprintk("The shared memory buffer is not large enough: %d -> %d\n",
				buffer_length, h->params[index].memref.size);
		status = -ENOSPC;
		goto out;
	}

	memcpy((uint8_t *) (h->params[index].memref.offset + SAC_MEMORY_BASE), buffer, buffer_length);
	h->params[index].memref.size = buffer_length;
	dprintk("Wrote %d bytes to shared memory\n", buffer_length);

out:
	return status;
}

int32_t fips_read_from_shared_memory(teec_abi_invokecommand_t *h,
		uint32_t index,
		uint8_t *buffer,
		uint32_t *buffer_length)
{
	int32_t status = 0;

	if (h->params[index].memref.size > *buffer_length) {
		dprintk("The internal memory is not large enough: %d -> %d\n",
				h->params[index].memref.size, *buffer_length);
		status = -ENOSPC;
		goto out;
	}

	*buffer_length = h->params[index].memref.size;
	memcpy(buffer, (uint8_t *) (h->params[index].memref.offset + SAC_MEMORY_BASE), *buffer_length);
	dhexdump("Read from shared memory", buffer, *buffer_length);

out:
	return status;
}

int32_t fips_hash(uint8_t *input,
		uint32_t input_length,
		fips_hash_algorithm hash_algorithm,
		uint8_t *digest,
		uint32_t *digest_length)
{
	int32_t status;

	hash_work_struct sha;

	switch (hash_algorithm) {
	case FIPS_HASH_SHA224:
		sha.hashtype = HC_HASH_ALGO_SHA_224;
		sha.hashlen = 28;
		break;
	case FIPS_HASH_SHA256:
		sha.hashtype = HC_HASH_ALGO_SHA_256;
		sha.hashlen = 32;
		break;
	case FIPS_HASH_SHA384:
		sha.hashtype = HC_HASH_ALGO_SHA_384;
		sha.hashlen = 48;
		break;
	case FIPS_HASH_SHA512:
		sha.hashtype = HC_HASH_ALGO_SHA_512;
		sha.hashlen = 64;
		break;
	case FIPS_HASH_SHA512_224:
		sha.hashtype = HC_HASH_ALGO_SHA_512_224;
		sha.hashlen = 28;
		break;
	case FIPS_HASH_SHA512_256:
		sha.hashtype = HC_HASH_ALGO_SHA_512_256;
		sha.hashlen = 32;
		break;
#if (defined CONFIG_CMRT_S3HC || defined CONFIG_CMRT_S3HC2)
	case FIPS_HASH_SHA3_224:
		sha.hashtype = HC_HASH_ALGO_SHA3_224;
		sha.hashlen = 28;
		break;
	case FIPS_HASH_SHA3_256:
		sha.hashtype = HC_HASH_ALGO_SHA3_256;
		sha.hashlen = 32;
		break;
	case FIPS_HASH_SHA3_384:
		sha.hashtype = HC_HASH_ALGO_SHA3_384;
		sha.hashlen = 48;
		break;
	case FIPS_HASH_SHA3_512:
		sha.hashtype = HC_HASH_ALGO_SHA3_512;
		sha.hashlen = 64;
		break;
#endif
	default:
		status = -EINVAL;
		goto out;
	}

	*digest_length = sha.hashlen;
	status = cri_hash(&sha, input, input_length, digest, *digest_length, FIPS_HC_1);

out:
	return status;
}

#ifdef CONFIG_DEBUG
const char *fips_command_str(fips_command cmd)
{
#define A(X) { X, #X }
	static const struct {
		uint32_t cmdcode;
		const char *name;
	} cmdcodes[] = {
		A(FIPS_SERVICE_INVALID_COMMAND),
		A(FIPS_SERVICE_LOGIN_FINAL),
		A(FIPS_SERVICE_CREATE_USER),
		A(FIPS_SERVICE_DELETE_USER),
		A(FIPS_SERVICE_GEN_SYMM_KEY),
		A(FIPS_SERVICE_DERIVE_SYMM_KEY),
		A(FIPS_SERVICE_DERIVE_SYMM_KEY_TWO_STEP),
		A(FIPS_SERVICE_GEN_EC_KEYPAIR),
		A(FIPS_SERVICE_GEN_RSA_KEYPAIR),
		A(FIPS_SERVICE_IMPORT_KEY),
		A(FIPS_SERVICE_EXPORT_KEY),
		A(FIPS_SERVICE_EXPORT_KEY_KTC),
		A(FIPS_SERVICE_AES_ECB),
		A(FIPS_SERVICE_AES_GCM_INIT),
		A(FIPS_SERVICE_AES_GCM_AAD_UPDATE),
		A(FIPS_SERVICE_AES_GCM_UPDATE),
		A(FIPS_SERVICE_AES_GCM_ENCRYPT_FINAL),
		A(FIPS_SERVICE_AES_GCM_DECRYPT_FINAL),
		A(FIPS_SERVICE_AES_CBC_INIT),
		A(FIPS_SERVICE_AES_CBC_UPDATE),
		A(FIPS_SERVICE_AES_CBC_FINAL),
		A(FIPS_SERVICE_AES_CTR_INIT),
		A(FIPS_SERVICE_AES_CTR_UPDATE),
		A(FIPS_SERVICE_AES_CTR_FINAL),
		A(FIPS_SERVICE_AES_CFB128_INIT),
		A(FIPS_SERVICE_AES_CFB128_UPDATE),
		A(FIPS_SERVICE_AES_CFB128_FINAL),
		A(FIPS_SERVICE_ECDSA_SIGN),
		A(FIPS_SERVICE_ECDSA_VERIFY),
		A(FIPS_SERVICE_ECDSA_PK_TEST),
		A(FIPS_SERVICE_ECDH),
		A(FIPS_SERVICE_RSA_SIGN),
		A(FIPS_SERVICE_RSA_VERIFY),
		A(FIPS_SERVICE_MAC_GEN_INIT),
		A(FIPS_SERVICE_MAC_GEN_FINAL),
		A(FIPS_SERVICE_MAC_VERIFY_INIT),
		A(FIPS_SERVICE_MAC_VERIFY_FINAL),
		A(FIPS_SERVICE_MAC_UPDATE),
		A(FIPS_SERVICE_HASH_INIT),
		A(FIPS_SERVICE_HASH_UPDATE),
		A(FIPS_SERVICE_HASH_FINAL),
		A(FIPS_SERVICE_GET_TRNG),
		A(FIPS_SERVICE_LIST_ASSETS),
		A(FIPS_SERVICE_MOVE_ASSET),
		A(FIPS_DELETE_DYNAMIC_ASSET),
		A(FIPS_DELETE_STATIC_ASSET),
		A(FIPS_SERVICE_ZEROIZE),
		A(FIPS_SERVICE_SELF_TEST),
		A(FIPS_SERVICE_RESET),
		A(FIPS_SERVICE_SHOW_STATUS),
		A(FIPS_SERVICE_DRBG),
		A(FIPS_SERVICE_GEN_KYBER_KEM_KEYPAIR),
		A(FIPS_SERVICE_GEN_DILITHIUM_KEYPAIR),
		A(FIPS_SERVICE_DILITHIUM_SIGN),
		A(FIPS_SERVICE_DILITHIUM_VERIFY),
		A(FIPS_SERVICE_GEN_KYBER_KEM_KEYPAIR),
		A(FIPS_SERVICE_KYBER_KEM_ENC),
		A(FIPS_SERVICE_KYBER_KEM_DEC),
		A(FIPS_SERVICE_LMS_VERIFY),
		A(FIPS_SERVICE_HSS_VERIFY),
		A(FIPS_SERVICE_XMSS_VERIFY),
		A(FIPS_SERVICE_XMSSMT_VERIFY)
	};
#undef A
	enum { k_num_cmdcodes = sizeof(cmdcodes) / sizeof(cmdcodes[0]) };
	for (uint32_t i = 0; i < k_num_cmdcodes; ++i) {
		if (cmdcodes[i].cmdcode == cmd)
			return cmdcodes[i].name;
	}
	return "UNKNOWN_COMMAND";
}

const char *fips_asset_type_str(fips_asset_type type)
{
#define A(X) { X, #X }
	static const struct {
		uint32_t asset_type;
		const char *name;
	} asset_types[] = {
		A(FIPS_TYPE_AES),
		A(FIPS_TYPE_HMAC_SHA224),
		A(FIPS_TYPE_HMAC_SHA256),
		A(FIPS_TYPE_HMAC_SHA384),
		A(FIPS_TYPE_HMAC_SHA512),
		A(FIPS_TYPE_RSA_PUBLIC_KEY),
		A(FIPS_TYPE_RSA_KEYPAIR),
		A(FIPS_TYPE_RSA_PF_KEYPAIR),
		A(FIPS_TYPE_RSA_CRT_KEYPAIR),
		A(FIPS_TYPE_ECDSA_PUBLIC_KEY),
		A(FIPS_TYPE_ECDSA_KEYPAIR),
		A(FIPS_TYPE_ECDH_PUBLIC_KEY),
		A(FIPS_TYPE_ECDH_KEYPAIR),
		A(FIPS_TYPE_SHARED_SECRET),
		A(FIPS_TYPE_AES_GCM_ENCRYPT),
		A(FIPS_TYPE_AES_GCM_DECRYPT),
		A(FIPS_TYPE_WRAP_KEY),
		A(FIPS_TYPE_SECRET),
		A(FIPS_TYPE_HMAC_SHA3_224),
		A(FIPS_TYPE_HMAC_SHA3_256),
		A(FIPS_TYPE_HMAC_SHA3_384),
		A(FIPS_TYPE_HMAC_SHA3_512),
		A(FIPS_TYPE_DILITHIUM_PUBLIC_KEY),
		A(FIPS_TYPE_DILITHIUM_KEYPAIR),
		A(FIPS_TYPE_KYBER_ENCAP_KEY),
		A(FIPS_TYPE_KYBER_KEYPAIR)
	};
#undef A
	enum { k_num_asset_types = sizeof(asset_types) / sizeof(asset_types[0]) };
	for (uint32_t i = 0; i < k_num_asset_types; ++i) {
		if (asset_types[i].asset_type == type)
			return asset_types[i].name;
	}
	return "UNKNOWN_ASSET_TYPE";
}
#endif

int cmrt_pke_rsa_ctx_init(struct cmrt_rsa_ctx *ctx, size_t bit_length, void *buf)
{
	static const uint32_t E = 0x00010001;
	uint32_t bytes_len = bit_length / 8;
	memset(buf, 0, 9 * bytes_len + sizeof(uint32_t));
	ctx->key.bits = bit_length;
	ctx->key.e = (uint8_t *)&E;
	ctx->key.elength = 4;
	ctx->key.flags = 0;

	ctx->key.n = buf;
	ctx->key.d = ctx->key.n + bytes_len;

	ctx->key.p = ctx->key.d + bytes_len;
	ctx->key.q = ctx->key.p + bytes_len;
	ctx->key.dp = ctx->key.q + bytes_len;
	ctx->key.dq = ctx->key.dp + bytes_len;
	ctx->key.iq = ctx->key.dq + bytes_len;
	ctx->key.mask = ctx->key.iq + bytes_len;

	ctx->signature = ctx->key.mask + sizeof(uint32_t);
	ctx->message = ctx->signature + bytes_len;

	return 0;
}

int cri_rsa_pub(cmrt_pke_t pke, struct cmrt_rsa_ctx *ctx)
{
	return cmrt_pke_rsa_public_key_primitive(pke, ctx->key.bits,
				ctx->key.n, ctx->key.e, ctx->signature, ctx->message);
}
```

## src/cri_utils.h
```c
/*
 * Copyright (c) 2020-2023 Cryptography Research, Inc. (CRI).
 * A license or authorization from CRI is needed to use this file.
 */

#ifndef CRI_UTILS_H
#define CRI_UTILS_H

#include <stdint.h>
#include <stddef.h>
#include <cri/cmrt/fips/fips_types.h>
#include <cri/cmrt/pke.h>
#include <drivers/cmrt/pke.h>

#define CHECK_COMMAND(x) do { \
	if (((uint32_t *) workcontext)[0] != 0x00000000) { \
		dprintk("Working context is not empty, cleaning now\n"); \
		status = -EPERM; \
		goto out; \
	} \
	((uint32_t *) workcontext)[0] = (x); \
} while (0);

#define ALIGN_32_BIT_POINTER(x) (((uint32_t)(x) + 3) & 0xFFFFFFFC)

#define GET_32_BIT_WORD(x, y, z) do { \
	memcpy(&(x), (y) + offset, 4 * sizeof(uint8_t)); \
	(x) = swap32((x)); \
	offset += 4 * sizeof(uint8_t); \
} while (0);

#ifndef BIT2WORD
#define BIT2WORD(bits) ((bits) / 32)
#endif
#ifndef BIT2BYTE
#define BIT2BYTE(bits) ((bits) / 8)
#endif

#define _RSA_CONCAT(a, b) a##b

#define DCLR_CTX(bits) _RSA_CONCAT(_rsa_context_, bits)
#define RSA_CTX_SIZE(bits) sizeof(struct DCLR_CTX(bits))

#define DCLR_KEY_CTX(bits) _RSA_CONCAT(aux_cmrt_rsa_key_, bits)
#define DCLR_RSA_CTX(bits) _RSA_CONCAT(aux_cmrt_rsa_ctx_, bits)

#define DEF_KEY_CTX(bits) \
struct DCLR_KEY_CTX(bits) { \
	uint8_t n[BIT2BYTE(bits)]; /**< public key modulus */ \
	uint8_t e[BIT2BYTE(bits)]; /**< public key exponent */ \
	uint32_t elength; /**< byte length of e */ \
	uint8_t d[BIT2BYTE(bits)]; /**< private exponent, if required */ \
	uint8_t p[BIT2BYTE(bits)/8+8]; /**< private key (CRT) prime */ \
	uint8_t q[BIT2BYTE(bits)/8+8]; /**< private key (CRT) prime */ \
	uint8_t dp[BIT2BYTE(bits)/8+8]; /**< private key dp = d mod p-1 */ \
	uint8_t dq[BIT2BYTE(bits)/8+8]; /**< private key dq = d mod q-1 */ \
	uint8_t iq[BIT2BYTE(bits)/8+8]; /**< private key iq = q^-1 mod p */ \
	uint8_t mask[8]; /**< mask used to blind key */ \
};

DEF_KEY_CTX(1024);
DEF_KEY_CTX(2048);
DEF_KEY_CTX(3072);
DEF_KEY_CTX(4096);
DEF_KEY_CTX(8192);

#define DEF_CMRT_RSA_CTX(bits) \
struct DCLR_RSA_CTX(bits) { \
	struct DCLR_KEY_CTX(bits) key; \
	uint8_t signature[BIT2BYTE(bits)]; \
	uint8_t message[BIT2BYTE(bits)]; \
};

DEF_CMRT_RSA_CTX(1024);
DEF_CMRT_RSA_CTX(2048);
DEF_CMRT_RSA_CTX(3072);
DEF_CMRT_RSA_CTX(4096);
DEF_CMRT_RSA_CTX(8192);

uint32_t swap32(uint32_t x);

/* note length is in 32-bit words */
void reverse_endian_words(const void *in, const size_t length, void *out);

/* note length is in 32-bit words */
void reverse_words(const void *in, const size_t length, void *out);

int32_t fips_write_to_shared_memory(const uint8_t *buffer,
		uint32_t buffer_length,
		teec_abi_invokecommand_t *h,
		uint32_t index);

int32_t fips_read_from_shared_memory(teec_abi_invokecommand_t *h,
		uint32_t index,
		uint8_t *buffer,
		uint32_t *buffer_length);

int32_t fips_hash(uint8_t *input,
		uint32_t input_length,
		fips_hash_algorithm hash_algorithm,
		uint8_t *digest,
		uint32_t *digest_length);

#ifdef CONFIG_DEBUG
const char *fips_command_str(fips_command cmd);
const char *fips_asset_type_str(fips_asset_type type);
#endif

int cmrt_pke_rsa_ctx_init(struct cmrt_rsa_ctx *ctx, size_t bit_length, void *buf);
int cri_rsa_pub(cmrt_pke_t pke, struct cmrt_rsa_ctx *ctx);
#endif
```

## src/fips.c
```c
/*
 * Copyright (c) 2020-2024 Cryptography Research, Inc. (CRI).
 * A license or authorization from CRI is needed to use this file.
 */

#include <zephyr.h>
#include <device.h>
#include <stdint.h>
#include <stddef.h>
#include <string.h>
#include <ctype.h>

#include <errno.h>
#include <hexutil.h>
#include <smcalls.h>

#include <cri/cmrt/teedev_dmac.h>
#include <cri/cmrt/aes.h>
#include <cri/cmrt/hc.h>
#include <cri/cmrt/dd.h>
#include <cri/cmrt/eac.h>
#include <cri/cmrt/tee_client_api.h> /* TEEC_MEMREF values */
#include <cri/cmrt/tee_client_abi.h>
#include <cri/cmrt/pke.h>
#include <cri/cmrt.h>

#include <cri/cmrt/fips/fips_types.h>

#include "teec_cmvp.h"
#include "teefs_cmvp.h"
#include "fips_asset.h"
#include "cmvp_sw.h"

/*
 * By Column, we have CO, User and Anonymous. Corresponding to the
 * table on page 43 of the specification.
 */
static uint8_t permission_table[NUMBER_OF_SERVICES][4] = {
		{ 0, 0, 0, 0 }, /* FIPS_SERVICE_INVALID_COMMAND */
		{ 1, 1, 0, 1 }, /* FIPS_SERVICE_LOGIN_FINAL */
		{ 1, 0, 0, 0 }, /* FIPS_SERVICE_CREATE_USER */
		{ 1, 0, 0, 0 }, /* FIPS_SERVICE_DELETE_USER */
		{ 1, 1, 0, 1 }, /* FIPS_SERVICE_GEN_SYMM_KEY */
		{ 1, 1, 0, 1 }, /* FIPS_SERVICE_DERIVE_SYMM_KEY */
		{ 1, 1, 0, 1 }, /* FIPS_SERVICE_DERIVE_SYMM_KEY_TWO_STEP */
		{ 1, 1, 0, 1 }, /* FIPS_SERVICE_GEN_EC_KEYPAIR */
		{ 1, 1, 0, 1 }, /* FIPS_SERVICE_GEN_RSA_KEYPAIR */
		{ 1, 1, 0, 1 }, /* FIPS_SERVICE_IMPORT_KEY */
		{ 1, 1, 0, 1 }, /* FIPS_SERVICE_EXPORT_KEY */
		{ 1, 1, 0, 0 }, /* FIPS_SERVICE_EXPORT_KEY_KTC */
		{ 1, 1, 0, 1 }, /* FIPS_SERVICE_AES_ECB */
		{ 1, 1, 0, 1 }, /* FIPS_SERVICE_AES_GCM_INIT */
		{ 1, 1, 0, 1 }, /* FIPS_SERVICE_AES_GCM_AAD_UPDATE */
		{ 1, 1, 0, 1 }, /* FIPS_SERVICE_AES_GCM_UPDATE */
		{ 1, 1, 0, 1 }, /* FIPS_SERVICE_AES_GCM_ENCRYPT_FINAL */
		{ 1, 1, 0, 1 }, /* FIPS_SERVICE_AES_GCM_DECRYPT_FINAL */
		{ 1, 1, 0, 1 }, /* FIPS_SERVICE_AES_CBC_INIT */
		{ 1, 1, 0, 1 }, /* FIPS_SERVICE_AES_CBC_UPDATE */
		{ 1, 1, 0, 1 }, /* FIPS_SERVICE_AES_CBC_FINAL */
		{ 1, 1, 0, 1 }, /* FIPS_SERVICE_AES_CTR_INIT */
		{ 1, 1, 0, 1 }, /* FIPS_SERVICE_AES_CTR_UPDATE */
		{ 1, 1, 0, 1 }, /* FIPS_SERVICE_AES_CTR_FINAL */
		{ 1, 1, 0, 1 }, /* FIPS_SERVICE_AES_CFB128_INIT */
		{ 1, 1, 0, 1 }, /* FIPS_SERVICE_AES_CFB128_UPDATE */
		{ 1, 1, 0, 1 }, /* FIPS_SERVICE_AES_CFB128_FINAL */
		{ 1, 1, 0, 1 }, /* FIPS_SERVICE_ECDSA_SIGN */
		{ 1, 1, 0, 1 }, /* FIPS_SERVICE_ECDSA_VERIFY */
		{ 1, 1, 0, 1 }, /* FIPS_SERVICE_ECDSA_PK_TEST */
		{ 1, 1, 0, 1 }, /* FIPS_SERVICE_ECDH */
		{ 1, 1, 0, 1 }, /* FIPS_SERVICE_RSA_SIGN */
		{ 1, 1, 0, 1 }, /* FIPS_SERVICE_RSA_VERIFY */
		{ 1, 1, 0, 1 }, /* FIPS_SERVICE_MAC_GEN_INIT */
		{ 1, 1, 0, 1 }, /* FIPS_SERVICE_MAC_GEN_FINAL */
		{ 1, 1, 0, 1 }, /* FIPS_SERVICE_MAC_VERIFY_INIT */
		{ 1, 1, 0, 1 }, /* FIPS_SERVICE_MAC_VERIFY_FINAL */
		{ 1, 1, 0, 1 }, /* FIPS_SERVICE_MAC_UPDATE */
		{ 1, 1, 0, 1 }, /* FIPS_SERVICE_HASH_INIT */
		{ 1, 1, 0, 1 }, /* FIPS_SERVICE_HASH_UPDATE */
		{ 1, 1, 0, 1 }, /* FIPS_SERVICE_HASH_FINAL */
		{ 1, 1, 0, 1 }, /* FIPS_SERVICE_GET_TRNG */
		{ 1, 1, 0, 0 }, /* FIPS_SERVICE_LIST_ASSETS */
		{ 1, 1, 0, 0 }, /* FIPS_SERVICE_MOVE_ASSET */
		{ 1, 1, 0, 0 }, /* FIPS_DELETE_DYNAMIC_ASSET */
		{ 1, 1, 0, 0 }, /* FIPS_DELETE_STATIC_ASSET */
		{ 1, 0, 0, 0 }, /* FIPS_SERVICE_ZEROIZE */
		{ 1, 1, 1, 1 }, /* FIPS_SERVICE_SELF_TEST */
		{ 1, 1, 1, 0 }, /* FIPS_SERVICE_RESET */
		{ 1, 1, 1, 0 }, /* FIPS_SERVICE_SHOW_STATUS */
		{ 1, 0, 0, 1 }, /* FIPS_SERVICE_DRBG */
		{ 1, 1, 0, 1 }, /* FIPS_SERVICE_GEN_DILITHIUM_KEYPAIR */
		{ 1, 1, 0, 1 }, /* FIPS_SERVICE_DILITHIUM_SIGN */
		{ 1, 1, 0, 1 }, /* FIPS_SERVICE_DILITHIUM_VERIFY */
		{ 1, 1, 0, 1 }, /* FIPS_SERVICE_GEN_KYBER_KEM_KEYPAIR */
		{ 1, 1, 0, 1 }, /* FIPS_SERVICE_KYBER_KEM_ENC */
		{ 1, 1, 0, 1 }, /* FIPS_SERVICE_KYBER_KEM_DEC */
		{ 1, 1, 0, 1 }, /* FIPS_SERVICE_LMS_VERIFY */
		{ 1, 1, 0, 1 }, /* FIPS_SERVICE_HSS_VERIFY */
		{ 1, 1, 0, 1 }, /* FIPS_SERVICE_XMSS_VERIFY */
		{ 1, 1, 0, 1 }  /* FIPS_SERVICE_XMSSMT_VERIFY */
};

void fips_intialize_state(fips_state_t *state)
{
	state->user = FIPS_OWNER_ANONYMOUS;
	state->teec_session = 0;
	state->user_session = 0;
	state->authenticated_login_started = 0;
	state->approved_mode = 0;
	state->key_length = 0;
	state->key_value = NULL;
	state->scratch = NULL;
	state->do_reset = false;
}

void destroy_workcontext_and_halt(int32_t status)
{
	destroy_workcontext(status);
	cri_mcall_exit(-EFAULT, status, false);
}

int32_t destroy_workcontext_and_reset(fips_state_t *state)
{
	int32_t status = 0;

	destroy_workcontext(status);
	status = dismantle_teefs_RAM();
	if (status) { goto out; }

	state->do_reset = true;
out:
	return status;
}

void destroy_workcontext(int32_t length)
{
	uint32_t cmd;
	uint32_t overwrite_length = 0;

	cmd = (uint32_t) workcontext[0];

	if (length <= 0) {
		overwrite_length = MAX_WORKCONTEXT_LEN - 2;
	} else if (length < MAX_WORKCONTEXT_LEN - 1) {
		overwrite_length = length;
	} else {
		destroy_workcontext_and_halt(-EINVAL);
	}

	switch (cmd) {
	case FIPS_SERVICE_AES_ECB:
	case FIPS_SERVICE_AES_CBC_INIT:
	case FIPS_SERVICE_AES_CBC_UPDATE:
	case FIPS_SERVICE_AES_CBC_FINAL:
	case FIPS_SERVICE_AES_GCM_INIT:
	case FIPS_SERVICE_AES_GCM_AAD_UPDATE:
	case FIPS_SERVICE_AES_GCM_UPDATE:
	case FIPS_SERVICE_AES_GCM_ENCRYPT_FINAL:
	case FIPS_SERVICE_AES_GCM_DECRYPT_FINAL:
	case FIPS_SERVICE_AES_CTR_INIT:
	case FIPS_SERVICE_AES_CTR_UPDATE:
	case FIPS_SERVICE_AES_CTR_FINAL:
	case FIPS_SERVICE_AES_CFB128_INIT:
	case FIPS_SERVICE_AES_CFB128_UPDATE:
	case FIPS_SERVICE_AES_CFB128_FINAL:
		;
		aes_work_struct *aes;
		aes = (aes_work_struct *) (workcontext + sizeof(uint32_t));
		if (cri_is_valid(aes->aesengine))
			cri_aes_close(aes->aesengine);
		memset(g_inout_buffer, 0x00, MAX_TEEFS_BUFFER_LEN * sizeof(uint8_t));
		break;
	case FIPS_SERVICE_HASH_INIT:
	case FIPS_SERVICE_HASH_UPDATE:
	case FIPS_SERVICE_HASH_FINAL:
		;
		hash_work_struct *sha;
		sha = (hash_work_struct *) (workcontext + sizeof(uint32_t));
		if (cri_is_valid(sha->hashengine)) {
			dprintk("Closing the hash engine\n");
			cri_hc_close(sha->hashengine);
		}
		memset(g_inout_buffer, 0x00, MAX_TEEFS_BUFFER_LEN * sizeof(uint8_t));
		break;
	case FIPS_SERVICE_MAC_GEN_INIT:
	case FIPS_SERVICE_MAC_GEN_FINAL:
	case FIPS_SERVICE_MAC_VERIFY_INIT:
	case FIPS_SERVICE_MAC_VERIFY_FINAL:
	case FIPS_SERVICE_MAC_UPDATE:
		;
		mac_work_struct *mac;
		hash_work_struct *hsha;
		mac = (mac_work_struct *) (workcontext + sizeof(uint32_t));
		hsha = (hash_work_struct *) &(mac->sha);
		if (cri_is_valid(hsha->hashengine)) {
			dprintk("Closing the hash engine\n");
			cri_hc_close(hsha->hashengine);
		}
		memset(g_inout_buffer, 0x00, MAX_TEEFS_BUFFER_LEN * sizeof(uint8_t));
		break;
	}

	if (overwrite_length != 0) {
		memset(workcontext, 0x00, overwrite_length);
	}
}

int32_t get_approved_mode(fips_command operation, uint8_t *approved_mode)
{
	u32_t value = cri_read_reg(CMRT_SIC_BASE, R_FIPS_MODE);
	if (((value & FIPS_MODE_RUNNING_FLAG) == FIPS_MODE_RUNNING_FLAG) &&
		(operation < NUMBER_OF_SERVICES)) {
		*approved_mode = permission_table[operation][3];
	} else {
		*approved_mode = 0;
	}

	return 0;
}

uint32_t fips_get_permissions(fips_owner_user user, fips_command operation)
{
	int column;

	switch (user) {
	case FIPS_OWNER_ANONYMOUS:
		column = 2;
		return permission_table[operation][column];
		break;

	case FIPS_OWNER_CRYPTO_OFFICER:
		column = 0;
		return permission_table[operation][column];
		break;

	case FIPS_OWNER_USER_0:
	case FIPS_OWNER_USER_1:
	case FIPS_OWNER_USER_2:
	case FIPS_OWNER_USER_3:
	case FIPS_OWNER_USER_4:
	case FIPS_OWNER_USER_5:
		column = 1;
		return permission_table[operation][column];
		break;

	default:
		return 0;
	}
}

/*
 * FIPS_DENIED no access
 * FIPS_READ read access
 * FIPS_WRITE write access
 */
uint32_t fips_get_asset_permissions(fips_owner_user session_user,
		fips_owner_user asset_owner)
{

	switch (session_user) {
	case FIPS_OWNER_ANONYMOUS:
		return (FIPS_DENIED);
		break;

	case FIPS_OWNER_CRYPTO_OFFICER:
		if ((asset_owner == FIPS_OWNER_CRYPTO_OFFICER)
				|| (asset_owner == FIPS_OWNER_ALL)) {
			return (FIPS_WRITE | FIPS_READ);
		} else {
			return FIPS_DENIED;
		}
		break;

	case FIPS_OWNER_USER_0:
	case FIPS_OWNER_USER_1:
	case FIPS_OWNER_USER_2:
	case FIPS_OWNER_USER_3:
	case FIPS_OWNER_USER_4:
	case FIPS_OWNER_USER_5:
		if (asset_owner == session_user) {
			return (FIPS_WRITE | FIPS_READ);
		} else if (asset_owner == FIPS_OWNER_ALL) {
			return FIPS_READ;
		} else {
			return FIPS_DENIED;
		}
		break;

	default:
		return FIPS_DENIED;
	}
}

int32_t fips_is_fips_asset_location(int asset)
{
	int32_t valid = 0;

	switch (asset) {
	case FIPS_ASSET_DYNAMIC:
	case FIPS_ASSET_STATIC:
		valid = 1;
	};

	return valid;

}

int32_t fips_is_fips_direction(int direction)
{
	int32_t valid = 0;

	switch (direction) {
	case FIPS_CIPHER_ENCRYPT:
	case FIPS_CIPHER_DECRYPT:
		valid = 1;
	};

	return valid;

}

int32_t fips_is_valid_tag_length(uint32_t length)
{
	if ((length == 16) ||
		(length == 15) ||
		(length == 14) ||
		(length == 13) ||
		(length == 12))
		return 1;
	else
		return 0;
}

int32_t fips_asset_to_buffer(fips_asset *asset, uint8_t *inout_buffer,
		uint32_t *inout_buffer_len)
{
	fips_asset_type type;
	type = (asset->metadata) & 0xff;
	int32_t status = 0;

	size_t size;
	size_t total_len;
	uint8_t *tmp_bf = inout_buffer;
	uint32_t remainder;

	total_len = 0;

	size = sizeof(fips_asset) - sizeof(asset->asset_data);
	total_len += size;
	if (total_len < (MAX_TEEFS_BUFFER_LEN))
		memcpy(tmp_bf, (uint8_t *) asset, size);
	else {
		dprintk("TEEFS buffer too small for asset\n");
		status = 1;
		goto out;
	}
	tmp_bf += size;

	switch (type) {
	case FIPS_TYPE_AES:
	case FIPS_TYPE_AES_GCM_ENCRYPT:
	case FIPS_TYPE_AES_GCM_DECRYPT:
	case FIPS_TYPE_WRAP_KEY:
		;
		fips_aes_key *aeskey;
		aeskey = (fips_aes_key *) asset->asset_data;
		size = sizeof(fips_aes_key) - sizeof(aeskey->key);
		total_len += size;
		if (total_len < (MAX_TEEFS_BUFFER_LEN))
			memcpy(tmp_bf, (uint8_t *) aeskey, size);
		else {
			dprintk("TEEFS buffer too small for asset\n");
			status = 1;
			goto out;
		}
		tmp_bf += size;
		if (total_len < (MAX_TEEFS_BUFFER_LEN))
			memcpy(tmp_bf, aeskey->key, aeskey->size);
		else {
			dprintk("TEEFS buffer too small for asset\n");
			status = 1;
			goto out;
		}
		tmp_bf += aeskey->size;
		total_len += aeskey->size;
		status = 0;
		break;
	case FIPS_TYPE_HMAC_SHA224:
	case FIPS_TYPE_HMAC_SHA256:
	case FIPS_TYPE_HMAC_SHA384:
	case FIPS_TYPE_HMAC_SHA512:
#if (defined CONFIG_CMRT_S3HC || defined CONFIG_CMRT_S3HC2)
	case FIPS_TYPE_HMAC_SHA3_224:
	case FIPS_TYPE_HMAC_SHA3_256:
	case FIPS_TYPE_HMAC_SHA3_384:
	case FIPS_TYPE_HMAC_SHA3_512:
#endif
		;
		fips_hmac_key *hmackey;
		hmackey = (fips_hmac_key *) asset->asset_data;
		size = sizeof(fips_hmac_key) - sizeof(hmackey->key);
		total_len += size;
		if (total_len < (MAX_TEEFS_BUFFER_LEN))
			memcpy(tmp_bf, (uint8_t *) hmackey, size);
		else {
			dprintk("TEEFS buffer too small for asset\n");
			status = 1;
			goto out;
		}
		tmp_bf += size;
		if (total_len < (MAX_TEEFS_BUFFER_LEN))
			memcpy(tmp_bf, hmackey->key, hmackey->size);
		else {
			dprintk("TEEFS buffer too small for asset\n");
			status = 1;
			goto out;
		}
		tmp_bf += hmackey->size;
		total_len += hmackey->size;
		status = 0;
		break;
	default:
		dprintk("Unknown asset type\n");
		goto out;
	}

	remainder = total_len % 4;
	if (remainder != 0) {
		total_len += remainder;
		if (total_len < (MAX_TEEFS_BUFFER_LEN))
			memset(tmp_bf, 0x00, remainder);
		else {
			dprintk("TEEFS buffer too small for asset\n");
			status = 1;
			goto out;
		}

	}

	*inout_buffer_len = total_len;
	dhexdump("In the buffer", inout_buffer, *inout_buffer_len);
	goto out1;

out:
	memset(inout_buffer, 0x00, MAX_TEEFS_BUFFER_LEN);
out1:
	return status;
}

int32_t fips_check_valid_key_length(fips_asset_type type, size_t checksize)
{
	int32_t status = -EINVAL;

	dprintk("type: %d, length: %d\n", type, checksize);

	if (checksize == 0) {
		goto err;
	}

	switch (type) {
	case FIPS_TYPE_SECRET:
		if (checksize <= 512) {
			status = 0;
		}
		break;
	case FIPS_TYPE_AES:
#ifdef CONFIG_CMRT_AES_192BIT
		if ((checksize == 16) || (checksize == 24) || (checksize == 32)) {
#else
		if ((checksize == 16) || (checksize == 32)) {
#endif
			status = 0;
		}
		break;
	case FIPS_TYPE_WRAP_KEY:
	case FIPS_TYPE_AES_GCM_ENCRYPT:
	case FIPS_TYPE_AES_GCM_DECRYPT:
#ifdef CONFIG_CMRT_AES_192BIT
		if ((checksize == 16) || (checksize == 24) || (checksize == 32)) {
#else
		if ((checksize == 16) || (checksize == 32)) {
#endif
			status = 0;
		}
		break;
	case FIPS_TYPE_HMAC_SHA224:
		if (checksize <= 64) {
			status = 0;
		}
		break;
	case FIPS_TYPE_HMAC_SHA256:
		if (checksize <= 64) {
			status = 0;
		}
		break;
	case FIPS_TYPE_HMAC_SHA384:
		if (checksize <= 128) {
			status = 0;
		}
		break;
	case FIPS_TYPE_HMAC_SHA512:
		if (checksize <= 128) {
			status = 0;
		}
		break;
#if (defined CONFIG_CMRT_S3HC || defined CONFIG_CMRT_S3HC2)
	case FIPS_TYPE_HMAC_SHA3_224:
		if (checksize <= 144) {
			status = 0;
		}
		break;
	case FIPS_TYPE_HMAC_SHA3_256:
		if (checksize <= 136) {
			status = 0;
		}
		break;
	case FIPS_TYPE_HMAC_SHA3_384:
		if (checksize <= 104) {
			status = 0;
		}
		break;
	case FIPS_TYPE_HMAC_SHA3_512:
		if (checksize <= 72) {
			status = 0;
		}
		break;
#endif
	default:
		dprintk("Unknown asset type\n");
	}

err:
	return status;
}

int32_t buffer_to_fips_asset(uint8_t *inout_buffer,
		uint32_t *inout_buffer_len, uint8_t *destination,
		uint8_t *workbuffer)
{
	fips_asset *asset;
	fips_asset_type type;
	size_t len;
	uint8_t *tmp_destination;
	uint8_t *tmp_source;
	int32_t status;
	fips_command workcontext_type = 0;
	uint32_t *workcontext_32;
	void *workcontext_struct = NULL;

	status = 0;

	if ((destination == NULL) | (inout_buffer == NULL)) {
		dprintk("Buffer pointers are not valid\n");
		status = 1;
		goto out;
	}

	if (workbuffer != NULL) {
		workcontext_32 = (uint32_t *) workbuffer;
		workcontext_type = workcontext_32[0];
		dprintk("Workcontext_type %d\n", workcontext_type);
		workcontext_struct = (void *) (workbuffer + 4);
	}

	tmp_destination = destination;
	tmp_source = inout_buffer;

	asset = (fips_asset *) tmp_destination;
	len = sizeof(fips_asset) - sizeof(asset->asset_data);
	memcpy(tmp_destination, tmp_source, len);
	tmp_destination += len;
	tmp_source += len;

	type = GET_ASSET_TYPE(asset->metadata);

	switch (type) {
	case FIPS_TYPE_AES:
	case FIPS_TYPE_AES_GCM_ENCRYPT:
	case FIPS_TYPE_AES_GCM_DECRYPT:
	case FIPS_TYPE_WRAP_KEY:
		;
		aeskey_work_struct *aeskey_work = NULL;
		if (((workcontext_type >= FIPS_SERVICE_AES_ECB)
				&& (workcontext_type <= FIPS_SERVICE_AES_CFB128_FINAL))
				|| (workcontext_type == FIPS_SERVICE_IMPORT_KEY)
				|| (workcontext_type == FIPS_SERVICE_EXPORT_KEY)
				|| (workcontext_type == FIPS_SERVICE_MAC_GEN_INIT)
				|| (workcontext_type == FIPS_SERVICE_MAC_VERIFY_INIT)) {
			aeskey_work = (aeskey_work_struct *) workcontext_struct;
			aeskey_work->asset = (fips_asset *) (tmp_destination - len);
			asset->asset_data = tmp_destination + sizeof(asset->asset_data);
		}
		tmp_destination += PTR_SIZE;
		fips_aes_key *aeskey;
		fips_aes_key *aeskeys;
		aeskeys = (fips_aes_key *) tmp_source;
		aeskey = (fips_aes_key *) tmp_destination;
		if (((workcontext_type >= FIPS_SERVICE_AES_ECB)
				&& (workcontext_type <= FIPS_SERVICE_AES_CFB128_FINAL))
				|| (workcontext_type == FIPS_SERVICE_IMPORT_KEY)
				|| (workcontext_type == FIPS_SERVICE_EXPORT_KEY)
				|| (workcontext_type == FIPS_SERVICE_MAC_GEN_INIT)
				|| (workcontext_type == FIPS_SERVICE_MAC_VERIFY_INIT)) {
			aeskey_work->key = (fips_aes_key *) tmp_destination;
		}
		len = sizeof(fips_aes_key) - PTR_SIZE;
		memcpy(tmp_destination, tmp_source, len);
		tmp_destination += len;
		tmp_source += len;
		if (((workcontext_type >= FIPS_SERVICE_AES_ECB)
				&& (workcontext_type <= FIPS_SERVICE_AES_CFB128_FINAL))
				|| (workcontext_type == FIPS_SERVICE_IMPORT_KEY)
				|| (workcontext_type == FIPS_SERVICE_EXPORT_KEY)
				|| (workcontext_type == FIPS_SERVICE_MAC_GEN_INIT)
				|| (workcontext_type == FIPS_SERVICE_MAC_VERIFY_INIT)) {
			aeskey->key = tmp_destination + sizeof(aeskey->key);
		}
		tmp_destination += PTR_SIZE;
		memcpy(tmp_destination, tmp_source, aeskeys->size);
		if (((workcontext_type >= FIPS_SERVICE_AES_ECB)
				&& (workcontext_type <= FIPS_SERVICE_AES_CFB128_FINAL))
				|| (workcontext_type == FIPS_SERVICE_IMPORT_KEY)
				|| (workcontext_type == FIPS_SERVICE_EXPORT_KEY)
				|| (workcontext_type == FIPS_SERVICE_MAC_GEN_INIT)
				|| (workcontext_type == FIPS_SERVICE_MAC_VERIFY_INIT)) {
			aeskey_work->keyvalue = (uint8_t *) tmp_destination;
		}
		break;
	case FIPS_TYPE_HMAC_SHA224:
	case FIPS_TYPE_HMAC_SHA256:
	case FIPS_TYPE_HMAC_SHA384:
	case FIPS_TYPE_HMAC_SHA512:
#if (defined CONFIG_CMRT_S3HC || defined CONFIG_CMRT_S3HC2)
	case FIPS_TYPE_HMAC_SHA3_224:
	case FIPS_TYPE_HMAC_SHA3_256:
	case FIPS_TYPE_HMAC_SHA3_384:
	case FIPS_TYPE_HMAC_SHA3_512:
#endif
		;
		mackey_work_struct *mackey_work;
		if ((workcontext_type >= FIPS_SERVICE_MAC_GEN_INIT)
				&& (workcontext_type <= FIPS_SERVICE_MAC_UPDATE)) {
			mackey_work = (mackey_work_struct *) workcontext_struct;
			mackey_work->asset = (fips_asset *) (tmp_destination - len);
			asset->asset_data = tmp_destination + sizeof(asset->asset_data);
		}
		tmp_destination += PTR_SIZE;
		fips_hmac_key *hmackey;
		fips_hmac_key *hmackeys;
		hmackey = (fips_hmac_key *) tmp_destination;
		hmackeys = (fips_hmac_key *) tmp_source;
		if ((workcontext_type >= FIPS_SERVICE_MAC_GEN_INIT)
				&& (workcontext_type <= FIPS_SERVICE_MAC_UPDATE)) {
			mackey_work->key = (fips_hmac_key *) tmp_destination;
		}
		len = sizeof(fips_hmac_key) - PTR_SIZE;
		memcpy(tmp_destination, tmp_source, len);
		tmp_destination += len;
		tmp_source += len;
		if ((workcontext_type >= FIPS_SERVICE_MAC_GEN_INIT)
				&& (workcontext_type <= FIPS_SERVICE_MAC_UPDATE)) {
			hmackey->key = tmp_destination + sizeof(hmackey->key);
		}
		tmp_destination += PTR_SIZE;
		memcpy(tmp_destination, tmp_source, hmackeys->size);
		if ((workcontext_type >= FIPS_SERVICE_MAC_GEN_INIT)
				&& (workcontext_type <= FIPS_SERVICE_MAC_UPDATE)) {
			mackey_work->keyvalue = (uint8_t *) tmp_destination;
		}
		break;
	default:
		printk("No valid data in buffer\n");
		status = -EINVAL;
	}

out:
	return status;
}

uint8_t asset_overhead[FIPS_TYPE_NUM] = {0,
					 4, /* FIPS_TYPE_AES */
					 4, /* FIPS_TYPE_HMAC_SHA224 */
					 4, /* FIPS_TYPE_HMAC_SHA256 */
					 4, /* FIPS_TYPE_HMAC_SHA384 */
					 4, /* FIPS_TYPE_HMAC_SHA512 */
					 8, /* FIPS_TYPE_RSA_PUBLIC_KEY */
					 8, /* FIPS_TYPE_RSA_KEYPAIR */
					 8, /* FIPS_TYPE_RSA_PF_KEYPAIR */
					 8, /* FIPS_TYPE_RSA_CRT_KEYPAIR */
					 4, /* FIPS_TYPE_ECDSA_PUBLIC_KEY */
					 4, /* FIPS_TYPE_ECDSA_KEYPAIR */
					 4, /* FIPS_TYPE_ECDH_PUBLIC_KEY */
					 4, /* FIPS_TYPE_ECDH_KEYPAIR */
					 4, /* FIPS_TYPE_SHARED_SECRET */
					 4, /* FIPS_TYPE_AES_GCM_ENCRYPT */
					 4, /* FIPS_TYPE_AES_GCM_DECRYPT */
					 4, /* FIPS_TYPE_WRAP_KEY */
					 4, /* FIPS_TYPE_SECRET */
					 4, /* FIPS_TYPE_HMAC_SHA3_224 */
					 4, /* FIPS_TYPE_HMAC_SHA3_256 */
					 4, /* FIPS_TYPE_HMAC_SHA3_384 */
					 4, /* FIPS_TYPE_HMAC_SHA3_512 */
					 4, /* FIPS_TYPE_DILITHIUM_PUBLIC_KEY */
					 4, /* FIPS_TYPE_DILITHIUM_KEYPAIR */
					 4, /* FIPS_TYPE_KYBER_ENCAP_KEY */
					 4  /* FIPS_TYPE_KYBER_KEYPAIR */
					};
```

## src/fips.h
```c
/*
 * Copyright (c) 2020-2024 Cryptography Research, Inc. (CRI).
 * A license or authorization from CRI is needed to use this file.
 */

#ifndef CMRT_FIPS_H
#define CMRT_FIPS_H

#include <stdint.h>
#include <stddef.h>

#include <cri/cmrt/fips/fips_types.h>

#include "cmvp_sw.h"
#include <tee_client_api.h> /* TEEC_MEMREF values */
#include <tee_client_abi.h>

#include <cri/cmrt.h>
#include <cri/cmrt/hc.h>
#include <cri/cmrt/aes.h>

#define SHA_BUF_MAX_SIZE 64
#define PTR_SIZE 4

typedef struct {
	uint8_t user;
	uint8_t teec_session;
	uint8_t user_session;
	uint8_t authenticated_login_started;
	uint8_t approved_mode;
	uint32_t key_length;
	uint8_t *key_value;
	uint8_t *scratch;
	uint8_t do_reset;
} fips_state_t;

typedef struct {
	fips_asset *asset;
	fips_aes_key *key;
	uint8_t *keyvalue;
} aeskey_work_struct;

typedef struct {
	aeskey_work_struct aeskey;
	uint8_t *IV;
	uint32_t IVlen;
	cri_aes_t aesengine;
	uint32_t direction;
	uint32_t taglen;
} aes_work_struct;

typedef struct {
	uint32_t hashtype;
	uint32_t hashlen;
	uint8_t hash_buffer[SHA_BUF_MAX_SIZE];
	uint32_t buffer_offset;
	cri_hc_t hashengine;
} hash_work_struct;

typedef struct {
	fips_asset *asset;
	fips_hmac_key *key; /* also used for AES CMAC with cast */
	uint8_t *keyvalue;
} mackey_work_struct;

typedef struct {
	mackey_work_struct mackey;
	hash_work_struct sha;
	aes_work_struct aes;
} mac_work_struct;

typedef struct {
	aes_work_struct aeskey;
	uint8_t *scratch;
} import_work_struct;

typedef struct {
	aes_work_struct aeskey;
	fips_asset *outkey;
	uint8_t *scratch;
} export_work_struct;

void fips_intialize_state(fips_state_t *state);

int32_t fips_login(fips_state_t *state, teec_abi_header_t *h);
int32_t fips_logout(fips_state_t *state, teec_abi_header_t *h);
int32_t fips_service_login_final(fips_state_t *state, teec_abi_invokecommand_t *h);

int32_t fips_service_command(fips_state_t *state, teec_abi_invokecommand_t *h);
int32_t get_approved_mode(fips_command operation, uint8_t *approved_mode);
uint32_t fips_get_permissions(fips_owner_user user, fips_command operation);

#define FIPS_DENIED 0
#define FIPS_READ 1
#define FIPS_WRITE 2
uint32_t fips_get_asset_permissions(fips_owner_user session_user,
		fips_owner_user asset_owner);

#define FIPS_IMPORT 0
#define FIPS_EXPORT 1
int32_t fips_key_import_export(fips_state_t *state, teec_abi_invokecommand_t *h, uint8_t direction);
/*int32_t fips_key_import(fips_state_t *state, teec_abi_invokecommand_t *h);*/
int32_t fips_key_export(fips_state_t *state, teec_abi_invokecommand_t *h);
int32_t fips_service_export_ktc(fips_state_t *state, teec_abi_invokecommand_t *h);

int32_t get_randomness_int(uint8_t *buffer, size_t size);
int32_t fips_get_randomness(fips_state_t *state, teec_abi_invokecommand_t *h);
int32_t fips_generate_symmetric_key(fips_state_t *state, teec_abi_invokecommand_t *h);

#define DERIVE_KEY_ONE_STEP 1
#define DERIVE_KEY_TWO_STEP 2
int32_t fips_derive_symmetric_key(fips_state_t *state, teec_abi_invokecommand_t *h, uint8_t step);

int32_t fips_aes_ecb(fips_state_t *state, teec_abi_invokecommand_t *h);
int32_t fips_aes_cbc_init(fips_state_t *state, teec_abi_invokecommand_t *h);
int32_t fips_aes_cbc_update(fips_state_t *state, teec_abi_invokecommand_t *h);
int32_t fips_aes_cbc_final(fips_state_t *state, teec_abi_invokecommand_t *h);
int32_t fips_aes_gcm_init(fips_state_t *state, teec_abi_invokecommand_t *h);
int32_t fips_aes_gcm_aad_update(fips_state_t *state, teec_abi_invokecommand_t *h);
int32_t fips_aes_gcm_update(fips_state_t *state, teec_abi_invokecommand_t *h);
int32_t fips_aes_gcm_encrypt_final(fips_state_t *state, teec_abi_invokecommand_t *h);
int32_t fips_aes_gcm_decrypt_final(fips_state_t *state, teec_abi_invokecommand_t *h);
int32_t fips_aes_ctr_init(fips_state_t *state, teec_abi_invokecommand_t *h);
int32_t fips_aes_ctr_update(fips_state_t *state, teec_abi_invokecommand_t *h);
int32_t fips_aes_ctr_final(fips_state_t *state, teec_abi_invokecommand_t *h);
int32_t fips_aes_cfb128_init(fips_state_t *state, teec_abi_invokecommand_t *h);
int32_t fips_aes_cfb128_update(fips_state_t *state, teec_abi_invokecommand_t *h);
int32_t fips_aes_cfb128_final(fips_state_t *state, teec_abi_invokecommand_t *h);

int32_t hash_int(hash_work_struct *sha, uint8_t *in_dataarray, size_t inlen, uint8_t *out_hash, size_t outlen);
int32_t fips_hash_init(fips_state_t *state, teec_abi_invokecommand_t *h);
int32_t fips_hash_update(fips_state_t *state, teec_abi_invokecommand_t *h);
int32_t fips_hash_final(fips_state_t *state, teec_abi_invokecommand_t *h);

int32_t fips_mac_gen_init(fips_state_t *state, teec_abi_invokecommand_t *h);
int32_t fips_mac_update(fips_state_t *state, teec_abi_invokecommand_t *h);
int32_t fips_mac_gen_final(fips_state_t *state, teec_abi_invokecommand_t *h);
int32_t fips_mac_ver_init(fips_state_t *state, teec_abi_invokecommand_t *h);
int32_t fips_mac_ver_final(fips_state_t *state, teec_abi_invokecommand_t *h);

int32_t fips_create_user(fips_state_t *state, teec_abi_invokecommand_t *h);
int32_t fips_delete_user(fips_state_t *state, teec_abi_invokecommand_t *h);

int32_t fips_ec_generate_key(fips_state_t *state, teec_abi_invokecommand_t *h);
int32_t fips_ecdsa_sign(fips_state_t *state, teec_abi_invokecommand_t *h);
int32_t fips_ecdsa_verify(fips_state_t *state, teec_abi_invokecommand_t *h);
int32_t fips_ecdsa_pk_test(fips_state_t *state, teec_abi_invokecommand_t *h);
int32_t fips_ecdh(fips_state_t *state, teec_abi_invokecommand_t *h);

int32_t fips_selftest(fips_state_t *state, teec_abi_invokecommand_t *h);

int32_t fips_rsa_generate_keypair(fips_state_t *state, teec_abi_invokecommand_t *h);
int32_t fips_rsa_sign(fips_state_t *state, teec_abi_invokecommand_t *h);
int32_t fips_rsa_verify(fips_state_t *state, teec_abi_invokecommand_t *h);

int32_t fips_move_asset(fips_state_t *state, teec_abi_invokecommand_t *h);
int32_t fips_zeroize_assets(fips_state_t *state, teec_abi_invokecommand_t *h);
int32_t fips_list_asset_service(fips_state_t *state, teec_abi_invokecommand_t *h);
int32_t fips_show_status(fips_state_t *state, teec_abi_invokecommand_t *h);
int32_t fips_drbg(fips_state_t *state, teec_abi_invokecommand_t *h);

int32_t fips_is_fips_asset_location(int asset);
int32_t fips_is_fips_direction(int direction);
int32_t fips_is_valid_tag_length(uint32_t length);
int32_t fips_asset_to_buffer(fips_asset *asset, uint8_t *inout_buffer,
		uint32_t *inout_buffer_len);
int32_t buffer_to_fips_asset(uint8_t *inout_buffer,
		uint32_t *inout_buffer_len, uint8_t *destination,
		uint8_t *workcontext_buffer);
int32_t fips_check_valid_asset_size_ext(fips_asset_type type, size_t checksize);
int32_t fips_check_valid_key_length(fips_asset_type type, size_t checksize);

void destroy_workcontext(int32_t length);
void destroy_workcontext_and_halt(int32_t status);
int32_t destroy_workcontext_and_reset(fips_state_t *state);

int32_t test_otp(void);

int32_t fips_dilithium_generate_keypair(fips_state_t *state, teec_abi_invokecommand_t *h);
int32_t fips_dilithium_sign(fips_state_t *state, teec_abi_invokecommand_t *h);
int32_t fips_dilithium_verify(fips_state_t *state, teec_abi_invokecommand_t *h);

int32_t fips_kyber_kem_generate_keypair(fips_state_t *state, teec_abi_invokecommand_t *h);
int32_t fips_kyber_kem_encapsultate(fips_state_t *state, teec_abi_invokecommand_t *h);
int32_t fips_kyber_kem_decapsultate(fips_state_t *state, teec_abi_invokecommand_t *h);

int32_t fips_lms_verify(fips_state_t *state, teec_abi_invokecommand_t *h);
int32_t fips_hss_verify(fips_state_t *state, teec_abi_invokecommand_t *h);
int32_t fips_xmss_verify(fips_state_t *state, teec_abi_invokecommand_t *h);
int32_t fips_xmss_mt_verify(fips_state_t *state, teec_abi_invokecommand_t *h);

#endif
```
