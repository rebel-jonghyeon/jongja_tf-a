## CMakeLists.txt
```
# Copyright (c) 2017-2023 Cryptography Research, Inc. (CRI).

cmake_minimum_required(VERSION 3.20.0)

find_package(Zephyr REQUIRED HINTS $ENV{ZEPHYR_BASE})
project(sboot)

add_definitions(-DSBOOT_VERSION_INFO="${SBOOT_VERSION_INFO}")

target_include_directories(
	app
	PRIVATE
	${ZEPHYR_BASE}/kernel/include
	${ZEPHYR_BASE}/samples/cmrt/fboot/include
	${ZEPHYR_BASE}/samples/cmrt/fboot/src
	${ZEPHYR_BASE}/include
	${ZEPHYR_BASE}/drivers/cmrt
	${ZEPHYR_BASE}/lib/gpt/include
	${ZEPHYR_BASE}/lib/integrity/include
	src
	src/drivers/cmu
	src/drivers/dma
	src/drivers/spi
	src/drivers/timer
	src/drivers/uart
	src/drivers/sac
)

target_sources(
	app
	PRIVATE
	src/main.c
	src/emergency.c
	src/drivers/dma/dma.c
	src/drivers/cmu/cmu.c
	src/drivers/spi/dwc_ssi.c
	src/drivers/timer/timer.c
	src/drivers/uart/uart.c
	src/drivers/sac/sac_custom.c
	../../fboot/src/lifecycle.c
	../../fboot/src/fboot.c
	../../fboot/src/img.c
	../../fboot/src/syscalls.c
	../../fboot/src/supervisor.c
	../../fboot/src/supervisor.S
	../../fboot/src/isr.S
)

target_sources_ifdef(
	CONFIG_CMRT_DATASTORE
	app
	PRIVATE
	../../fboot/src/datastore.c
)

target_sources_ifdef(
	CONFIG_CMRT_CFI
	app
	PRIVATE
	../../fboot/src/cfi.c
)

target_sources_ifdef(
	CONFIG_CMRT_FBOOT_HAS_RSA_VERIFY
	app
	PRIVATE
	../../fboot/src/fboot_rsa_verify.c
)

target_sources_ifdef(
	CONFIG_CMRT_FBOOT_HAS_LMS_VERIFY
	app
	PRIVATE
	../../fboot/src/fboot_lms_verify.c
)

target_sources_ifdef(
	CONFIG_CMRT_FBOOT_HAS_LMS_HSS_VERIFY
	app
	PRIVATE
	../../fboot/src/fboot_lms_hss_verify.c
)

target_sources_ifdef(
	CONFIG_CMRT_FBOOT_HAS_XMSS_VERIFY
	app
	PRIVATE
	../../fboot/src/fboot_xmss_verify.c
)

if(CONFIG_CMRT_CALIPTRA_SUPPORT)
	target_sources(app PRIVATE src/caliptra.c)
	target_link_libraries(app PRIVATE caliptra)
endif()
```

## Kconfig
```
# Copyright (c) 2023 Cryptography Research, Inc. (CRI)

menu "SBOOT Options"

config CMRT_SBOOT_WATCHDOG_TIMEOUT_MS
	int "Watchdog timeout in milliseconds"
	default 5000 if CMRT_CALIPTRA_SUPPORT
	default 2863 if CMRT_FBOOT_HAS_LMS_VERIFY || CMRT_FBOOT_HAS_LMS_HSS_VERIFY || CMRT_FBOOT_HAS_XMSS_VERIFY || CMRT_FBOOT_HAS_XMSS_MT_VERIFY
	default 0
	help
	  CMRT boot till sboot with HW configured watchdog timeout.
	  sboot configures watchdog timeout to a value that is appropriate for
	  the device. This value should be changed by customer. If the value is
	  zero then sboot will not configure a new watchdog timeout.
endmenu

rsource "../fboot/Kconfig"
```

## prj.conf
```kconfig
../fboot/prj.conf
```

## src/main.c
```c
/*
 * Copyright (c) 2017-2023 Cryptography Research, Inc. (CRI).
 * A license or authorization from CRI is needed to use this file.
 */

#include <fboot.h>
#include <sboot.h>
#include <syscalls.h>
#ifdef CONFIG_WDT_CMRT
#include <drivers/watchdog.h>
#endif
#ifdef CONFIG_CMRT_CALIPTRA_SUPPORT
#include "caliptra.h"
#endif

#include <logging/log.h>
LOG_MODULE_DECLARE(cmrt, CONFIG_CMRT_LOG_LEVEL);

const static char version_info[] __version = SBOOT_VERSION_INFO;

#include <rebel_h.h>
#include <rebel_h_gpt.h>
#include <rebel_h_integrity.h>
#include "sac_custom.h"
#include "dma.h"
#include "dma_reg.h"
#include "cmu.h"
#include "dwc_ssi.h"
#include "uart.h"
#include "emergency.h"

#define SYSREG_ROT_PRIVATE			(0x1E00210000ULL)
#define PAD_ROT						(0x6A8)
#define EMERGENCY_DOWNLOAD			(0x1)

#define OM_STAT						(0x0)
#define OM_MASK						(0x7)
#define PCIE_OPTION					(0x4248)
#define CM7_CPU_PCIE_OPTION			(0x6E48)
#define ENABLE_CPU					(0x1)
#define PCIE_ISOLATION				(0x20000000U)

#define SECURE_OTP_BOOT				(0x1)
#define SECURE_XIP_BOOT				(0x3)
#define NORMAL_BOOT					(0x5)
#define RECOVERY_BOOT				(0x6)
#define TEST_BOOT					(0x7)

#define TBOOT_S_DEST_ADDR			(0x1006A00)
#define TBOOT_P0_DEST_ADDR			(0x1FF8000000ULL)
#define TBOOT_P1_DEST_ADDR			(0x1FF8230000ULL)
/* Copy TBOOT_P1 footer to CMRT sram because of PCIe sram size limit */
#define TBOOT_P1_FOOTER_DEST_ADDR	TBOOT_S_DEST_ADDR

#define PCIE_SUB_CTRL_INST			(0x1E08180000ULL)
#define SFR_PHY_CFG_0_REG			(0x20EC)
#define SFR_PHY_CFG_102_REG			(0x1138)
#define SFR_PHY_CFG_103_REG			(0x113C)
#define SFR_PHY_CFG_104_REG			(0x1140)
#define PHY_SRAM_EXT_LD_DONE		(0x20)

#define PHY_SRAM_INIT_DONE			(0x1)
#define WAIT_PCIE_PHY_SRAM_INIT_DONE(sfr)								\
	cmrt_sac_set_base(NULL, GET_SAC_BASE(PCIE_SUB_CTRL_INST + (sfr)));	\
	do {																\
		cmrt_wdt_feed();											\
	} while (!(sys_read32(GET_SAC_R_CPU_DATA(sfr)) & PHY_SRAM_INIT_DONE))

#define PCIE_PHY0_CFG_REG			(0x215C)
#define PCIE_PHY1_CFG_REG			(0x112C)
#define PCIE_PHY2_CFG_REG			(0x1130)
#define PCIE_PHY3_CFG_REG			(0x1134)

#define SYSREG_PCIE_BASE			(0x1E08110000ULL)
#define MUX_CR_PARA_SEL				(0x644)
#define MUX_CR_PARA_SEL_SEPARATE	(0x1)
#define MUX_CR_PARA_SEL_BROADCAST	(0x0)

#define SRAM_INTEGRITY_CHECK_DONE	(0xAAAAAAAAU)

#define SAC_EXT_ADDR_WIDTH_HI_MASK	(0xFF)

enum sboot_s_boot_sequence {
	NOT_STARTED,
	INIT_LOG,
	HW_INIT,
	CHECK_EMERGENCY_DOWNLOAD,
	RUN_EMERGENCY_DOWNLOAD,
	LOAD_AND_CHECK_TBOOT_P0,
	RESET_RELEASE_CM7,
	WAIT_CM7_RESET_DONE,
	LOAD_AND_CHECK_TBOOT_P1,
	NOTIFY_CM7_PHY_RESET_DONE,
	LOAD_AND_CHECK_TBOOT_S,
	RETURN_TO_FBOOT_S,
};

extern uint32_t fboot_supervisor_clear(void);
extern int fboot_supervisor_start(void);

struct dma_block_config img_info[] = {
	/* Sboot_n default info */
	{
	},
	/* Tboot_s default info */
	{
		.dest_address = TBOOT_S_DEST_ADDR,
	},
	/* tboot_n default info */
	{
	},
	/* Tboot_p0 default info */
	{
		.dest_address = TBOOT_P0_DEST_ADDR,
	},
	/* Tboot_p1 default info */
	{
		.dest_address = TBOOT_P1_DEST_ADDR,
	},
	/* Tboot_u default info */
	{
	},
	/* CP0_BL31 default info */
	{
	},
	/* CP0_FREERTOS default info */
	{
	},
	/* CP1_BL31 default info */
	{
	},
	/* CP1_FREERTOS default info */
	{
	},
	/* Tboot_p1_footer default info */
	{
	},
};

int copy_image(uint32_t img_type, uint32_t length, struct dma_block_config img_info[])
{
	/*
	 * TBOOT_S and footer will be copied in CMRT sram
	 * TBOOT_P0 and footer will be copied in BLK_PCIE intmem,
	 * then footer will be copied from intmem to CMRT sram
	 * TBOOT_P1 will be copied in BLK_PCIE intmem, footer will be in CMRT sram
	 */
	if (img_type == IMG_TBOOT_P0) {
		sboot_dma_config(&img_info[img_type]);
		sboot_dma_start();
		sboot_dma_xfer_done();
		return 0;
	} else if (img_type == IMG_TBOOT_P1) {
		uint64_t img_footer_addr = img_info[img_type].source_address + length - sizeof(uint32_t);

		cmrt_sac_set_base(NULL, GET_SAC_BASE(img_footer_addr));
		uint32_t img_footer_length = sys_read32(GET_SAC_R_CPU_DATA(img_footer_addr));

		if (length != TBOOT_P1_SRAM_MAX * 2 + img_footer_length) {
			return -EINVAL;
		}
		img_info[img_type].block_size = TBOOT_P1_SRAM_MAX;

		cmrt_sac_set_base(NULL, GET_SAC_BASE(PHY0_APB2CR_PARA_PCIE + MUX_SWITCH));
		int value = sys_read32(GET_SAC_R_CPU_DATA(MUX_SWITCH));

		sboot_dma_config(&img_info[img_type]);
		sboot_dma_start();
		sboot_dma_xfer_done();

		uint64_t base = PHY0_APB2CR_PARA_PCIE + MUX_SWITCH;

		cmrt_sac_set_base(NULL, GET_SAC_BASE(base));
		sys_write32(value | MUX_VALUE, GET_SAC_R_CPU_DATA(base));
		img_info[img_type].source_address += img_info[img_type].block_size;

		sboot_dma_config(&img_info[img_type]);
		sboot_dma_start();
		sboot_dma_xfer_done();

		base = PHY0_APB2CR_PARA_PCIE + MUX_SWITCH;
		cmrt_sac_set_base(NULL, GET_SAC_BASE(base));
		sys_write32(value, GET_SAC_R_CPU_DATA(base));

		img_info[IMG_TBOOT_P1_FOOTER].block_size = img_footer_length;
		img_info[IMG_TBOOT_P1_FOOTER].source_address = img_info[img_type].source_address
														+ img_info[img_type].block_size;

		return 0;
	} else if (img_type == IMG_TBOOT_S) {
		uint64_t src = img_info[IMG_TBOOT_S].source_address;
		int res = 0;

		if ((src >> 32) > 0) {
			cmrt_sac_set_base(NULL, GET_SAC_BASE(src));

			cmrt_dmac_t dmac = cmrt_dmac_open(CMRT_O_SYNC);

			if (!cmrt_is_valid(dmac)) {
				return -ENODEV;
			}

			res = cmrt_dmac_data(dmac, GET_SAC_OFFSET(src),
								 img_info[IMG_TBOOT_S].dest_address, length, 0);
			cmrt_dmac_close(dmac);

			return res;
		} else {
			return -EINVAL;
		}
	} else {
		return -EINVAL;
	}
}

static void disable_timer(void)
{
	const struct device *wdt = device_get_binding(DT_LABEL(DT_ALIAS(watchdog0)));

	if (wdt) {
		(void)wdt_disable(wdt);
	}
}

static uint64_t check_condition(void)
{
	cmrt_sac_set_base(NULL, GET_SAC_BASE(CPMU_PRIVATE + OM_STAT));
	uint32_t bootmode = sys_read32(GET_SAC_R_CPU_DATA(OM_STAT)) & OM_MASK;

	if (bootmode != SECURE_OTP_BOOT && bootmode != SECURE_XIP_BOOT) {
		LOG_ERR("Not expected boot mode: %d", bootmode);
		disable_timer();
		while (1)
			__asm__("wfi");
	}

	return get_chiplet_id();
}

void hw_init(uint64_t chiplet_id)
{
	sac_set_config(SAC_EXT_ADDR_WIDTH_HI_MASK);

	cmu_init(chiplet_id);
	if (chiplet_id == CHIPLET_PRIMARY) {
		sboot_dma_init();
		dwc_ssi_config();
		gpt_init();
	}
}

void cm7_release_reset(void)
{
	uint64_t base = CPMU_PRIVATE;
	uint32_t val;

	cmrt_sac_set_base(NULL, GET_SAC_BASE(base + PCIE_OPTION));
	val = sys_read32(GET_SAC_R_CPU_DATA(base + PCIE_OPTION));
	val &= ~PCIE_ISOLATION;
	sys_write32(val, GET_SAC_R_CPU_DATA(base + PCIE_OPTION));

	cmrt_sac_set_base(NULL, GET_SAC_BASE(base + CM7_CPU_PCIE_OPTION));
	sys_write32(ENABLE_CPU, GET_SAC_R_CPU_DATA(base + CM7_CPU_PCIE_OPTION));
}

#ifdef CONFIG_WDT_CMRT
void cmrt_wdt_feed(void)
{
	(void)wdt_cmrt_feed(NULL, 0);
}
#else
void cmrt_wdt_feed(void)
{
	;
}
#endif

void cm7_wait_reset_done(void)
{
	WAIT_PCIE_PHY_SRAM_INIT_DONE(PCIE_PHY0_CFG_REG);
	WAIT_PCIE_PHY_SRAM_INIT_DONE(PCIE_PHY1_CFG_REG);
	WAIT_PCIE_PHY_SRAM_INIT_DONE(PCIE_PHY2_CFG_REG);
	WAIT_PCIE_PHY_SRAM_INIT_DONE(PCIE_PHY3_CFG_REG);
}

void cm7_notify_phy_load_done(void)
{
	uint64_t base = PCIE_SUB_CTRL_INST;
	uint32_t val;

	cmrt_sac_set_base(NULL, GET_SAC_BASE(base + SFR_PHY_CFG_0_REG));
	val = sys_read32(GET_SAC_R_CPU_DATA(base + SFR_PHY_CFG_0_REG));
	sys_write32(val | PHY_SRAM_EXT_LD_DONE, GET_SAC_R_CPU_DATA(base + SFR_PHY_CFG_0_REG));

	cmrt_sac_set_base(NULL, GET_SAC_BASE(base + SFR_PHY_CFG_102_REG));
	val = sys_read32(GET_SAC_R_CPU_DATA(base + SFR_PHY_CFG_102_REG));
	sys_write32(val | PHY_SRAM_EXT_LD_DONE, GET_SAC_R_CPU_DATA(base + SFR_PHY_CFG_102_REG));

	cmrt_sac_set_base(NULL, GET_SAC_BASE(base + SFR_PHY_CFG_103_REG));
	val = sys_read32(GET_SAC_R_CPU_DATA(base + SFR_PHY_CFG_103_REG));
	sys_write32(val | PHY_SRAM_EXT_LD_DONE, GET_SAC_R_CPU_DATA(base + SFR_PHY_CFG_103_REG));

	cmrt_sac_set_base(NULL, GET_SAC_BASE(base + SFR_PHY_CFG_104_REG));
	val = sys_read32(GET_SAC_R_CPU_DATA(base + SFR_PHY_CFG_104_REG));
	sys_write32(val | PHY_SRAM_EXT_LD_DONE, GET_SAC_R_CPU_DATA(base + SFR_PHY_CFG_104_REG));
}

void cm7_pcie_phy_para_sel(bool broadcast)
{
	cmrt_sac_set_base(NULL, GET_SAC_BASE(SYSREG_PCIE_BASE + MUX_CR_PARA_SEL));
	if (broadcast)
		sys_write32(MUX_CR_PARA_SEL_BROADCAST, GET_SAC_R_CPU_DATA(SYSREG_PCIE_BASE + MUX_CR_PARA_SEL));
	else
		sys_write32(MUX_CR_PARA_SEL_SEPARATE, GET_SAC_R_CPU_DATA(SYSREG_PCIE_BASE + MUX_CR_PARA_SEL));
}

int main(void)
{
	cmrt_set_boot_status(SBOOT_RUNNING_ID, SBOOT_RUNNING_ID);
	LOG_INF("Sboot is running");

	uint64_t chiplet_id = check_condition();

	BOOT_LOG(ROT, SBOOT_S, INIT_LOG);
	INIT_BOOT_LOG(chiplet_id);
	UPDATE_RESET_LOG;

	hw_init(chiplet_id);

	extern int z_clock_hw_cycles_per_sec;

#ifdef CONFIG_WDT_CMRT
	/* It's possible to change the clock frequency here in sboot
	 * The watchdog driver uses this value in wdt_install_timeout.
	 * As an example set it to the same value it already has.
	 */
	z_clock_hw_cycles_per_sec = CONFIG_SYS_CLOCK_HW_CYCLES_PER_SEC;
	/* Possibly define new watchdog timeout and feed it. */
	const struct device *wdt = device_get_binding(DT_LABEL(DT_ALIAS(watchdog0)));

	if (wdt) {
#if CONFIG_CMRT_SBOOT_WATCHDOG_TIMEOUT_MS > 0
		struct wdt_timeout_cfg cfg = { .window = { .max = CONFIG_CMRT_SBOOT_WATCHDOG_TIMEOUT_MS } };
		(void)wdt_install_timeout(wdt, &cfg);
		(void)wdt_setup(wdt, 0);
#endif
		(void)wdt_cmrt_feed(NULL, 0);
	}
#endif

	cmrt_sac_set_base(NULL, GET_SAC_BASE(SYSREG_ROT_PRIVATE + PAD_ROT));
	if (sys_read32(GET_SAC_R_CPU_DATA(PAD_ROT)) == EMERGENCY_DOWNLOAD) {
		BOOT_LOG(ROT, SBOOT_S, RUN_EMERGENCY_DOWNLOAD);
		emergency_download();
	}

	if (chiplet_id != CHIPLET_PRIMARY) {
		start_image(IMG_TBOOT_S, copy_image, img_info,
					fboot_supervisor_clear,
					fboot_supervisor_start);

		disable_timer();
		while (1)
			__asm__("wfi");

		/* Never touch here */
		__asm__("j .");
	}

#if IS_ENABLED(CMRT_SIC_BOOT_CONTROL)
	/* A placeholder to change the boot flow. CMRT has issued fboot_reset
	 * with info written to the SIC boot control register. This makes it
	 * possible to change the logic to boot to a secondary image, etc.
	 */
	uint32_t boot_control = cmrt_read_reg(CMRT_SIC_BASE, R_BOOT_CONTROL);

	if (boot_control != 0) {
		LOG_INF("SIC boot control: 0x%08x", boot_control);
		/* Sboot could clear the register here to avoid possible
		 * boot loop. However, we keep the value for fboot_reset_info
		 * system call to return the value to the supervisor, too.
		 */
	}
#endif
#ifdef CONFIG_CMRT_DATASTORE
	/* Sample code for using a datastore key in image decryption.
	 * Fboot will use this key if datastore key source is set in footer.
	 * MAKE SURE NOT TO USE THIS KEY IN PRODUCTION!
	 */
	LOG_INF("Writing static decryption key to datastore");
	static const uint8_t ds_key[KDC_KEY_SIZE] = {
		0x00, 0x01, 0x02, 0x03, 0x04, 0x05, 0x06, 0x07,
		0x08, 0x09, 0x0a, 0x0b, 0x0c, 0x0d, 0x0e, 0x0f,
		0x10, 0x11, 0x12, 0x13, 0x14, 0x15, 0x16, 0x17,
		0x18, 0x19, 0x1a, 0x1b, 0x1c, 0x1d, 0x1e, 0x1f };
	(void)fboot_data_store_write("CMRT_IMAGE_KEY_SRC_DS", sizeof("CMRT_IMAGE_KEY_SRC_DS") - 1,
									ds_key, sizeof(ds_key), false);
	/* Supervisor has permission to use and update the key. */
	(void)fboot_data_store_grant("CMRT_IMAGE_KEY_SRC_DS", sizeof("CMRT_IMAGE_KEY_SRC_DS") - 1,
									DS_ALL_ROOTS | DS_S_WRITE | DS_S_EXECUTE, -1, false);
#endif
	if (start_image(IMG_TBOOT_P0, copy_image, img_info, NULL, NULL) != 0) {
		handling_img_error(write_flash_256b);
	}

	cm7_release_reset();

	if (get_is_pcie_phy_sram_load() == IS_PHY_SRAM_LOAD) {
		cm7_wait_reset_done();

		cm7_pcie_phy_para_sel(true);
		if (start_image(IMG_TBOOT_P1, copy_image, img_info, NULL, NULL) != 0) {
			handling_img_error(write_flash_256b);
		}
		cm7_pcie_phy_para_sel(false);

		cm7_notify_phy_load_done();
	}

	/* Try the primary image location. */
	if (start_image(IMG_TBOOT_S, copy_image, img_info,
					fboot_supervisor_clear,
					fboot_supervisor_start) != 0) {
		handling_img_error(write_flash_256b);
	}

	/* Never touch here */
	disable_timer();
	__asm__("j .");

	return 0;
}
```

## src/caliptra.c
```c
/*
 * Copyright (c) 2023 Cryptography Research, Inc. (CRI).
 * A license or authorization from CRI is needed to use this file
 */
#include <stddef.h>
#include <stdint.h>
#include <stdbool.h>
#include <sys/printk.h>
#include <logging/log.h>

#include <drivers/cmrt/cmrt.h>
#include <drivers/cmrt/tmc.h>
#include <drivers/cmrt/hc.h>
#include <drivers/cmrt/fmc.h>
#include <drivers/cmrt/sic_reg.h>
#include <cmrt/fboot/img_version.h>
#include <cmrt/fboot/img_format.h>

#include <cmrt/caliptra/flow.h>
#include <cmrt/caliptra/x509.h>
#include <cmrt/caliptra/assets.h>
#include <cmrt/caliptra/handover.h>

#include "caliptra.h"

/* fboot datastore direct call api */
#include "syscalls.h"

LOG_MODULE_DECLARE(cmrt, CONFIG_CMRT_LOG_LEVEL);

/*
 * Generate LDevID assets. Performs the following high-level steps:
 *
 * 1. Retrieve OTP assets (UDS seed, field entropy).
 * 2. Derive the IDevID keypair.
 * 3. Compute CDI_LDevID.
 * 4. Derive the LDevID keypair.
 * 5. Issue the LDevID certificate.
 * 6. Generate an LDevID certificate signing request.
 */
int ldevid_flow(cmrt_caliptra_rom_context_t *context)
{
	int res = 0;

	/* IDevID {priv, pub} := eccKPDF(udsHash, "IDevID key pair") */
	cmrt_caliptra_privkey_t idevid_priv;
	cmrt_caliptra_pubkey_t idevid_pub;
	if (res == 0) {
		res = cmrt_caliptra_ecckpdf(&context->uds_hash, sizeof(context->uds_hash),
					    CMRT_KP_INFO_IDevID, strlen(CMRT_KP_INFO_IDevID),
					    &idevid_priv, &idevid_pub);
	}

	/* CDI_LDevID :=  HMAC(udsHash, fieldEntropy) */
	if (res == 0) {
		res = cmrt_caliptra_hmac(&context->uds_hash, sizeof(context->uds_hash),
					 &context->field_entropy, sizeof(context->field_entropy),
					 &context->cdi_ldevid);
	}

	/* Clear udsHash and fieldEntropy from memory. */
	cmrt_caliptra_zeroize(&context->uds_hash, sizeof(context->uds_hash));
	cmrt_caliptra_zeroize(&context->field_entropy, sizeof(context->field_entropy));

	/* LDevID {priv, pub} := eccKPDF(CDI_LDevID, "LDevID Key Pair") */
	if (res == 0) {
		res = cmrt_caliptra_ecckpdf(&context->cdi_ldevid, sizeof(context->cdi_ldevid),
					    CMRT_KP_INFO_LDevID, strlen(CMRT_KP_INFO_LDevID),
					    &context->ldevid_priv, &context->ldevid_pub);
	}

	/* Obtain the fboot and sboot versions referenced in the
	 * LDevID certificate.
	 */
	alignas(4) uint8_t fboot_ver[48];
	size_t fboot_ver_len = sizeof(fboot_ver);
	alignas(4) uint8_t sboot_ver[48];
	size_t sboot_ver_len = sizeof(sboot_ver);
	if (res == 0) {
		res = fboot_get_image_version(CMRT_FBOOT_IMAGE_VERSION, fboot_ver, &fboot_ver_len);
		if (res == 0) {
			fboot_ver_len = strlen(fboot_ver);
		}
	}
	if (res == 0) {
		res = fboot_get_image_version(CMRT_SBOOT_IMAGE_VERSION, sboot_ver, &sboot_ver_len);
		if (res == 0) {
			sboot_ver_len = strlen(sboot_ver);
		}
	}

	/* Finalize TMC initialization before we start signing
	 * anything. This is done even if a previous step has failed,
	 * to allow non-caliptra boot flows.
	 */
	int tmc_res = cmrt_tmc_sync(context->tmc);
	/* We don't want to overwrite any current failures in res. */
	if (res == 0) {
		res = tmc_res;
	}
	cmrt_tmc_close(context->tmc);
	context->tmc = CMRT_INVALID_HANDLE;

	/* Generate the LDevID certificate, issued by IDevID. */
	cmrt_caliptra_tcb_t idevid = {
		.identity = CMRT_CALIPTRA_ID_IDevID,
		.privkey = &idevid_priv,
		.pubkey = &idevid_pub,
	};
	cmrt_caliptra_tcb_t ldevid = {
		.identity = CMRT_CALIPTRA_ID_LDevID,
		.privkey = &context->ldevid_priv,
		.pubkey = &context->ldevid_pub,
	};
	cmrt_caliptra_tcbinfo_t tcbis[] = {
		{
			.version = fboot_ver,
			.version_len = fboot_ver_len,
			.layer = 0,
		},
		{
			.version = sboot_ver,
			.version_len = sboot_ver_len,
			.layer = 0,
		},
	};
	cmrt_caliptra_cert_params_t ldevid_cert_params = {
		.issuer = &idevid,
		.subject = &ldevid,
		.deviceinfo = &context->devinfo,
		.tcbinfos = tcbis,
		.tcbinfos_len = ARRAY_SIZE(tcbis),
	};
	alignas(4) uint8_t der[CMRT_CALIPTRA_MAX_DER_LEN];
	size_t der_len = sizeof(der);
	if (res == 0) {
		res = cmrt_caliptra_write_cert(der, &der_len, &ldevid_cert_params);
	}

	/* Clear IDevID credentials from memory. */
	cmrt_caliptra_zeroize(&idevid_priv, sizeof(idevid_priv));
	cmrt_caliptra_zeroize(&idevid_pub, sizeof(idevid_pub));

	/* - LDevID certificate (FMC=none RT=R) */
	if (res == 0) {
		res = cmrt_caliptra_rta_store(CMRT_CALIPTRA_RTA_LDevID_CERT, der, der_len);
	}

	/* Construct the owner LDevID CSR. */
	cmrt_caliptra_csr_params_t owner_ldevid_csr_params = {
		.subject = &ldevid,
		.deviceinfo = &context->devinfo,
		.tcbinfos = tcbis,
		.tcbinfos_len = ARRAY_SIZE(tcbis),
	};
	if (res == 0) {
		res = cmrt_caliptra_write_csr(der, &der_len, &owner_ldevid_csr_params);
	}
	/* - Owner LDevID CSR (FMC=none RT=R) */
	if (res == 0) {
		res = cmrt_caliptra_rta_store(CMRT_CALIPTRA_RTA_OWNER_LDevID_CSR, der, der_len);
	}
	return res;
}

static int get_debug_mode(uint32_t *dbg)
{
	int res = -EINVAL;
	if (dbg != NULL) {
		cmrt_fmc_t fmc = cmrt_fmc_open();
		if (cmrt_is_valid(fmc)) {
			uint32_t tdv = 0;
			res = cmrt_fmc_read(fmc, FMC_TDV_OFFSET, &tdv);
			if (res == 0) {
				*dbg = tdv & FMC_TEST_MODE_BIT;
			}
			cmrt_fmc_close(fmc);
		}
	}
	return res;
}

static int hash_otpfield(cmrt_omc_t omc, cmrt_hc_t hc, uint32_t offset, size_t len)
{
	/* The longest field we read is a root. */
	alignas(4) uint8_t tmp[OTP_ROOT_SIZE];
	int res = cmrt_omc_read(omc, offset, tmp, len);
	if (res == 0) {
		res = cmrt_hc_update(hc, tmp, len);
	}
	return res;
}

/* Feed the security state into the hash context. */
static int hash_otp_security_state(cmrt_hc_t hc)
{
	int res = 0;
	cmrt_omc_t omc = cmrt_omc_open(CMRT_O_SYNC);
	if (cmrt_is_valid(omc)) {
		if (res == 0) {
			res = hash_otpfield(omc, hc, OTP_STATUS_WORD_OFFSET, OTP_STATUS_WORD_SIZE);
		}
		if (res == 0) {
			res = hash_otpfield(omc, hc, OTP_KEY_OBLITERATE_OFFSET, OTP_KEY_OBLITERATE_SIZE);
		}
		if (res == 0) {
			res = hash_otpfield(omc, hc, OTP_DEVICE_ID_OFFSET, OTP_DEVICE_ID_SIZE);
		}
		if (res == 0) {
			res = hash_otpfield(omc, hc, OTP_OEM_ID_OFFSET, OTP_OEM_ID_SIZE);
		}
		if (res == 0) {
			res = hash_otpfield(omc, hc, OTP_ROOT_OFFSET(0), OTP_ROOT_SIZE);
		}
		if (res == 0) {
			res = hash_otpfield(omc, hc, OTP_ROOT_OFFSET(1), OTP_ROOT_SIZE);
		}
		cmrt_omc_close(omc);
	}
	return res;
}

static int measure_security_state(cmrt_hc_t hc)
{
	int res = 0;
	if (res == 0) {
		res = hash_otp_security_state(hc);
	}
	if (res == 0) {
		uint32_t sboot_hash[SIC_SBOOT_HASH_REGS];
		for (uint32_t i = 0; i < SIC_SBOOT_HASH_REGS; ++i) {
			sboot_hash[i] = cmrt_read_reg(CMRT_SIC_BASE, R_SBOOT_HASH_0 + i*4u);
		}
		res = cmrt_hc_update(hc, &sboot_hash, sizeof(sboot_hash));
	}
	if (res == 0) {
		uint32_t debugmode;
		res = get_debug_mode(&debugmode);
		if (res == 0) {
			res = cmrt_hc_update(hc, &debugmode, sizeof(debugmode));
		}
	}
	return res;
}

static int calculate_cdi_fmc(const cmrt_caliptra_digest_t *cdi_ldevid,
			     const cmrt_caliptra_digest_t *tci_fmc,
			     cmrt_caliptra_digest_t *cdi_fmc)
{
	int res = 0;

	/* CDI_fmc_msg := SHA(security_state || TCI_fmc) */
	cmrt_hc_t hc = cmrt_hc_open(NULL, CMRT_O_SYNC);
	if (cmrt_is_valid(hc)) {
		res = cmrt_hc_init(hc, CMRT_HASH_SHA384, NULL, 0);
		if (res == 0) {
			res = measure_security_state(hc);
		}

		cmrt_caliptra_digest_t cdi_fmc_msg;
		size_t cdi_fmc_msg_len = sizeof(cdi_fmc_msg);
		if (res == 0) {
			res = cmrt_hc_final(hc, tci_fmc, sizeof(*tci_fmc),
					    &cdi_fmc_msg, &cdi_fmc_msg_len);
		}
		cmrt_hc_close(hc);

		/* CDI_fmc := HMAC(CDI_ldevid, CDI_fmc_msg) */
		if (res == 0) {
			res = cmrt_caliptra_hmac(cdi_ldevid, sizeof(*cdi_ldevid),
						 &cdi_fmc_msg, sizeof(cdi_fmc_msg),
						 cdi_fmc);
		}
	}
	return res;
}

/*
 * Generate FMC assets.
 *
 * 1. Calculate CDI_fmc.
 * 2. Derive the AliasFMC keypair.
 * 3. Issue the AliasFMC certificate.
 */
int fmc_flow(cmrt_caliptra_rom_context_t *context, const void *fmc_address, size_t fmc_size)
{
	int res = 0;

	/* TCI_fmc := HASH(fmc) */
	cmrt_caliptra_digest_t tci_fmc;
	if (res == 0) {
		res = cmrt_caliptra_hash(fmc_address, fmc_size, &tci_fmc);
	}
	cmrt_caliptra_digest_t cdi_fmc;
	if (res == 0) {
		res = calculate_cdi_fmc(&context->cdi_ldevid, &tci_fmc, &cdi_fmc);
	}

	/* AliasFMC {priv, pub} := eccKPDF(CDI_fmc, "AliasFMC key pair") */
	cmrt_caliptra_privkey_t aliasfmc_priv;
	cmrt_caliptra_pubkey_t aliasfmc_pub;
	if (res == 0) {
		res = cmrt_caliptra_ecckpdf(&cdi_fmc, sizeof(cdi_fmc),
					    CMRT_KP_INFO_AliasFMC, strlen(CMRT_KP_INFO_AliasFMC),
					    &aliasfmc_priv, &aliasfmc_pub);
	}

	/* Generate the AliasFMC certificate, issued by LDevID. */

	alignas(4) uint8_t fmc_ver[48];
	size_t fmc_ver_len = sizeof(fmc_ver);
	if (res == 0) {
		res = fboot_get_image_version(CMRT_SUPERVISOR_IMAGE_VERSION, fmc_ver, &fmc_ver_len);
		if (res == 0) {
			fmc_ver_len = strlen(fmc_ver);
		}
	}

	cmrt_caliptra_tcb_t aliasfmc = {
		.identity = CMRT_CALIPTRA_ID_AliasFMC,
		.privkey = &aliasfmc_priv,
		.pubkey = &aliasfmc_pub,
	};
	cmrt_caliptra_tcb_t ldevid = {
		.identity = CMRT_CALIPTRA_ID_LDevID,
		.privkey = &context->ldevid_priv,
		.pubkey = &context->ldevid_pub,
	};
	const cmrt_caliptra_digest_t *fmc_fwids[] = {
		&tci_fmc,
	};
	cmrt_caliptra_tcbinfo_t fmc_tcbis[] = {
		{
			.version = fmc_ver,
			.version_len = fmc_ver_len,
			.layer = 1,
			.fwids = fmc_fwids,
			.fwids_len = ARRAY_SIZE(fmc_fwids),
		},
	};
	cmrt_caliptra_cert_params_t aliasfmc_cert_params = {
		.issuer = &ldevid,
		.subject = &aliasfmc,
		.deviceinfo = &context->devinfo,
		.tcbinfos = fmc_tcbis,
		.tcbinfos_len = ARRAY_SIZE(fmc_tcbis),
	};
	alignas(4) uint8_t der[CMRT_CALIPTRA_MAX_DER_LEN];
	size_t der_len = sizeof(der);
	if (res == 0) {
		res = cmrt_caliptra_write_cert(der, &der_len, &aliasfmc_cert_params);
	}

	/* Clear LDevID assets from memory. */
	cmrt_caliptra_zeroize(&context->cdi_ldevid, sizeof(context->cdi_ldevid));
	cmrt_caliptra_zeroize(&context->ldevid_priv, sizeof(context->ldevid_priv));
	cmrt_caliptra_zeroize(&context->ldevid_pub, sizeof(context->ldevid_pub));

	/* Make the following assets available to the FMC and/or the
	 * RT. The permissions for the given asset are given in
	 * parentheses. The write permission is needed for erasing the
	 * asset.
	 */

	/* - CDI_fmc (FMC=RW RT=none) */
	if (res == 0) {
		res = cmrt_caliptra_rta_store(CMRT_CALIPTRA_RTA_CDI_FMC, &cdi_fmc, sizeof(cdi_fmc));
	}

	/* - AliasFMC keypair (FMC=RW RT=none) */
	if (res == 0) {
		res = cmrt_caliptra_rta_store(CMRT_CALIPTRA_RTA_ALIASFMC_PRIV, &aliasfmc_priv, sizeof(aliasfmc_priv));
	}
	if (res == 0) {
		res = cmrt_caliptra_rta_store(CMRT_CALIPTRA_RTA_ALIASFMC_PUB, &aliasfmc_pub, sizeof(aliasfmc_pub));
	}

	/* - AliasFMC certificate (FMC=none RT=R) */
	if (res == 0) {
		res = cmrt_caliptra_rta_store(CMRT_CALIPTRA_RTA_ALIASFMC_CERT, der, der_len);
	}

	return res;
}

int cmrt_caliptra_rom_flow_init(cmrt_caliptra_rom_context_t *context)
{
	memset(context, 0, sizeof(*context));
	cmrt_caliptra_oam_t oam;
	int res = cmrt_caliptra_oam_open(oam);
	if (res == 0) {
		res = cmrt_caliptra_oam_init(oam, 0);
	}
	cmrt_caliptra_uds_t uds_seed;
	if (res == 0) {
		res = cmrt_caliptra_oam_read_uds_seed(oam, &uds_seed);
	}
	int slot;
	if (res == 0) {
		res = cmrt_caliptra_oam_read_field_entropy(oam, &context->field_entropy, &slot);
	}
	cmrt_caliptra_oam_close(oam);
	/* OAM (omc) must be closed before deobfuscating, otherwise
	 * KDC blocks.
	 */

	if (res == 0) {
		res = cmrt_caliptra_derive_uds_hash(&uds_seed, &context->uds_hash);
	}
	if (res == 0) {
		res = cmrt_caliptra_deobfuscate_field_entropy(&context->field_entropy, slot);
	}
	cmrt_caliptra_zeroize(&uds_seed, sizeof(uds_seed));
	return res;
}

int cmrt_caliptra_rom_flow(cmrt_caliptra_rom_context_t *context,
			   cmrt_tmc_t tmc,
			   const void *fmc_address, size_t fmc_size)
{
	context->tmc = tmc;
	int res = cmrt_caliptra_get_deviceinfo(&context->devinfo);
	if (res == 0) {
		res = ldevid_flow(context);
	}
	if (res == 0) {
		res = fmc_flow(context, fmc_address, fmc_size);
	}
	return res;
}

void cmrt_caliptra_rom_flow_finalize(cmrt_caliptra_rom_context_t *context)
{
	/* If the previous steps did not sync/close the TMC (indicated
	 * by setting 'tmc' to CMRT_INVALID_HANDLE), we must do it
	 * here.
	 */
	if (cmrt_is_valid(context->tmc)) {
		cmrt_tmc_sync(context->tmc);
		cmrt_tmc_close(context->tmc);
		context->tmc = CMRT_INVALID_HANDLE;
	}
	cmrt_caliptra_zeroize(context, sizeof(*context));
}

int cmrt_caliptra_plat_datastore_write(const char *name, size_t namelen,
				       const void *data, size_t datalen)
{
	return fboot_data_store_write(name, namelen, data, datalen, false);
}

int cmrt_caliptra_plat_datastore_grant(const char *name, size_t namelen, int root, uint32_t attr)
{
	return fboot_data_store_grant(name, namelen, attr, root, false);
}
```

## src/caliptra.h
```c
/*
 * Copyright (c) 2023 Cryptography Research, Inc. (CRI).
 * A license or authorization from CRI is needed to use this file.
 */
#ifndef CMRT_CALIPTRA_ROM_FLOW_H
#define CMRT_CALIPTRA_ROM_FLOW_H

#include <drivers/cmrt/tmc.h>
#include <cmrt/caliptra/types.h>

#ifdef __cplusplus
extern "C" {
#endif

/* Information required during the Caliptra ROM flow. */
typedef struct cmrt_caliptra_rom_context {
	cmrt_tmc_t tmc;
	cmrt_caliptra_digest_t uds_hash;
	cmrt_caliptra_field_entropy_t field_entropy;
	cmrt_caliptra_deviceinfo_t devinfo;
	cmrt_caliptra_privkey_t ldevid_priv;
	cmrt_caliptra_pubkey_t ldevid_pub;
	cmrt_caliptra_digest_t cdi_ldevid;
} cmrt_caliptra_rom_context_t;

/**
 * Perform the initial step in the Caliptra ROM boot flow.
 *
 * Derive the IDevID identity and deobfuscate the current field
 * entropy.
 *
 * This must happen before any supervisor is loaded and the active
 * root is switched, because doing so will change the KDC derivation
 * path used in deobfuscation.
 *
 * @param context the Caliptra ROM context
 * @return 0 on success, -ERRNO on error.
 */
int cmrt_caliptra_rom_flow_init(cmrt_caliptra_rom_context_t *context);

/**
 * Perform the main Caliptra ROM boot flow.
 *
 * Derive the LDevID and AliasFMC identities, and save assets required
 * by the First Mutable Code (FMC) into the data store. This has to be
 * called after the FMC has been loaded to RAM and verified.
 *
 * The boot flow needs a TMC handle for signing; this is supplied from
 * outside so that sboot can start initialization early and perform
 * loading of FMC in parallel.
 *
 * @param tmc a TMC handle opened with CMRT_O_ASYNC. The handle is
 * consumed the Caliptra ROM boot flow (the caller shall not clean it up).
 * @param fmc_address address of the FMC in memory
 * @param fmc_size size of the FMC
 * @return 0 on success, -ERRNO on error.
 */
int cmrt_caliptra_rom_flow(cmrt_caliptra_rom_context_t *context,
			   cmrt_tmc_t tmc, const void *fmc_address, size_t fmc_size);

/**
 * Finalize the Caliptra ROM flow.
 *
 * This must be called in all cases, irrespective of the outcome of
 * previous functions.
 *
 * @param context the Caliptra ROM context
 */
void cmrt_caliptra_rom_flow_finalize(cmrt_caliptra_rom_context_t *context);

#ifdef __cplusplus
}
#endif
#endif
```

## src/emergency.c
```c
#include <fboot.h>
#include <syscalls.h>
#ifdef CONFIG_WDT_CMRT
#include <drivers/watchdog.h>
#endif
#include "rebel_h.h"
#include "uart.h"
#include "emergency.h"
#include "timer.h"

#define _SOH					(0x01)
#define _STX					(0x02)
#define _EOT					(0x04)
#define _ACK					(0x06)
#define _NAK					(0x15)
#define _CAN					(0x18)
#define IMG_REQUEST				('C')

#define PREAMBLE_SIZE			(1)
#define PKT_NUM_SIZE			(1)
#define CRC_SIZE				(2)

#define START_INDEX_OF_DATA		(PREAMBLE_SIZE + PKT_NUM_SIZE + PKT_NUM_SIZE)

#define E_PKT_NUM				(1) /* Not exptected packet number */
#define E_PKT_NUM_MIRROR		(2) /* Wrong mirror value of packet number */
#define E_LENGTH_UNSUPPORTED	(3) /* Unsupported length */
#define E_CRC					(4) /* CRC fail */

#define SOH_PKT_DATA_SIZE		(128)
#define STX_PKT_DATA_SIZE		(1024)

#define BYTE_MASK				(0xFF)

#define TIMEOUT_MS				(1000)

#define XMODEM_CRC16_INIT_VAL	(0x0000)
#define XMODEM_CRC16_POLY		(0x1021)
#define XMODEM_CRC16_BITMASK	(0x8000)
#define XMODEM_CRC16_WIDTH		(8)

extern int wdt_cmrt_feed(const struct device *dev, int channel_id);

typedef struct __attribute__((__packed__)) xmodem {
	uint8_t preamble;
	uint8_t pkt_num;
	uint8_t pkt_num_reverse;
	/* in case of 128 byte of data(SOH), CRC will be in data[129:128],
	 * in case of 1024 byte of data(STX), CRC will be in data[1025:1024].
	 */
	uint8_t data[STX_PKT_DATA_SIZE + CRC_SIZE];
} xmodem_packet;

uint16_t get_xmodem_crc16(const uint8_t *data, size_t len)
{
	uint16_t crc = XMODEM_CRC16_INIT_VAL;
	const uint16_t poly = XMODEM_CRC16_POLY;

	for (size_t i = 0; i < len; ++i) {
		crc ^= (uint16_t)data[i] << XMODEM_CRC16_WIDTH;
		for (int b = 0; b < XMODEM_CRC16_WIDTH; ++b) {
			if (crc & XMODEM_CRC16_BITMASK)
				crc = (crc << 1) ^ poly;
			else
				crc = (crc << 1);
		}
	}
	return crc;
}

uint32_t verify_packet(xmodem_packet *packet, uint32_t length,
					   uint32_t expected_pkt_num)
{
	if (packet->pkt_num != expected_pkt_num)
		return -E_PKT_NUM;

	if (((uint8_t)~(packet->pkt_num)) != packet->pkt_num_reverse)
		return -E_PKT_NUM_MIRROR;

	/* supported data length is either 128 or 1024 */
	if (!(length == STX_PKT_DATA_SIZE || length == SOH_PKT_DATA_SIZE))
		return -E_LENGTH_UNSUPPORTED;

	uint16_t pkt_crc = ((uint16_t)packet->data[length]) << 8 | packet->data[length + 1];

	if (get_xmodem_crc16(packet->data, length) == pkt_crc)
		return true;
	else
		return -E_CRC;
}

/* note this function should be called after cmu init().
 * exptect UART_PERI 500MHz,
 * and CLK_ROT_ACLK 750MHz
 */
void emergency_download(void)
{
	uart_init();

	/* set default data length as 128B in a packet */
	uint32_t data_length = SOH_PKT_DATA_SIZE;
	uint8_t packet_count;
	uint32_t is_first_pkt;
	uint32_t packet_length;
	uint32_t received_size;

	uint8_t *rx_buf = (uint8_t *)fboot_supervisor_clear();
	uint8_t *rx_buf_backup = rx_buf;

	while (true) {
		xmodem_packet pkt;
		uint32_t img_length = 0;
		int32_t res;
		uint64_t start_uptime_ms;
		uint64_t end_uptime_ms;
img_request:
		is_first_pkt = 1;
		packet_count = 1;
		img_length = 0;
		rx_buf = rx_buf_backup;

		flush_rx_fifo();
		push_tx_fifo(IMG_REQUEST);

receive_packet:
		start_uptime_ms = get_uptime_ms();

		while (1) {
			(void)wdt_cmrt_feed(NULL, 0);

			if (poll_rx_fifo(&pkt.preamble) == RX_FIFO_HAS_DATA) {
				break;
			}
			end_uptime_ms = get_uptime_ms();

			/* timeout 1s, request to start over */
			if (end_uptime_ms - start_uptime_ms > TIMEOUT_MS) {
				goto img_request;
			}
		}

		received_size = 0;

		/* if reached here, UART received a character */
		if (pkt.preamble == _SOH) {
			data_length = SOH_PKT_DATA_SIZE;
		} else if (pkt.preamble == _STX) {
			data_length = STX_PKT_DATA_SIZE;
		} else if (pkt.preamble == _CAN) {
			/* Cancel, make receiver start to request again  */
			goto img_request;
		} else if (pkt.preamble == _EOT) {
			if (pkt.preamble == _EOT) {
				cmrt_raw_footer_t raw;

				res = fboot_load_image((uint32_t *)(uintptr_t)rx_buf_backup,
									   (size_t)img_length, &raw, NULL);
				flush_rx_fifo();
				push_tx_fifo(_ACK);
				if (res < 0) {
					/* verification fail */
					goto img_request;
				}
				fboot_supervisor_start();
			}
		} else {
			flush_rx_fifo();
			push_tx_fifo(_NAK);
			goto receive_packet;
		}

		/* Packet size : preamble(1B) + No.(1B) + Rev.No.(1B), Data(128 or 1024B), CRC(2B) */
		/* below packet_length is the size without preamble */
		packet_length = PKT_NUM_SIZE + PKT_NUM_SIZE + data_length + CRC_SIZE;
		received_size = read_data_in_fifo(&pkt.pkt_num, packet_length);
		if (packet_length == received_size) {
			packet_length += PREAMBLE_SIZE;

			if (verify_packet(&pkt, data_length, packet_count) == true) {
				packet_count++;

				if (is_first_pkt == 1) {
					uint32_t img_hdr_size = sizeof(cmrt_img_header_t);

					for (int i = 0; i < data_length - img_hdr_size; i++)
						*(rx_buf++) = pkt.data[img_hdr_size + i];

					img_length = (uint32_t)pkt.data[0];
					img_length |= (uint32_t)pkt.data[1] << 8;
					img_length |= (uint32_t)pkt.data[2] << 16;
					img_length |= (uint32_t)pkt.data[3] << 24;

					uint32_t mirror;

					mirror = (uint32_t)pkt.data[4];
					mirror |= (uint32_t)pkt.data[5] << 8;
					mirror |= (uint32_t)pkt.data[6] << 16;
					mirror |= (uint32_t)pkt.data[7] << 24;

					cmrt_img_header_t hdr;

					hdr.length = img_length;
					hdr.mirror = mirror;

					if (cmrt_is_valid_hdr(&hdr, MAX_SIZE) == false) {
						flush_rx_fifo();
						push_tx_fifo(_NAK);
						goto receive_packet;
					}

					is_first_pkt = 0;
				} else {
					for (int i = 0; i < data_length; i++) {
						*(rx_buf++) = pkt.data[i];
					}
				}

				flush_rx_fifo();
				push_tx_fifo(_ACK);
			} else {
				flush_rx_fifo();
				push_tx_fifo(_NAK);
			}
		} else {
			/* clear buffer */
			flush_rx_fifo();
			push_tx_fifo(_NAK);
		}

		goto receive_packet;
	}
	/* never reach here */
	__asm__ ("wfi");
}
```

## src/emergency.h
```c
#pragma once

void emergency_download(void);
```
