/*
 * Copyright (c) 2024 Samsung Electronics Co., Ltd.
 *
 * SPDX-License-Identifier: Apache-2.0
 *
 */

/dts-v1/;

#include <rebel/rebel_h.dtsi>
/ {
	model = "rebel_h SOC";
	compatible = "rebellions,rebel_h";

	chosen {
		zephyr,sram = &dram0;
		zephyr,console = &uart1;
	};
};

&uart1 {
	status = "okay";
	current-speed = <115200>;
};
