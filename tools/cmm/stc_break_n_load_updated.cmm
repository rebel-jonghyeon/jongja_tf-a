ON ERROR GOTO ENDERR

Data.LOAD.Elf /home/rebellions/Silicon_BringUp_data/heeyoung/debugging_our_repo/rebel_cds_collab_hw/binaries/BootLoader_CP/bl31.elf /NoCODE
Data.LOAD.Elf /home/rebellions/Silicon_BringUp_data/heeyoung/debugging_our_repo/rebel_cds_collab_hw/binaries/FreeRTOS_CP/freertos_kernel.elf /NoCODE /NoClear

CD ~~~~/
// Test directory
LOCAL &test_dir &testlist_dir
&test_dir="/share/cds_drop_250724/rbln_test_vectors_250723/patterns"
&testlist_dir="/share/cds_drop_250724/testlists/testlist_short.txt"

stc_break_n_load_entry:
    PRIVATE &arg0
    ENTRY &arg0

    IF ("&arg0"=="")
    (
        PRINT "CALLED WITHOUT ARGUMENT, SETTING BREAKPOINT"
        GOSUB set_breakpoint
    )
    ELSE
    (
        PRINT "CALLED WITH ARGUMENT, EXECUTING STC DATA LOAD LOGIC"
        GOSUB load_stc_data
    )
    GO
    ENDDO

set_breakpoint:
    Break.Set     load_stc_data /Program /Onchip /CMD "DO stc_break_n_load_updated.cmm 0"

    // preload names into stc_list var
    PRIVATE &idx  &test_name
    OPEN #1 &testlist_dir /READ

    &idx = 0
    REPEAT
    (
        READ #1 %LINE &test_name
        ;V %s stc_list[&idx] = "&test_name"
        ;d.s stc_list+&idx*64. %s  "&test_name"
        d.s stc_list+&idx*64. "&test_name"
        ;var.set stc_list[&idx][63.]=0x0
	    d.s stc_list+&idx*64.+63. 0x0
        &idx=&idx+1
    )
    WHILE !FILE.EOFLASTREAD()
    V %s stc_list[&idx-1] = "EOF"
    CLOSE #1

    RETURN
load_stc_data:
    PRIVATE &idx &test_name &stc_addr

    ;&idx = Var.Value(stc_tc_idx)
    &idx = data.long(current_stc_idx)
    &idx = &idx*64.
    ;&test_name= Data.string(Var.ADDRESS(stc_list[&idx]))
    &stc_addr = stc_list+&idx
    &test_name= Data.String(&stc_addr)

    LOCAL &mem_data &cmd_data
    &cmd_data="&test_dir/&test_name-command_datadb.dat"
    &mem_data="&test_dir/&test_name-memory_datadb.dat"
    PRINT "&cmd_data"
    PRINT "&mem_data"

    data.load.binary &cmd_data zaxi:0x54200000 /NoClear// /Verify
    data.load.binary &mem_data zaxi:0x60000000 /NoClear// /Verify
    RETURN

ENDERR:
    ENDDO
