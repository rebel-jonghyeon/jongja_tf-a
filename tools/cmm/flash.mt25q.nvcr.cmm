;
; .cmm script to write/read NVCR and support RESET_ENABLE/MEMORY, WRITE_ENABLE
;

B::
RESet
SYStem.RESet

; Chiplet-id of target
; Xj0* JTAG: per-chiplet standalone
; Xj1* JTAG PAD route: TDI -> chiplet-0 -> chiplet-2 -> chiplet-3 -> chiplet-1 -> TDO

LOCAL &STANDALONE	; 0: per-chiplet Xj0*, 1: daisy-chain Xj1* path
LOCAL &CHIPLET_ID

&ZEBU=0.
&STANDALONE=1.
&CHIPLET_ID=0.

PRINT			VERSION.SOFTWARE()

; Set DAP's IR/DR POST/PRE value for the target chiplet
; Chiplet-0 only supported
IF &STANDALONE==1.
(
  SYS.CONFIG DAPIRPRE		0.
  SYS.CONFIG DAPIRPOST		0.
  SYS.CONFIG DAPDRPRE		0.
  SYS.CONFIG DAPDRPOST		0.
)
ELSE IF &CHIPLET_ID==0.
(
  SYS.CONFIG DAPIRPRE		12.
  SYS.CONFIG DAPIRPOST		0.
  SYS.CONFIG DAPDRPRE		3.
  SYS.CONFIG DAPDRPOST		0.
)
ELSE
(
  PRINT "Not supported CHIPLET_ID"
  ENDDO
)

; Basic setting
SYSTEM.JTAGCLOCK		20MHz
SYSTEM.CPU				CORTEXA73

SYSTEM.OPTION	RESBREAK	OFF
SYSTEM.OPTION	ENRESET		OFF
SYSTEM.OPTION	TRST		OFF
SYSTEM.OPTION.MEMSTATUSCHECK ON

; AXI-AP
SYSTEM.CONFIG.AXIAP1.Base		DP:0x00002000

SYStem.mode Prepare

; Flash command
GLOBAL &CMD_WRITE_ENABLE
GLOBAL &CMD_RESET_ENABLE
GLOBAL &CMD_RESET_MEMORY
GLOBAL &CMD_READ_NVCR
GLOBAL &CMD_WRITE_NVCR

&CMD_WRITE_ENABLE=0x06
&CMD_RESET_ENABLE=0x66
&CMD_RESET_MEMORY=0x99
&CMD_READ_NVCR=0xB5
&CMD_WRITE_NVCR=0xB1

;
; Start of QSPI controller
;
GLOBAL &spi_base_addr
&spi_base_addr=0x1e00500000

GOSUB qspi_init

;
; Function
;
; GOSUB RESET_ENABLE
; GOSUB RESET_MEMORY
; GOSUB WRITE_ENABLE
; GOSUB_READ_NVCR
; GOSUB_WRITE_NVCR ${16-bit data}

LOCAL &NVCR
LOCAL &NUM_DUMYY_CYCLE  ; [15:12]
LOCAL &XIP_MODE			; [11:9]
LOCAL &OUT_DRV_STRENGTH ; [8:6]
LOCAL &CMD_DTR			; [5]
LOCAL &RH				; [4]
LOCAL &CMD_QAUD			; [3]
LOCAL &CMD_DUAL			; [2]
LOCAL &SEG_SEL			; [1]
LOCAL &ADDRESSING		; [0]

;
; Set NVCR bit fields here
;
&NUM_DUMYY_CYCLE=0xF
&XIP_MODE=0x7
&OUT_DRV_STRENGTH=0x7
&CMD_DTR=0x1
&RH=0x1
&CMD_QUAD=0x1
&CMD_DUAL=0x1
&SEG_SEL=0x1
&ADDRESSING=0x1
;
; Re-ordering
; *) NOTE: MSB [15:8] will be passed first from controller,
; Device will get it as LSB
;
&NVCR=(&NUM_DUMYY_CYCLE<<12.)|(&XIP_MODE<<9.)|(&OUT_DRV_STRENGTH<<6.)|(&CMD_DTR<<5.)|(&RH<<4.)|(&CMD_QUAD<<3.)|(&CMD_DUAL<<2.)|(&SEG_SEL<<1.)|(&ADDRESSING<<0.);

LOCAL &NVCR_REORDERED
&NVCR_REORDERED=((&NVCR&0xFF00)>>8.)|((&NVCR&0x00FF)<<8.)

;
; Example
; 0. READ_ENABLE/MEMORY
; 1. Check the NVCR value first
; 2. Write some NVCR value
; 3. Read back NVCR again
;
GOSUB RESET_ENABLE
GOSUB RESET_MEMORY

LOCAL &a
GOSUB READ_NVCR
ENTRY &a
PRINT "READ_NVCR: &a"

; Enable WE latch
GOSUB WRITE_ENABLE

; Pass 2-byte re-ordered data
GOSUB WRITE_NVCR &NVCR_REORDERED

GOSUB READ_NVCR
ENTRY &a

PRINT "READ_NVCR: &a"

ENDDO
;
; End of Example
;

; Label
RESET_ENABLE:
  GOSUB SETUP_1_0_0_CMD
  GOSUB qspi_ssi_tx_i &CMD_RESET_ENABLE
  RETURN

RESET_MEMORY:
  GOSUB SETUP_1_0_0_CMD
  GOSUB qspi_ssi_tx_i &CMD_RESET_MEMORY
  RETURN

WRITE_ENABLE:
  GOSUB SETUP_1_0_0_CMD
  GOSUB qspi_ssi_tx_i &CMD_WRITE_ENABLE
  RETURN

WRITE_NVCR:
  LOCAL &val
  ENTRY &val

  LOCAL &dw_spi_ctrlr0_addr_l_0
  LOCAL &dw_spi_ctrlr0_inst_l_8
  LOCAL &dw_spi_ctrlr0_wait_cycle_0
  LOCAL &dw_spi_ctrlr0_trans_type_tt0
  LOCAL &dw_spi_ctrlr0_ddr_disable
  LOCAL &dw_ctrlr0_dfs_8
  LOCAL &dw_ctrlr0_tmod_tx
  LOCAL &dw_ctrlr0_spi_frf_standard
  LOCAL &dw_ctrlr1_ndf_1word
  LOCAL &txftlr

  &txftlr=0x18
  &dw_spi_ctrlr0_addr_l_0=0x0
  &dw_spi_ctrlr0_inst_l_8=(0x2<<8.)
  &dw_spi_ctrlr0_wait_cycle_0=0x0
  &dw_spi_ctrlr0_trans_type_tt0=0x0
  &dw_spi_ctrlr0_ddr_disable=0
  &dw_ctrlr0_dfs_8=0xf
  &dw_ctrlr0_tmod_tx=(0x1<<10.) ;tx
  &dw_ctrlr0_spi_frf_standard=0x0
  &dw_ctrlr1_ndf_1word=0x0

  GOSUB qspi_config_ssi_controller &dw_spi_ctrlr0_addr_l_0 &dw_spi_ctrlr0_inst_l_8 &dw_spi_ctrlr0_wait_cycle_0 &dw_spi_ctrlr0_trans_type_tt0 &dw_spi_ctrlr0_ddr_disable &dw_ctrlr0_dfs_8 &dw_ctrlr0_tmod_tx &dw_ctrlr0_spi_frf_standard &dw_ctrlr1_ndf_1word

  GOSUB axi_write (&spi_base_addr+&txftlr) 0x10000

  GOSUB tx_available

  GOSUB axi_write (&spi_base_addr+0x60) &CMD_WRITE_NVCR ; Command
  GOSUB axi_write (&spi_base_addr+0x60) &val			; 16-bit Data

  GOSUB qspi_check_busy

  RETURN

READ_NVCR:
  LOCAL &dw_spi_ctrlr0_addr_l_0
  LOCAL &dw_spi_ctrlr0_inst_l_8
  LOCAL &dw_spi_ctrlr0_wait_cycle_0
  LOCAL &dw_spi_ctrlr0_trans_type_tt0
  LOCAL &dw_spi_ctrlr0_ddr_disable
  LOCAL &dw_ctrlr0_dfs_8
  LOCAL &dw_ctrlr0_tmod_rx
  LOCAL &dw_ctrlr0_spi_frf_standard
  LOCAL &dw_ctrlr1_ndf_1word

  &dw_spi_ctrlr0_addr_l_0=0x0
  &dw_spi_ctrlr0_inst_l_8=(0x2<<8.)
  &dw_spi_ctrlr0_wait_cycle_0=0x0
  &dw_spi_ctrlr0_trans_type_tt0=0x0
  &dw_spi_ctrlr0_ddr_disable=0
  &dw_ctrlr0_dfs_8=0xf ; 16bit
  &dw_ctrlr0_tmod_rx=(0x2<<10.)
  &dw_ctrlr0_spi_frf_standard=0x0
  &dw_ctrlr1_ndf_1word=0x0
  GOSUB axi_write (&spi_base_addr+0x18) 0x0

  GOSUB qspi_config_ssi_controller &dw_spi_ctrlr0_addr_l_0 &dw_spi_ctrlr0_inst_l_8 &dw_spi_ctrlr0_wait_cycle_0 &dw_spi_ctrlr0_trans_type_tt0 &dw_spi_ctrlr0_ddr_disable &dw_ctrlr0_dfs_8 &dw_ctrlr0_tmod_rx &dw_ctrlr0_spi_frf_standard &dw_ctrlr1_ndf_1word

  GOSUB qspi_ssi_rx_i &CMD_READ_NVCR
  ENTRY &read_status_value

  ; Re-order to align NVCR[15:0], based on given 16-bit
  LOCAL &data
  &data=((&read_status_value&0xFF00)>>8.)|((&read_status_value&0x00FF)<<8.)

  RETURN &data


;
; IP-level functions
;
qspi_init:
  GOSUB qspi_int_disable
  GOSUB qspi_ssi_enable

  RETURN

qspi_int_disable:
  GOSUB qspi_ssi_disable
  LOCAL &imr
  &imr=0x2c ; interrupt mask reg
  GOSUB axi_write (&spi_base_addr+&imr) 0x0

  RETURN

tx_available:
  LOCAL &sr
  &sr=0x28	; status register

  GOSUB qspi_check_busy

  LOCAL &dw_sr_tfnf_bit
  &dw_sr_tfnf_bit=0x2 ; (0x1 <<1)

  GOSUB axi_read (&spi_base_addr+&sr)
  ENTRY &sr_value

  while ((&sr_value)&(&dw_sr_tfnf_bit))==0
  (
	GOSUB axi_read (&spi_base_addr+&sr)
	ENTRY &sr_value
  )
  RETURN

rx_available:
  LOCAL &sr
  &sr=0x28	; status register

  LOCAL &dw_sr_rfne_bit
  &dw_sr_rfne_bit=0x8 ; (0x1 <<3)

  GOSUB axi_read (&spi_base_addr+&sr)
  ENTRY &sr_value

  while ((&sr_value)&(&dw_sr_rfne_bit))==0
  (
	GOSUB axi_read (&spi_base_addr+&sr)
	ENTRY &sr_value
  )
  GOSUB qspi_check_busy

  RETURN

qspi_check_busy:
  LOCAL &dw_sr_busy_bit;
  &dw_sr_busy_bit=0x1
  LOCAL &sr; ; status register 0x28
  &sr=0x28

  GOSUB axi_read (&spi_base_addr+&sr)
  ENTRY &sr_value

  while (((&sr_value)&(&dw_sr_busy_bit))==&dw_sr_busy_bit)
  (
	GOSUB axi_read (&spi_base_addr+&sr)
	ENTRY &sr_value
  )

  RETURN

qspi_ssi_disable:
  LOCAL &ssienr; ssi enable register
  &ssienr=0x8
  LOCAL &ssienr_enable
  &ssienr_enable=0x1
  GOSUB axi_read (&spi_base_addr+&ssienr)
  ENTRY &ssienr_value

  &ssienr_value=(&ssienr_value)&(~&ssienr_enable)
  GOSUB axi_write (&spi_base_addr+&ssienr) &ssienr_value

  RETURN

qspi_ssi_enable:
  LOCAL &ssienr; ssi enable register
  &ssienr=0x8
  LOCAL &ssienr_enable
  &ssienr_enable=0x1

  GOSUB axi_write (&spi_base_addr+&ssienr) &ssienr_enable
  RETURN


qspi_ser_disable:
  GOSUB qspi_ssi_disable

  LOCAL &ser
  &ser=0x10	 ; target enable register. offset 0x10

  GOSUB axi_read (&spi_base_addr+&ser)
  ENTRY &ser_value

  &ser_value=((&ser_value)&(~0x1))
  GOSUB axi_write (&spi_base_addr+&ser) &ser_value

  GOSUB qspi_ssi_enable
  RETURN

qspi_ser_enable:
  GOSUB qspi_ssi_disable

  LOCAL &ser
  &ser=0x10	 ; target enable register. offset 0x10

  GOSUB axi_read (&spi_base_addr+&ser)
  ENTRY &ser_value

  &ser_value=((&ser_value)|0x1)
  GOSUB axi_write (&spi_base_addr+&ser) &ser_value

  GOSUB qspi_ssi_enable
  RETURN

check_read_flag_status:
  LOCAL &dw_spi_ctrlr0_addr_l_0
  LOCAL &dw_spi_ctrlr0_inst_l_8
  LOCAL &dw_spi_ctrlr0_wait_cycle_0
  LOCAL &dw_spi_ctrlr0_trans_type_tt0
  LOCAL &dw_spi_ctrlr0_ddr_disable
  LOCAL &dw_ctrlr0_dfs_8
  LOCAL &dw_ctrlr0_tmod_rx
  LOCAL &dw_ctrlr0_spi_frf_standard
  LOCAL &dw_ctrlr1_ndf_1word

  &dw_spi_ctrlr0_addr_l_0=0x0
  &dw_spi_ctrlr0_inst_l_8=(0x2<<8.)
  &dw_spi_ctrlr0_wait_cycle_0=0x0
  &dw_spi_ctrlr0_trans_type_tt0=0x0
  &dw_spi_ctrlr0_ddr_disable=0
  &dw_ctrlr0_dfs_8=0x7
  &dw_ctrlr0_tmod_rx=(0x2<<10.)
  &dw_ctrlr0_spi_frf_standard=0x0
  &dw_ctrlr1_ndf_1word=0x0

  GOSUB qspi_config_ssi_controller &dw_spi_ctrlr0_addr_l_0 &dw_spi_ctrlr0_inst_l_8 &dw_spi_ctrlr0_wait_cycle_0 &dw_spi_ctrlr0_trans_type_tt0 &dw_spi_ctrlr0_ddr_disable &dw_ctrlr0_dfs_8 &dw_ctrlr0_tmod_rx &dw_ctrlr0_spi_frf_standard &dw_ctrlr1_ndf_1word

  LOCAL &READ_FLAG_STATUS
  &READ_FLAG_STATUS=0x70
  GOSUB qspi_ssi_rx_i &READ_FLAG_STATUS
  ENTRY &read_status_value
  RETURN &read_status_value

check_read_status:
  LOCAL &dw_spi_ctrlr0_addr_l_0
  LOCAL &dw_spi_ctrlr0_inst_l_8
  LOCAL &dw_spi_ctrlr0_wait_cycle_0
  LOCAL &dw_spi_ctrlr0_trans_type_tt0
  LOCAL &dw_spi_ctrlr0_ddr_disable
  LOCAL &dw_ctrlr0_dfs_8
  LOCAL &dw_ctrlr0_tmod_rx
  LOCAL &dw_ctrlr0_spi_frf_standard
  LOCAL &dw_ctrlr1_ndf_1word

  &dw_spi_ctrlr0_addr_l_0=0x0
  &dw_spi_ctrlr0_inst_l_8=(0x2<<8.)
  &dw_spi_ctrlr0_wait_cycle_0=0x0
  &dw_spi_ctrlr0_trans_type_tt0=0x0
  &dw_spi_ctrlr0_ddr_disable=0
  &dw_ctrlr0_dfs_8=0x7
  &dw_ctrlr0_tmod_rx=(0x2<<10.)
  &dw_ctrlr0_spi_frf_standard=0x0
  &dw_ctrlr1_ndf_1word=0x0

  GOSUB qspi_config_ssi_controller &dw_spi_ctrlr0_addr_l_0 &dw_spi_ctrlr0_inst_l_8 &dw_spi_ctrlr0_wait_cycle_0 &dw_spi_ctrlr0_trans_type_tt0 &dw_spi_ctrlr0_ddr_disable &dw_ctrlr0_dfs_8 &dw_ctrlr0_tmod_rx &dw_ctrlr0_spi_frf_standard &dw_ctrlr1_ndf_1word

  LOCAL &READ_STATUS_COMMAND
  &READ_STATUS_COMMAND=0x5
  GOSUB qspi_ssi_rx_i &READ_STATUS_COMMAND
  ENTRY &read_status_value

  PRINT "READ STATUS: &read_status_value"

  RETURN &read_status_value

qspi_config_ssi_controller:
  ENTRY &addr &inst &wait_cycle &trans_type &ddr &dfs &tmod &frf &ndf

  GOSUB qspi_ssi_disable

  LOCAL &spi_ctrlr0
  LOCAL &ctrlr0
  LOCAL &ctrlr1

  &spi_ctrlr0=0xf4 ; spi control register
  &ctrlr0=0x0 ; control register 0
  &ctrlr1=0x4 ; control register 1

  LOCAL &spi_ctrlr0_val
  LOCAL &ctrlr0_val
  LOCAL &ctrlr1_val
  &spi_ctrlr0_val=&addr|&inst|&wait_cycle|&trans_type|&ddr

  GOSUB axi_write (&spi_base_addr+&spi_ctrlr0) &spi_ctrlr0_val

  &ctrlr0_val=&dfs|&tmod|&frf
  GOSUB axi_write (&spi_base_addr+&ctrlr0) &ctrlr0_val

  &ctrlr1_val=&ndf
  GOSUB axi_write (&spi_base_addr+&ctrlr1) &ctrlr1_val

  GOSUB qspi_ssi_enable

  RETURN

qspi_ssi_tx_i:
  ENTRY &inst

  LOCAL &drx
  &drx=0x60; // Data Register

  GOSUB tx_available
  GOSUB axi_write (&spi_base_addr+&drx) &inst
  GOSUB qspi_check_busy
  RETURN

qspi_ssi_rx_i:
  ENTRY &inst

  LOCAL &drx
  &drx=0x60; // Data Register

  GOSUB tx_available
  GOSUB axi_write (&spi_base_addr+&drx) &inst
  GOSUB rx_available

  GOSUB axi_read (&spi_base_addr+&drx)
  ENTRY &drx_value
  RETURN &drx_value

check_flash_available:
  LOCAL &FLASH_READY
  &FLASH_READY=0x80
  GOSUB check_read_flag_status
  ENTRY &status_value

  while ((&status_value)&(&FLASH_READY))!=&FLASH_READY
  (
     GOSUB check_read_flag_status
     ENTRY &status_value
  )
  RETURN

SETUP_1_0_0_CMD:
  LOCAL &dw_spi_ctrlr0_addr_l_0
  LOCAL &dw_spi_ctrlr0_inst_l_8
  LOCAL &dw_spi_ctrlr0_wait_cycle_0
  LOCAL &dw_spi_ctrlr0_trans_type_tt0
  LOCAL &dw_spi_ctrlr0_ddr_disable
  LOCAL &dw_ctrlr0_dfs_8
  LOCAL &dw_ctrlr0_tmod_tx
  LOCAL &dw_ctrlr0_spi_frf_standard
  LOCAL &dw_ctrlr1_ndf_1word
  LOCAL &txftlr

  ; inst.(cmd) = 0 / addr = 0 / data = 8bit
  &dw_spi_ctrlr0_addr_l_0=0x0
  &dw_spi_ctrlr0_inst_l_8=(0x0<<8.)
  &dw_spi_ctrlr0_wait_cycle_0=0x0
  &dw_spi_ctrlr0_trans_type_tt0=0x0
  &dw_spi_ctrlr0_ddr_disable=0
  &dw_ctrlr0_dfs_8=0x7
  &dw_ctrlr0_tmod_tx=(0x1<<10.)
  &dw_ctrlr0_spi_frf_standard=0x0
  &dw_ctrlr1_ndf_1word=0x0
  &txftlr=0x18

  ; Set tx fifo = 0, for cmd-addr-data:1-0-0 format
  GOSUB qspi_ssi_disable
  GOSUB axi_write (&spi_base_addr+&txftlr) 0.
  GOSUB qspi_config_ssi_controller &dw_spi_ctrlr0_addr_l_0 &dw_spi_ctrlr0_inst_l_8 &dw_spi_ctrlr0_wait_cycle_0 &dw_spi_ctrlr0_trans_type_tt0 &dw_spi_ctrlr0_ddr_disable &dw_ctrlr0_dfs_8 &dw_ctrlr0_tmod_tx &dw_ctrlr0_spi_frf_standard &dw_ctrlr1_ndf_1word

  RETURN

axi_write:
  LOCAL &addr &val
  ENTRY &addr &val
  data.set zaxi:&addr %le %long &val
  ;PRINT "axi_write: &addr = &val"
  RETURN

axi_read:
  LOCAL &addr
  ENTRY &addr
  &value=data.long(zaxi:&addr)
  ;PRINT "axi_read: &addr = &value"
  RETURN &value
