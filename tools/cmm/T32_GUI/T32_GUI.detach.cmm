B::

IF !STATE.RUN()
(
    Go
)

SYStem.Down

ENDDO